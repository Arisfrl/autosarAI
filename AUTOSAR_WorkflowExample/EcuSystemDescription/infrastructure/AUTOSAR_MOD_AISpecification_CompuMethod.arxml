AUTOSAR XML (schema 00054)
standard types defined: Boolean
package /AUTOSAR_AISpecification/CompuMethods
  compu method A1: raw=phys*128 for phys -18..18; unit MtrPerSecSqd  # Acceleration 1 | Generic data type for acceleration
  compu method A10: raw=phys*99.95117385 for phys -20.48..20.48; unit MtrPerSecSqd  # Acceleration 10 | Generic data type for acceleration
  compu method A11: raw=phys*255.7544757 for phys -99..99; unit MtrPerSecSqd  # Acceleration 11 | Generic data type for acceleration
  compu method A12: raw=phys*32 for phys -981..981; unit MtrPerSecSqd  # Acceleration 12 | Generic data type for acceleration
  compu method A13: raw=phys*16 for phys -1962..1962; unit MtrPerSecSqd  # Acceleration 13 | Generic data type for acceleration
  compu method A14: raw=phys*4 for phys -7848..7848; unit MtrPerSecSqd  # Acceleration 14 | Generic data type for acceleration
  compu method A2: raw=phys*256 for phys -30..30; unit MtrPerSecSqd  # Acceleration 2 | Generic data type for acceleration
  compu method A3: raw=phys*1024 for phys -8.5..8.5; unit MtrPerSecSqd  # Acceleration 3 | Generic data type for acceleration
  compu method A4: raw=phys*1024 for phys -18..18; unit MtrPerSecSqd  # Acceleration 4 | Generic data type for acceleration
  compu method A5: raw=phys*256 for phys -200..200; unit MtrPerSecSqd  # Acceleration 5 | Generic data type for acceleration
  compu method A7: raw=phys*100 for phys 0..2.55; unit MtrPerSecSqd  # Acceleration 7 | Generic data type for acceleration
  compu method A8: raw=phys*27.77777778 for phys -1178..1178; unit MtrPerSecSqd  # Acceleration 8 | Generic data type for acceleration
  compu method A9: raw=phys*6.956376563 for phys -4710..4710; unit MtrPerSecSqd  # Acceleration 9 | Generic data type for acceleration
  compu method AckSt1: 0=NotAcpt (0 = NotAcpt (Request not accepted.)), 1=Acpt (1 = Acpt (Request accepted.))  # Acknowledge Status 1
  compu method AckSts1: 0=NotAcpt (0 = NotAcpt (Request not accepted.)), 1=Acpt (1 = Acpt (Request accepted.))  # Acknowledge Status 1
  compu method Ag1: raw=phys*1024 for phys -0.5..0.5; unit Rad  # Angle 1 | Generic data type for angle
  compu method Ag2: raw=phys*1024 for phys -1.5..1.5; unit Rad  # Angle 2 | Generic data type for angle
  compu method Ag3: raw=phys*8192 for phys -1.571..1.571; unit Rad  # Angle 3 | Generic data type for angle
  compu method Ag4: raw=phys*1024 for phys -14.5..14.5; unit Rad  # Angle 4 | Generic data type for angle
  compu method Ag5: raw=phys*1024 for phys -870..870; unit Rad  # Angle 5 | Generic data type for angle
  compu method Ag6: raw=phys*80.85071118 for phys -1.57079632679489..1.57079632679489; unit Rad  # Angle 6 | Generic data type for angle
  compu method AgA1: raw=phys*8 for phys -1000..1000; unit RadPerSecSqd  # Angle Acceleration 1 | Generic data type for angle acceleration
  compu method AgA2: raw=phys*256 for phys -75..75; unit RadPerSecSqd  # Angle Acceleration 2 | Generic data type for angle acceleration
  compu method AgSpd1: raw=phys*128 for phys -50..50; unit RadPerSec  # Angle Speed 1 | Generic data type for angle speed
  compu method AgSpd2: raw=phys*1024 for phys -5..5; unit RadPerSec  # Angle Speed 2 | Generic data type for angle speed
  compu method AgSpd3: raw=phys*4096 for phys -5..5; unit RadPerSec  # Angle Speed 3 | Generic data type for angle speed
  compu method AgSpd4: raw=phys*1024 for phys -10..10; unit RadPerSec  # Angle Speed 4 | Generic data type for angle speed
  compu method AgSpd5: raw=phys*1024 for phys -628..628; unit RadPerSec  # Angle Speed 5 | Generic data type for angle speed
  compu method AgSpd6: raw=phys*64 for phys 0..500; unit RadPerSec  # Angle Speed 6 | Generic data type for angle speed
  compu method AgSpd7: raw=phys*1000 for phys -1..1; unit RadPerSec  # Angle Speed 7 | Generic data type for angle speed
  compu method AgSpd8: raw=phys*4096 for phys -8..8; unit RadPerSec  # Angle Speed 8 | Generic data type for angle speed
  compu method AlrmSt1: 0=Disarmed (0 = Disarmed), 1=PreArmed (1 = PreArmed), 2=Armed (2 = Armed), 3=Alrmd (3 = Alrmd)  # Alarm Status
  compu method AlrmSts1: 0=Disarmed (0 = Disarmed), 1=PreArmed (1 = PreArmed), 2=Armed (2 = Armed), 3=Alrmd (3 = Alrmd)  # Alarm Status
  compu method AmprIdentcl: identical; unit Ampr  # Ampere Identical
  compu method ArmingTyp2: 0=Disarm (0 = Disarm), 1=Arm (1 = Arm), 2=ArmingNotFinshd (2 = ArmingNotFinshd), 3=ArmingFinshd (3 = ArmingFinshd)  # Arming Type
  compu method ArmingTyp3: 0=Disarm (0 = Disarm), 1=Arm (1 = Arm)  # Arming Type
  compu method AvlSt1: 0=NotAvl (0 = NotAvl (Not available.)), 1=Avl (1 = Avl (Available.)), 2=NotDefd (2 = NotDefd (Not defined.)), 3=NotExist (3 = NotExist (Not existing.))  # Available Status 1
  compu method AvlSts1: 0=NotAvl (0 = NotAvl (Not available.)), 1=Avl (1 = Avl (Available.)), 2=NotDefd (2 = NotDefd (Not defined.)), 3=NotExist (3 = NotExist (Not existing.))  # Available Status 1
  compu method AxisTyp1: 0=NoAxis (0 = NoAxis), 1=AxisHozl (1 = AxisHozl), 2=AxisVert (2 = AxisVert)  # Axis Type
  compu method BarIdentcl: identical; unit Bar  # Bar Identical
  compu method BltLockSt1: 0=Unlck (0 = Unlck (latch plate is not locked into belt lock or unknown (has to be used together with signal qualifier))), 1=Lock (1 = Lock (latch plate is safety locked into belt lock))  # Belt Lock State
  compu method BltLockSt2: 0=Unlck (0 = Unlck (belt is not locked)), 1=Lock (1 = Lock (belt is locked)), 2=NotPrsnt (2 = NotPrsnt (seat position is not equipped or not fixed))  # Belt Lock State
  compu method BodyLvlCtrl1: 0=Hld (0 = Hld (Hold (default), no body movement.)), 1=Up (1 = Up (Body movement "up".)), 2=Dwn (2 = Dwn (Body movement "down".))  # Body Level Control
  compu method BodyLvlMod1: 0=Lo (0 = Lo (Low mode)), 1=Norm (1 = Norm (Normal mode)), 2=Hi (2 = Hi (High mode))  # Body Level Mode 1
  compu method BrkActrMod1: 0=Reld (0 = Reld (Brake actuator is released.)), 1=DurgRels (1 = DurgRels (Brake actuator during release.)), 2=DurgApply (2 = DurgApply (Brake actuator during apply.)), 3=Appld (3 = Appld (Brake actuator applied.)), 4=BrkgCtrlDyn (4 = BrkgCtrlDyn (Brake actuator in dynamic control.))  # Brake Actuator Mode 1
  compu method BrkActrSatn1: 0=NoSatn (0 = NoSatn (No saturation)), 1=LimnSatnActv (1 = LimnSatnActv (Saturation due to actuator limitation))  # Brake Actuator Saturation 1
  compu method BrkMod1: 0=Cmft (0 = Cmft (comfort relevant)), 1=Sfty (1 = Sfty (safety relevant))  # Brake Mode
  compu method BrkReqTyp1: 0=NoReq (0 = NoReq (No request.)), 1=CmdToEpbSet (1 = CmdToEpbSet (Brake request via Electric Parking Brake (EPB).)), 2=SpclMod (2 = SpclMod (Special mode request.))  # Brake Request Type 1
  compu method BrkReqTyp2: 0=NoReq (0 = NoReq (No request.)), 1=CmdToEscSet (1 = CmdToEscSet (Brake request via Electronic Stability Control (ESC).)), 2=BrkgDynReq (2 = BrkgDynReq (Dynamic braking request.))  # Brake Request Type 2
  compu method BucdSt1: 0=NotBucd (0 = NotBucd (present occupant is not buckled at seating position)), 1=Bucd (1 = Bucd (present occupant is buckled at seating position)), 2=NoOccpt (2 = NoOccpt (no occupant present on seating position)), 3=NotPrsnt (3 = NotPrsnt (seat position not equipped or not fixed or not under control of occupant detection))  # Buckled State
  compu method CalSt1: 0=CalNotStrtd (0 = CalNotStrtd (Calibration not started.)), 1=CalStrtd (1 = CalStrtd (Calibration started.)), 2=CalFinshd (2 = CalFinshd (Calibration finished.)), 3=CalRejctd (3 = CalRejctd (Calibration rejected.))  # Calibration Status 1
  compu method CalSts1: 0=CalNotStrtd (0 = CalNotStrtd (Calibration not started.)), 1=CalStrtd (1 = CalStrtd (Calibration started.)), 2=CalFinshd (2 = CalFinshd (Calibration finished.)), 3=CalRejctd (3 = CalRejctd (Calibration rejected.))  # Calibration Status 1
  compu method ChdProtnCmd1: 0=Off (0 = Off), 1=Actvt (1 = Actvt), 2=Deactvt (2 = Deactvt)  # Child Protection Command
  compu method ChgInfo1: 0=NoChgInfo (0 = NoChgInfo (No change happened)), 1=ChgInfo (1 = ChgInfo (Change happened))  # Change
  compu method CluSt1: 0=Opend (0 = Opend (Opened)), 1=Inter (1 = Inter (Intermediate)), 2=NearClsd (2 = NearClsd (Near Closed)), 3=HardClsd (3 = HardClsd (Hard Closed))  # Clutch State
  compu method CornrMkr1: 0=Off (0 = Off), 1=Le (1 = Le (left)), 2=Ri (2 = Ri (right))  # Corner Marker
  compu method CptInfo1: 0=Fob (0 = Fob), 1=Imob (1 = Imob), 2=Ecu (2 = Ecu)  # Component Information
  compu method CrashSt1: 1=PreCrash (1 = PreCrash), 2=PostCrash (2 = PostCrash)  # Crash Status
  compu method CrashSts1: 1=PreCrash (1 = PreCrash), 2=PostCrash (2 = PostCrash)  # Crash Status
  compu method CrsCtrlAndAccSwtSt1: 0=Set (0 = Set (Set (engage))), 1=Resu (1 = Resu (Resume)), 2=Cncl (2 = Cncl (Cancel (disengage)))  # Cruise Control and ACC Switch Status 1
  compu method CrsCtrlAndAccSwtSts1: 0=Set (0 = Set (Set (engage))), 1=Resu (1 = Resu (Resume)), 2=Cncl (2 = Cncl (Cancel (disengage)))  # Cruise Control and ACC Switch Status 1
  compu method Crvt1: raw=phys*327670 for phys -0.1..0.1; unit PerMtr  # Curvature 1 | Generic data type for curvature
  compu method CtrlSt1: 0=NoCtrl (0 = NoCtrl (Not in control)), 1=InCtrl (1 = InCtrl (In control))  # Control Status
  compu method CtrlSts1: 0=NoCtrl (0 = NoCtrl (Not in control)), 1=InCtrl (1 = InCtrl (In control))  # Control Status
  compu method DamprCoeff1: raw=phys for phys -10000..10000; unit NwtSecPerMtr  # Damper Coefficient 1 | Generic data type for damper coefficient
  compu method Day1: raw=phys for phys 1..31  # Day 1 | It represents the value of a day in a month
  compu method DegCgrdIdentcl: identical; unit DegCgrd  # Degree Centigrade Identical
  compu method DegCgrdLnr1: raw=phys*2 for phys -70..213; unit DegCgrd  # Degree Centigrade Linear 1 | Generic data type for temperature.
  compu method DetnSt1: 0=NotDetd (0 = NotDetd (Not detected.)), 1=Detd (1 = Detd (Detected.))  # Detection Status 1
  compu method DetnSts1: 0=NotDetd (0 = NotDetd (Not detected.)), 1=Detd (1 = Detd (Detected.))  # Detection Status 1
  compu method DevErrSt1: 0=NoFlt (0 = NoFlt (No fault)), 1=DegradedOper (1 = DegradedOper (Degraded operation)), 2=Flt (2 = Flt (Fault))  # Device Error Status 1
  compu method DevErrSt2: 0=NoFlt (0 = NoFlt), 1=Flt (1 = Flt)  # Device Error Status
  compu method DevErrSt3: 0=Flt (0 = Flt (Fault)), 1=NoFlt (1 = NoFlt (No fault))  # Device Error Status 3
  compu method DevErrSt4: 0=Flt (0 = Flt (Fault)), 1=NoFlt (1 = NoFlt (No fault)), 2=Lockd (2 = Lockd (Locked))  # Device Error Status 4
  compu method DevErrSts1: 0=NoFlt (0 = NoFlt (No fault)), 1=DegradedOper (1 = DegradedOper (Degraded operation)), 2=Flt (2 = Flt (Fault))  # Device Error Status 1
  compu method DevErrSts2: 0=NoFlt (0 = NoFlt), 1=Flt (1 = Flt)  # Device Error Status
  compu method DevErrSts3: 0=Flt (0 = Flt (Fault)), 1=NoFlt (1 = NoFlt (No fault))  # Device Error Status 3
  compu method DevErrSts4: 0=Flt (0 = Flt (Fault)), 1=NoFlt (1 = NoFlt (No fault)), 2=Lockd (2 = Lockd (Locked))  # Device Error Status 4
  compu method DevSt4: 0=Off (0 = Off (Inactive)), 1=On (1 = On (Active)), 2=Err (2 = Err (Error))  # Device Status 4
  compu method DevSt5: 0=Flt (0 = Flt (Fault)), 1=Warn (1 = Warn (Able to warn)), 2=Actv (2 = Actv (Active (normal operation)))  # Device Status 5
  compu method DevSt6: 0=NoEvln (0 = NoEvln), 1=Vld (1 = Vld), 2=Invld (2 = Invld), 3=Miss (3 = Miss)  # Device Status
  compu method DevSt7: 0=Inin (0 = Inin (Initialization)), 1=Ok (1 = Ok (Ok)), 2=TmpErr (2 = TmpErr (Temporary error.)), 3=PrmntErr (3 = PrmntErr (Permanent error.)), 4=UsrOff (4 = UsrOff (Disabled by driver.))  # Device Status 7
  compu method DevSts4: 0=Off (0 = Off (Inactive)), 1=On (1 = On (Active)), 2=Err (2 = Err (Error))  # Device Status 4
  compu method DevSts5: 0=Flt (0 = Flt (Fault)), 1=Warn (1 = Warn (Able to warn)), 2=Actv (2 = Actv (Active (normal operation)))  # Device Status 5
  compu method DevSts6: 0=NoEvln (0 = NoEvln), 1=Vld (1 = Vld), 2=Invld (2 = Invld), 3=Miss (3 = Miss)  # Device Status
  compu method DevSts7: 0=Inin (0 = Inin (Initialization)), 1=Ok (1 = Ok (Ok)), 2=TmpErr (2 = TmpErr (Temporary error.)), 3=PrmntErr (3 = PrmntErr (Permanent error.)), 4=UsrOff (4 = UsrOff (Disabled by driver.))  # Device Status 7
  compu method DoorHndlSt1: 0=NotTouchd (0 = NotTouchd (Not Touched)), 1=Touchd (1 = Touchd (Touched)), 2=Invld (2 = Invld (Invalid))  # Door Handle Status
  compu method DoorHndlSts1: 0=NotTouchd (0 = NotTouchd (Not Touched)), 1=Touchd (1 = Touchd (Touched)), 2=Invld (2 = Invld (Invalid))  # Door Handle Status
  compu method DoorSt1: 0=Ukwn (0 = Ukwn (initialisation phase)), 1=Opend (1 = Opend), 2=Clsd (2 = Clsd), 3=Ajar (3 = Ajar (nearly closed)), 4=Invld (4 = Invld (implausible))  # Door Status
  compu method DoorSts1: 0=Ukwn (0 = Ukwn (initialisation phase)), 1=Opend (1 = Opend), 2=Clsd (2 = Clsd), 3=Ajar (3 = Ajar (nearly closed)), 4=Invld (4 = Invld (implausible))  # Door Status
  compu method DynPpty1: 0=Undefd (0 = Undefd (Undefined.)), 1=Standg (1 = Standg (Standing: has never been detected moving. )), 2=StopInDir (2 = StopInDir (Stopped: has been detected moving in same direction, but is stationary now.)), 3=MoveInDir (3 = MoveInDir (Moving: object has absolute speed in same direction.)), 4=MoveInIvsDir (4 = MoveInIvsDir (Moving: object has absolute speed in inverse direction. )), 5=StopInIvsDir (5 = StopInIvsDir (Stopped: has been detected moving in inverse, but is stationary now. ))  # Dynamic Property 1
  compu method EgyMngtSt1: 0=NoFctPsbl (0 = NoFctPsbl (only for completeness)), 1=SftyFctOnly (1 = SftyFctOnly (only safety functionalities / components active (functionalities considered as relevant for passenger safety))), 2=HbrntLvl1 (2 = HbrntLvl1 (Hibernation level 1 for deactivation of functionalities / components during long-term parking (to save battery capacity))), 3=HbrntLvl2 (3 = HbrntLvl2 (Hibernation level 2 for deactivation of functionalities / components during long-term parking (to save battery capacity))), 4=HbrntLvl3 (4 = HbrntLvl3 (Hibernation level 3 for deactivation of functionalities / components during long-term parking (to save battery capacity))), 5=LimnLvl1 (5 = LimnLvl1 (Limitation level 1 for deactivation of functionalities / components in case of improper load-balance of battery / generator during normal use of the vehicle)), 6=LimnLvl2 (6 = LimnLvl2 (Limitation level 2 for deactivation of functionalities / components in case of improper load-balance of battery / generator during normal use of the vehicle)), 7=LimnLvl3 (7 = LimnLvl3 (Limitation level 3 for deactivation of functionalities / components in case of improper load-balance of battery / generator during normal use of the vehicle)), 8=LimnLvl4 (8 = LimnLvl4 (Limitation level 4 for deactivation of functionalities / components in case of improper load-balance of battery / generator during normal use of the vehicle)), 9=FullFct (9 = FullFct (default (no functionalities / components deactivated due to energy management reasons))), 10=CnseEgy (10 = CnseEgy (To identify Energy Consumption situations: valid when battery is unbalanced or when more load has to be applied onto generator))  # Energy Management Status
  compu method EgyMngtSts1: 0=NoFctPsbl (0 = NoFctPsbl (only for completeness)), 1=SftyFctOnly (1 = SftyFctOnly (only safety functionalities / components active (functionalities considered as relevant for passenger safety))), 2=HbrntLvl1 (2 = HbrntLvl1 (Hibernation level 1 for deactivation of functionalities / components during long-term parking (to save battery capacity))), 3=HbrntLvl2 (3 = HbrntLvl2 (Hibernation level 2 for deactivation of functionalities / components during long-term parking (to save battery capacity))), 4=HbrntLvl3 (4 = HbrntLvl3 (Hibernation level 3 for deactivation of functionalities / components during long-term parking (to save battery capacity))), 5=LimnLvl1 (5 = LimnLvl1 (Limitation level 1 for deactivation of functionalities / components in case of improper load-balance of battery / generator during normal use of the vehicle)), 6=LimnLvl2 (6 = LimnLvl2 (Limitation level 2 for deactivation of functionalities / components in case of improper load-balance of battery / generator during normal use of the vehicle)), 7=LimnLvl3 (7 = LimnLvl3 (Limitation level 3 for deactivation of functionalities / components in case of improper load-balance of battery / generator during normal use of the vehicle)), 8=LimnLvl4 (8 = LimnLvl4 (Limitation level 4 for deactivation of functionalities / components in case of improper load-balance of battery / generator during normal use of the vehicle)), 9=FullFct (9 = FullFct (default (no functionalities / components deactivated due to energy management reasons))), 10=CnseEgy (10 = CnseEgy (To identify Energy Consumption situations: valid when battery is unbalanced or when more load has to be applied onto generator))  # Energy Management Status
  compu method EnagSt1: 0=NotEnad (0 = NotEnad (not enabled)), 1=Enad (1 = Enad (enabled))  # Enabling Status 1
  compu method EngRunngDir1: 0=EngRunngDirUndefd (0 = EngRunngDirUndefd (undefined running direction, no direction information accessible)), 1=EngRunngDirPos (1 = EngRunngDirPos (positive running direction)), 2=EngRunngDirNeg (2 = EngRunngDirNeg (negative running direction)), 3=EngRunngDirInvldErr (3 = EngRunngDirInvldErr (invalid due to error))  # Engine Running Direction
  compu method EngStrtRemReq1: 0=NoReq (0 = NoReq (no engine start request from remote control)), 1=EngStrtReq (1 = EngStrtReq (engine start request from remote control))  # Engine Start Remote Request
  compu method EntryEasy1: 0=Idle (0 = Idle (no user request)), 1=ActvtEntryEasyFrnt (1 = ActvtEntryEasyFrnt (allow easy entry from the front of the seat)), 2=RelsEntryEasyFrnt (2 = RelsEntryEasyFrnt (restore previous seat position after activation of easy entry from the front of the seat)), 3=ActvtEntryEasyRe (3 = ActvtEntryEasyRe (allow easy entry behind the seat)), 4=RelsEntryEasyRe (4 = RelsEntryEasyRe (restore previous seat position after activation of easy entry behind the seat))  # Entry Easy
  compu method EpbBtnCtrlSt1: 0=NoReq (0 = NoReq (No parking brake request by driver.)), 1=ApplyReq (1 = ApplyReq (Parking brake apply request by driver (push/pull button).)), 2=RelsReq (2 = RelsReq (Parking brake release request by driver (push/pull button).)), 3=Actvd (3 = Actvd (Parking brake apply request by driver (push only button).)), 4=Ukwn (4 = Ukwn (Unknown button state.))  # Button Control Status 1
  compu method EpbBtnCtrlSts1: 0=NoReq (0 = NoReq (No parking brake request by driver.)), 1=ApplyReq (1 = ApplyReq (Parking brake apply request by driver (push/pull button).)), 2=RelsReq (2 = RelsReq (Parking brake release request by driver (push/pull button).)), 3=Actvd (3 = Actvd (Parking brake apply request by driver (push only button).)), 4=Ukwn (4 = Ukwn (Unknown button state.))  # Button Control Status 1
  compu method F1: raw=phys for phys -2500..2500; unit Nwt  # Force 1 | Generic data type for force
  compu method F2: raw=phys for phys -20000..20000; unit Nwt  # Force 2 | Generic data type for force
  compu method F3: raw=phys for phys -150000..150000; unit Nwt  # Force 3 | Generic data type for force
  compu method Fac1: raw=phys*1024 for phys -32..31.9990234375  # Factor 1 | Generic data type for factor
  compu method Fac3: raw=phys*2048-1433.6 for phys 0.7..1.2  # Factor 3 | Generic data type for factor
  compu method Fac4: raw=phys*2048 for phys 0..1  # Factor 4 | Generic data type for factor
  compu method Fac5: raw=phys*128 for phys 0..127.9921875  # Factor 5 | Generic data type for factor
  compu method Fac7: raw=phys*255 for phys 0..1  # Factor 7 | Generic data type for factor
  compu method Fixa1: 0=NotFixd (0 = NotFixd (Not fixed)), 1=Fixd (1 = Fixd (Fixed))  # Fixation
  compu method Flg1: 0=Rst (0 = Rst (Flag reset: Flag is not set (FALSE))), 1=Set (1 = Set (Flag set: Flag is set (TRUE)))  # Flag
  compu method FricCoeff1: raw=phys*100 for phys 0..2  # Friction Coefficient 1 | Generic data type for friction coefficient
  compu method Frq1: raw=phys*16 for phys 0..100; unit Hz  # Frequency 1 | Generic data type for frequency
  compu method Frq2: raw=phys*10-5 for phys 0.5..20; unit KiloHz  # Frequency 2 | Generic data type for acoustic frequency
  compu method GearShiftPrevn1: 0=NoReq (0 = NoReq (No gear shift prevention request)), 1=InhbShiftUp (1 = InhbShiftUp (Inhibit up shift)), 2=InhbShiftDwn (2 = InhbShiftDwn (Inhibit down shift)), 3=InhbShiftAll (3 = InhbShiftAll (Inhibit all gear shifts))  # Gear Shift Prevention 1
  compu method GearSt1: -2=RvsGear2 (-2 = RvsGear2 (discrete reverse gear 2)), -1=RvsGear1 (-1 = RvsGear1 (discrete reverse gear 1)), 0=NoGearEngd (0 = NoGearEngd (no gear engaged)), 1=Gear1 (1 = Gear1 (discrete gear 1)), 2=Gear2 (2 = Gear2 (discrete gear 2)), 3=Gear3 (3 = Gear3 (discrete gear 3)), 4=Gear4 (4 = Gear4 (discrete gear 4)), 5=Gear5 (5 = Gear5 (discrete gear 5)), 6=Gear6 (6 = Gear6 (discrete gear 6)), 7=Gear7 (7 = Gear7 (discrete gear 7)), 8=Gear8 (8 = Gear2 (discrete gear 8)), 9=Gear9 (9 = Gear2 (discrete gear 9)), 10=Gear10 (10 = Gear10 (discrete gear 10)), 11=Gear11 (11 = Gear11 (discrete gear 11)), 12=Gear12 (12 = Gear12 (discrete gear 12)), 13=Gear13 (13 = Gear13 (discrete gear 13)), 14=Gear14 (14 = Gear14 (discrete gear 14)), 15=Gear15 (15 = Gear15 (discrete gear 15)), 16=Gear16 (16 = Gear16 (discrete gear 16)), 17=Gear17 (17 = Gear17 (discrete gear 17)), 18=Gear18 (18 = Gear18 (discrete gear 18)), 19=Gear19 (19 = Gear19 (discrete gear 19)), 20=Gear20 (20 = Gear20 (discrete gear 20)), 21=Gear21 (21 = Gear21 (discrete gear 21)), 22=Gear22 (22 = Gear22 (discrete gear 22)), 23=Gear23 (23 = Gear23 (discrete gear 23)), 24=Gear24 (24 = Gear24 (discrete gear 24)), 25=Gear25 (25 = Gear25 (discrete gear 25)), 26=Gear26 (26 = Gear26 (discrete gear 26)), 27=NoDisGear (27 = NoDisGear (no discrete gear))  # Gear State 1
  compu method HectoPaIdentcl: identical; unit HectoPa  # Hecto Pascal Identical
  compu method HldOnDmdSt1: 0=Avl (0 = Avl (Hold On Demand (HOD) function is available.)), 1=NotAvlAndVehMovg (1 = NotAvlAndVehMovg (Hold On Demand (HOD) function is not available because the vehicle is moving)), 2=NotAvlAndFailr (2 = NotAvlAndFailr (Hold On Demand (HOD) function is not available due to failure))  # Hold on Demand State 1
  compu method HomeCmngAndHomeLvngReq1: 0=Off (0 = Off), 1=HomeCmng (1 = HomeCmng), 2=HomeLvng (2 = HomeLvng)  # Home Coming and Home Leaving Request
  compu method Hr1: raw=phys for phys 0..23  # Hour 1 | It represents the value of an hour in a day (24h format)
  compu method HzIdentcl: identical; unit Hz  # Hertz Identical
  compu method ImobSt1: 0=FobBattLo (0 = FobBattLo (Fob Battery Low)), 1=NoFob (1 = NoFob (Fob Not Found)), 2=FobNotProgd (2 = FobNotProgd (Fob Not Programmed)), 3=Authn (3 = Authn (Authorized)), 4=NoAuthn (4 = NoAuthn (Not Authorized)), 5=LrngSt (5 = LrngSt (Learning Status)), 6=Err (6 = Err (Error))  # Immobilizer Status
  compu method ImobSts1: 0=FobBattLo (0 = FobBattLo (Fob Battery Low)), 1=NoFob (1 = NoFob (Fob Not Found)), 2=FobNotProgd (2 = FobNotProgd (Fob Not Programmed)), 3=Authn (3 = Authn (Authorized)), 4=NoAuthn (4 = NoAuthn (Not Authorized)), 5=LrngSts (5 = LrngSts (Learning Status)), 6=Err (6 = Err (Error))  # Immobilizer Status
  compu method ImobnWirelsReq1: 0=NotAvl (0 = NotAvl (Signal Not Available)), 1=On (1 = On), 2=Off (2 = Off), 3=Err (3 = Err (Error))  # Wireless Immobilizer Request
  compu method ImpctSt1: 0=NoImpct (0 = NoImpct (No impact occurred)), 1=Impct (1 = Impct (Impact occurred))  # Impact Status
  compu method ImpctSts1: 0=NoImpct (0 = NoImpct (No impact occurred)), 1=Impct (1 = Impct (Impact occurred))  # Impact Status
  compu method InOut1: 0=In (0 = In (Inside)), 1=Out (1 = Out (Outside))  # In Out
  compu method IndcrForStop1: 0=HardStop (0 = HardStop (hard stop)), 1=SoftStopForOn (1 = SoftStopForOn (soft stop on ON phase)), 2=SoftStopForOff (2 = SoftStopForOff (soft stop on OFF phase))  # Indicator For Stop
  compu method IndcrSt1: 0=Off (0 = Off), 1=LeOn (1 = LeOn), 2=RiOn (2 = RiOn), 3=LeAndRiOn (3 = LeAndRiOn)  # Indicator Status
  compu method IndcrSts1: 0=Off (0 = Off), 1=LeOn (1 = LeOn), 2=RiOn (2 = RiOn), 3=LeAndRiOn (3 = LeAndRiOn)  # Indicator Status
  compu method IndcrTypExt1: 0=Off (0 = Off), 1=Le (1 = Le), 2=Ri (2 = Ri), 3=TmpLe (3 = TmpLe), 4=TmpRi (4 = TmpRi)  # Indicator Type External
  compu method IntrLiReq1: 0=Ukwn (0 = Ukwn (Unknown)), 1=Off (1 = Off (Always off)), 2=On (2 = On (Always on)), 3=Aut (3 = Aut (Automatically on e. g. by opening a door)), 4=Invld (4 = Invld)  # Interior Light Request
  compu method InvldVld1: 0=Invld (0 = Invld (Invalid)), 1=Vld (1 = Vld (Valid))  # Invalid Valid
  compu method InvldVld2: 0=Vld (0 = Vld (Valid)), 1=Invld (1 = Invld (Invalid))  # Invalid Valid
  compu method Jerk1: raw=phys*256 for phys -30..30; unit MtrPerSecCubd  # Jerk 1 | Generic data type for acceleration change rate
  compu method KelvinIdentcl: identical; unit KelvinAbslt  # Kelvin Identical
  compu method KeyCmd1: 0=NoCmd (0 = NoCmd (No Command)), 1=Lrn (1 = Lrn (Learn)), 2=Auth (2 = Auth (Authorize))  # Key Command
  compu method KeyInsertSt1: 0=Insert (0 = Insert (Key is inserted into mechanical key cylinder)), 1=NotInsert (1 = NotInsert (Key is not inserted into mechanical key cylinder))  # Key Insert Status
  compu method KeyInsertSts1: 0=Insert (0 = Insert (Key is inserted into mechanical key cylinder)), 1=NotInsert (1 = NotInsert (Key is not inserted into mechanical key cylinder))  # Key Insert Status
  compu method KeySt1: 0=NoSt (0 = NoSt (No Status)), 1=Ackd (1 = Ackd (Verified)), 2=NotAckd (2 = NotAckd (Not Verified)), 3=Lrn (3 = Lrn (Learned)), 4=NotLrn (4 = NotLrn (Not Learned))  # Key Status
  compu method KeySts1: 0=NoSts (0 = NoSts (No Status)), 1=Ackd (1 = Ackd (Verified)), 2=NotAckd (2 = NotAckd (Not Verified)), 3=Lrn (3 = Lrn (Learned)), 4=NotLrn (4 = NotLrn (Not Learned))  # Key Status
  compu method KiloGrIdentcl: identical; unit KiloGr  # Kilo Gram Identical
  compu method KiloHzIdentcl: identical; unit KiloHz  # Kilo Hertz Identical
  compu method KiloMtrIdentcl: identical; unit KiloMtr  # Kilo Meter Identical
  compu method LeRi1: 0=Le (0 = Le (left)), 1=Ri (1 = Ri (right))  # Left Right 1
  compu method Len1: raw=phys*1020.408163 for phys -0.2..0.2; unit Mtr  # Length 1 | Generic data type for length
  compu method Len10: raw=phys*63.99804627 for phys -125..125; unit Mtr  # Length 10 | Generic data type for length
  compu method Len11: raw=phys*99.95117385 for phys 0..40.96; unit Mtr  # Length 11 | Generic data type for length
  compu method Len14: raw=phys*10 for phys 0..6; unit Mtr  # Length 14 | Generic data type for length
  compu method Len3: raw=phys*4096 for phys -0.3..0.3; unit Mtr  # Length 3 | Generic data type for length
  compu method Len4: raw=phys*1024 for phys -0.3..0.3; unit Mtr  # Length 4 | Generic data type for length
  compu method Len5: raw=phys*256 for phys 0..4; unit Mtr  # Length 5 | Generic data type for length
  compu method Len6: raw=phys*2 for phys 0..1000000; unit KiloMtr  # Length 6 | Generic data type for length
  compu method Len7: raw=phys*64 for phys -500..500; unit Mtr  # Length 7 | Generic data type for length
  compu method LiOnWarn1: 0=Off (0 = Off), 1=LiPark (1 = LiPark), 2=BeamLo (2 = BeamLo)  # Light On Warning
  compu method LockActvn1: 0=Off (0 = Off), 1=Unlck (1 = Unlck), 2=Lock (2 = Lock), 3=Safe (3 = Safe)  # Lock Activation
  compu method LockSt1: 0=Imps (0 = Imps (no plausible locking state)), 1=Unlckd (1 = Unlckd (Latch unlocked)), 2=Lockd (2 = Lockd (Latch locked)), 3=Safe (3 = Safe (Latch safed)), 4=Movg (4 = Movg (Latch is moving to a new position. As the latch movement might take much longer than the cycle time of the central locking master, it is helpful to keep the central locking master and the state of the lock in sync.))  # Lock Status
  compu method LockSt2: 0=Undefd (0 = Undefd (undefined status)), 1=Opend (1 = Opend (At least one door or lid is open)), 2=Clsd (2 = Clsd (all doors including lids closed, (at least one door unlocked))), 3=Lockd (3 = Lockd (all doors including lids locked, (at least one door unsafed))), 4=Safe (4 = Safe (Complete car safed (double locked)))  # Lock Status
  compu method LockStOfSteerCol1: 0=NotAvl (0 = NotAvl (Signal Not Available)), 1=Lockd (1 = Lockd (Locked)), 2=NotLockd (2 = NotLockd (Not Locked)), 3=Err (3 = Err (Error))  # Steering Column Lock Status
  compu method LockSts1: 0=Imps (0 = Imps (no plausible locking state)), 1=Unlckd (1 = Unlckd (Latch unlocked)), 2=Lockd (2 = Lockd (Latch locked)), 3=Safe (3 = Safe (Latch safed)), 4=Movg (4 = Movg (Latch is moving to a new position. As the latch movement might take much longer than the cycle time of the central locking master, it is helpful to keep the central locking master and the state of the lock in sync.))  # Lock Status
  compu method LockSts2: 0=Undefd (0 = Undefd (undefined status)), 1=Opend (1 = Opend (At least one door or lid is open)), 2=Clsd (2 = Clsd (all doors including lids closed, (at least one door unlocked))), 3=Lockd (3 = Lockd (all doors including lids locked, (at least one door unsafed))), 4=Safe (4 = Safe (Complete car safed (double locked)))  # Lock Status
  compu method LockStsOfSteerCol1: 0=NotAvl (0 = NotAvl (Signal Not Available)), 1=Lockd (1 = Lockd (Locked)), 2=NotLockd (2 = NotLockd (Not Locked)), 3=Err (3 = Err (Error))  # Steering Column Lock Status
  compu method LockTrigSrc1: 0=NoTrigSrc (0 = NoTrigSrc), 1=KeyRem (1 = KeyRem (Remote Key)), 2=Keyls (2 = Keyls (Keyless Entry)), 3=KeyMecl (3 = KeyMecl (Mechanical Key)), 4=KeyPad (4 = KeyPad (Keypad)), 5=Spd (5 = Spd (Speed)), 6=Crash (6 = Crash (Crash)), 7=IntrSwt (7 = IntrSwt (Interior switch for locking or unlocking)), 8=LockAut (8 = LockAut (Car locked after period of time passed)), 9=LockOutPrevn (9 = LockOutPrevn (Key left inside)), 10=TrUnlck (10 = TrUnlck (Trunk unlocked)), 11=FlprGlass (11 = FlprGlass (Flipper glass (rear window) ))  # Lock Trigger Source
  compu method LockUnlckReq1: 0=Idle (0 = Idle (no user request)), 1=Unlck (1 = Unlck), 2=Lock (2 = Lock)  # Lock Unlock Request
  compu method LockgCenReq1: 0=Idle (0 = Idle), 1=Unlck (1 = Unlck), 2=Lock (2 = Lock), 3=Safe (3 = Safe), 4=OpenCmft (4 = OpenCmft), 5=ClsCmft (5 = ClsCmft), 6=UnlckSeld (6 = UnlckSeld)  # Locking Central Request
  compu method LockgCenReqSrc1: 0=Undefd (0 = Undefd), 1=KeyMecl (1 = KeyMecl), 2=KeyRem (2 = KeyRem), 3=KeyPad (3 = KeyPad), 4=LockCenMst (4 = LockCenMst), 5=AcsKeylsOfDoorDrvr (5 = AcsKeylsOfDoorDrvr), 6=AcsKeylsOfDoorPass (6 = AcsKeylsOfDoorPass), 7=AcsKeylsOfDoorRiRe (7 = AcsKeylsOfDoorRiRe), 8=AcsKeylsOfDoorLeRe (8 = AcsKeylsOfDoorLeRe), 9=AcsKeylsOfLidRe (9 = AcsKeylsOfLidRe), 10=AcsKeylsUndefd (10 = AcsKeylsUndefd)  # Locking Central Request Source
  compu method M1: raw=phys for phys 0..10000; unit KiloGr  # Mass 1 | Generic data type for mass
  compu method M2: raw=phys for phys 0..250; unit KiloGr  # Mass 2 | Generic data type for mass
  compu method MemBtn1: 0=NoBtn (0 = NoBtn), 1=Btn1 (1 = Btn1), 2=Btn2 (2 = Btn2), 3=Btn3 (3 = Btn3), 4=Btn4 (4 = Btn4), 5=Btn5 (5 = Btn5)  # Memory Button
  compu method Mins1: raw=phys for phys 0..59  # Minute 1 | It represents the value of a minute in one hour
  compu method MirrTyp1: 0=NoMirr (0 = NoMirr), 1=DrvrMirr (1 = DrvrMirr), 2=DoorPass (2 = DoorPass), 3=IntrMirr (3 = IntrMirr)  # Mirror Type
  compu method MolPerMtrCubdIdentcl: identical; unit MolPerMtrCubd  # Mole Per Cubic Meter Identical
  compu method MoveSt1: 0=Idle (0 = Idle (Idle)), 1=Man (1 = Man (Manually)), 2=Aut (2 = Aut (Automatically))  # Move Status
  compu method MoveSts1: 0=Idle (0 = Idle (Idle)), 1=Man (1 = Man (Manually)), 2=Aut (2 = Aut (Automatically))  # Move Status
  compu method MovmtTyp1: 0=Idle (0 = Idle), 1=Inc (1 = Inc), 2=Dec (2 = Dec)  # Movement Type
  compu method Mth1: raw=phys for phys 1..12  # Month 1 | It represents the value of a month in a calendar year
  compu method MtrIdentcl: identical; unit Mtr  # Meter Identical
  compu method MtrPerSecCubdIdentcl: identical; unit MtrPerSecCubd  # Meter per Second Cubed Identical
  compu method MtrPerSecIdentcl: identical; unit MtrPerSec  # Meter per Second Identical
  compu method MtrPerSecSqdIdentcl: identical; unit MtrPerSecSqd  # Meter per Second Squared Identical
  compu method MtrRecprIdentcl: identical; unit PerMtr  # Meter Reciprocal Identical
  compu method N1: raw=phys*2 for phys 0..16383.5; unit Rpm  # Rotational Speed 1 | Generic data type for rotational speed
  compu method NGrdt1: raw=phys for phys -30000..30000; unit RpmPerSec  # Engine Speed Gradient | Generic data type for rotational speed gradient
  compu method NoUnitIdentcl: identical  # No Unit Identical
  compu method Nr1: raw=phys for phys -16..15  # Number 1 | Generic data type for number
  compu method Nr10: raw=phys for phys 0..512  # Number 10 | Generic data type for number
  compu method Nr2: raw=phys for phys 0..255  # Number 2 | Generic data type for number
  compu method Nr3: raw=phys for phys 0..65535  # Number 3 | Generic data type for number
  compu method Nr4: raw=phys for phys -128..127  # Number 4 | Generic data type for number
  compu method Nr5: raw=phys for phys 0..7  # Number 5 | Generic data type for number
  compu method Nr6: raw=phys for phys 0..31  # Number 6 | Generic data type for number
  compu method Nr7: raw=phys for phys 0..3  # Number 7 | Generic data type for number
  compu method Nr8: raw=phys for phys 0..4294967295  # Number 8 | Generic data type for number
  compu method Nr9: raw=phys for phys -8..7  # Number 9 | Generic data type for number
  compu method NwtIdentcl: identical; unit Nwt  # Newton Identical
  compu method NwtMtrIdentcl: identical; unit NwtMtr  # Newton Meter Identical
  compu method NwtMtrPerSecIdentcl: identical; unit NwtMtrPerSec  # Newton Meter per Second Identical
  compu method NwtPerMtrIdentcl: identical; unit NwtPerMtr  # Newton per Meter Identical
  compu method NwtSecPerMtrIdentcl: identical; unit NwtSecPerMtr  # Newton Second per Meter Identical
  compu method ObjClassn1: 0=NoClassn (0 = NoClassn (Not classified.)), 1=PassCar (1 = PassCar (Passenger car.)), 2=TruckBusVan (2 = TruckBusVan (Truck or bus or van.)), 3=MotorcycleBicycle (3 = MotorcycleBicycle (Motor cycle or bicycle.)), 4=Ped (4 = Ped (Pedestrian))  # Object Classification 1
  compu method ObstclDstInPrkgSegSt1: 0=ObstclDst (0 = ObstclDst (Measured distance to detected obstacle available)), 1=Idle (1 = Idle (Idle, no obstacle detected.)), 2=NotAvl (2 = NotAvl (Signal Not Available))  # Obstacle Distance Park Status
  compu method ObstclDstInPrkgSegSts1: 0=ObstclDst (0 = ObstclDst (Measured distance to detected obstacle available)), 1=Idle (1 = Idle (Idle, no obstacle detected.)), 2=NotAvl (2 = NotAvl (Signal Not Available))  # Obstacle Distance Park Status
  compu method OccptClass1: 0=Empty (0 = Empty (empty seat, not occupied)), 1=ChdSeatFacdRe (1 = ChdSeatFacdRe (rear faced child seat (RFCS))), 2=ChdSeatFacdFwd (2 = ChdSeatFacdFwd (forward faced child seat (FFCS))), 3=Fmale (3 = Fmale (5% female (light female))), 4=Male (4 = Male (50% male (medium male))), 5=MaleHvy (5 = MaleHvy (95% male (heavy male)))  # Occupant Class
  compu method OccptOutOfPos1: 0=InPos (0 = InPos (in position)), 1=OutOfPos (1 = OutOfPos (out of position)), 2=CritOutOfPos (2 = CritOutOfPos (critical out of position))  # Occupant out of Position
  compu method OccptPresSt1: 0=NoOccpt (0 = NoOccpt (no occupant is present on seating position)), 1=OccptPrsnt (1 = OccptPrsnt (seat position is occupied by occupant))  # Occupant Presence State
  compu method OnOff1: 0=Off (0 = Off), 1=On (1 = On)  # On Off 1
  compu method OnOff2: 0=On (0 = On), 1=Off (1 = Off)  # On Off 2
  compu method OpendClsd1: 0=Opend (0 = Opend), 1=Clsd (1 = Clsd)  # Opened Closed
  compu method Oper1: 0=Off (0 = Off), 1=Recall (1 = Recall), 2=Store (2 = Store)  # Operation
  compu method OperModSt1: 10=PrepIdle (10 = PrepIdle (Transient state: might be used to prepare for going to idle state.)), 0=Idle (0 = Idle (No valid user identification detected; car is waiting for valid identification. Most systems should be in power-save mode. Only functionalities that do not require a valid identification may be active / operational (e.g. hazard warning, burglar alarm, Id detection mechanisms, parking light).)), 6=PrepIdn (6 = PrepIdn (Transient state: components / functionalities involved in identification should be operational (may include overall system consistency checks to ensure that the system was not tampered during idle state etc.). State might be used to prepare for IdAprvd if start-up time is needed.)), 1=IdAprvd (1 = IdAprvd (Valid user identification detected in or around the car. Certain body functionalities may be active / operational (e.g. locking / unlocking of doors, (de-)activation of burglar alarm).)), 9=AcsyPost (9 = AcsyPost (Transient state: might be used to prepare for going to idle state (e.g. by storing persistent data to persistent storage).)), 2=Acsy (2 = Acsy (Valid user identification detected in or around the car. Certain accessory functionalities in the car may be active / operational (e.g. radio).)), 8=IgnOnPost (8 = IgnOnPost (Transient state: might be used to prepare for going to idle state (e.g. by storing persistent data to persistent storage).)), 3=IgnOn (3 = IgnOn (Ignition is on. Most power consumers may be at least temporarily active / operational; engine is not running.)), 5=EngRunng (5 = EngRunng (Ignition is on and combustion engine is running.)), 7=CrkPre (7 = CrkPre (Transient state: cranking is about to begin. State might be used to prepare for cranking (high power consumers might be switched off) and possible low power situation (e.g. by storing persistent data to persistent storage).)), 4=Crk (4 = Crk (Start of engine. Power consumers might be switched off. )), 15=Invld (15 = Invld (invalid mode))  # Operation Mode Status
  compu method OperModSts1: 10=PrepIdle (10 = PrepIdle (Transient state: might be used to prepare for going to idle state.)), 0=Idle (0 = Idle (No valid user identification detected; car is waiting for valid identification. Most systems should be in power-save mode. Only functionalities that do not require a valid identification may be active / operational (e.g. hazard warning, burglar alarm, Id detection mechanisms, parking light).)), 6=PrepIdn (6 = PrepIdn (Transient state: components / functionalities involved in identification should be operational (may include overall system consistency checks to ensure that the system was not tampered during idle state etc.). State might be used to prepare for IdAprvd if start-up time is needed.)), 1=IdAprvd (1 = IdAprvd (Valid user identification detected in or around the car. Certain body functionalities may be active / operational (e.g. locking / unlocking of doors, (de-)activation of burglar alarm).)), 9=AcsyPost (9 = AcsyPost (Transient state: might be used to prepare for going to idle state (e.g. by storing persistent data to persistent storage).)), 2=Acsy (2 = Acsy (Valid user identification detected in or around the car. Certain accessory functionalities in the car may be active / operational (e.g. radio).)), 8=IgnOnPost (8 = IgnOnPost (Transient state: might be used to prepare for going to idle state (e.g. by storing persistent data to persistent storage).)), 3=IgnOn (3 = IgnOn (Ignition is on. Most power consumers may be at least temporarily active / operational; engine is not running.)), 5=EngRunng (5 = EngRunng (Ignition is on and combustion engine is running.)), 7=CrkPre (7 = CrkPre (Transient state: cranking is about to begin. State might be used to prepare for cranking (high power consumers might be switched off) and possible low power situation (e.g. by storing persistent data to persistent storage).)), 4=Crk (4 = Crk (Start of engine. Power consumers might be switched off. )), 15=Invld (15 = Invld (invalid mode))  # Operation Mode Status
  compu method OutdBriSt1: 0=Ukwn (0 = Ukwn (E.g. (temporary) no sensor information available)), 1=Night (1 = Night), 2=Twli1 (2 = Twli1), 3=Twli2 (3 = Twli2), 4=Twli3 (4 = Twli3), 5=Twli4 (5 = Twli4), 6=Day (6 = Day), 7=Invld (7 = Invld (E.g. sensor signalizes defect))  # Outside Brightness Status
  compu method OutdBriSts1: 0=Ukwn (0 = Ukwn (E.g. (temporary) no sensor information available)), 1=Night (1 = Night), 2=Twli1 (2 = Twli1), 3=Twli2 (3 = Twli2), 4=Twli3 (4 = Twli3), 5=Twli4 (5 = Twli4), 6=Day (6 = Day), 7=Invld (7 = Invld (E.g. sensor signalizes defect))  # Outside Brightness Status
  compu method OvrdnSt1: 0=NotOvrdn (0 = NotOvrdn (Not overridden)), 1=Ovrdn (1 = Ovrdn (Overridden))  # Overridden Status
  compu method OvrdnSts1: 0=NotOvrdn (0 = NotOvrdn (Not overridden)), 1=Ovrdn (1 = Ovrdn (Overridden))  # Overridden Status
  compu method P1: raw=phys*128 for phys 0..10; unit Bar  # Pressure 1 | Generic data type for pressure
  compu method P4: raw=phys*0.2 for phys 0..1275; unit HectoPa  # Pressure 4 | Generic data type for pressure
  compu method P5: raw=phys/16384 for phys -536870912..536854528; unit Pa  # Pressure 5 | Generic data type for high pressure | Examples for usage: fuel pressure
  compu method P6: raw=phys/32 for phys -1048576..1048544; unit Pa  # Pressure 6 | Generic data type for low pressure | Examples for usage: ambient air pressure, particulate filter differential pressure
  compu method PaIdentcl: identical; unit Pa  # Pascal Identical
  compu method Perc1: raw=phys*256 for phys 0..100; unit Perc  # Percent 1 | Generic data type for percent
  compu method Perc10: raw=phys*100 for phys -327.68..327.67; unit Perc  # Percent 10 | Generic data type for percent | Examples for usage: common solenoid actuator (EGR), Pedal
  compu method Perc2: raw=phys*2 for phys 0..100; unit Perc  # Percent 2 | Generic data type for percent
  compu method Perc6: raw=phys for phys -128..127; unit Perc  # Percent 6 | Generic data type for percent
  compu method Perc7: raw=phys*10 for phys 0..1001; unit Perc  # Percent 7 | Generic data type for percent
  compu method Perc8: raw=phys*3225.806452+16129.03226 for phys -5..15; unit Perc  # Percent 8 | Generic data type for percent
  compu method Perc9: raw=phys*10 for phys 0..100.1; unit Perc  # Percent 9 | Generic data type for percent
  compu method PercGrdt1: raw=phys*16 for phys -1000..1000; unit PercPerSec  # Percent Gradient 1 | Generic data type for percent gradient
  compu method PercIdentcl: identical; unit Perc  # Percent Identical
  compu method PercLnr1: raw=phys*0.01220703125 for phys -100..100; unit Perc  # Percent Linear 1 | Generic computation method for percent having a power-of-2 resolution
  compu method PercPerSecIdentcl: identical; unit PercPerSec  # Percent per Second Identical
  compu method PitchovrMod1: 0=NoPitchovr (0 = NoPitchovr), 1=PitchovrFwd (1 = PitchovrFwd), 2=PitchovrBackw (2 = PitchovrBackw)  # Vehicle Pitchover Mode
  compu method PrkgLiIndcn1: 0=Off (0 = Off), 1=Le (1 = Le), 2=Ri (2 = Ri), 3=LeAndRi (3 = LeAndRi (Positioning light))  # Parking Light Indication
  compu method ProfPenSt1: 0=NoProf (0 = NoProf (no defined profile)), 1=Prof1 (1 = Prof1), 2=Prof2 (2 = Prof2), 3=Prof3 (3 = Prof3), 4=Prof4 (4 = Prof4), 5=Prof5 (5 = Prof5), 6=Prof6 (6 = Prof6), 7=Prof7 (7 = Prof7), 8=Prof8 (8 = Prof8), 9=Prof9 (9 = Prof9), 10=Prof10 (10 = Prof10), 11=Prof11 (11 = Prof11), 12=Prof12 (12 = Prof12), 13=Prof13 (13 = Prof13), 14=Prof14 (14 = Prof14), 15=Prof15 (15 = Prof15)  # Driver Profile
  compu method ProfPenSts1: 0=NoProf (0 = NoProf (no defined profile)), 1=Prof1 (1 = Prof1), 2=Prof2 (2 = Prof2), 3=Prof3 (3 = Prof3), 4=Prof4 (4 = Prof4), 5=Prof5 (5 = Prof5), 6=Prof6 (6 = Prof6), 7=Prof7 (7 = Prof7), 8=Prof8 (8 = Prof8), 9=Prof9 (9 = Prof9), 10=Prof10 (10 = Prof10), 11=Prof11 (11 = Prof11), 12=Prof12 (12 = Prof12), 13=Prof13 (13 = Prof13), 14=Prof14 (14 = Prof14), 15=Prof15 (15 = Prof15)  # Driver Profile
  compu method PsdNotPsd1: 0=NotPsd (0 = NotPsd), 1=Psd (1 = Psd)  # Pressed Not Pressed
  compu method PtIntvModTqCluFastReqTyp1: 0=NoRestrctn (0 = NoRestrctn (no restriction)), 1=IgnAgAndCylCutOff (1 = IgnAgAndCylCutOff (ignition angle and cylinder cut-off)), 2=IgnAg (2 = IgnAg (ignition angle)), 3=IgnAgAndAir (3 = IgnAgAndAir (ignition angle and air)), 4=Air (4 = Air (air)), 5=CylCutOff (5 = CylCutOff (cylinder cut-off)), 6=CylCutOffAndAir (6 = CylCutOffAndAir (cylinder cut-off and air))  # Powertrain Torque Clutch Fast Intervention Mode Type 1
  compu method PtTqCluMaxFastIntvModTyp1: 0=NoRestrctn (0 = NoRestrctn (no restriction)), 1=IgnAgAndCylCutOff (1 = IgnAgAndCylCutOff (ignition angle and cylinder cut-off)), 2=IgnAg (2 = IgnAg (ignition angle)), 3=CylCutOff (3 = CylCutOff (cylinder cut-off))  # Powertrain Torque Clutch Max Fast Intervention Mode Type 1
  compu method PullAidCmd1: 0=Off (0 = Off), 1=Open (1 = Open), 2=Cls (2 = Cls)  # Pull Aid Command
  compu method RadIdentcl: identical; unit Rad  # Radian Identical
  compu method RadPerSecIdentcl: identical; unit RadPerSec  # Radian per Second Identical
  compu method RadPerSecSqdIdentcl: identical; unit RadPerSecSqd  # Radian per Second Squared Identical
  compu method RainSenSnvty1: 0=RainSenSnvtyImps (0 = RainSenSnvtyImps), 1=RainSenSnvty1 (1 = RainSenSnvty1), 2=RainSenSnvty2 (2 = RainSenSnvty2), 3=RainSenSnvty3 (3 = RainSenSnvty3), 4=RainSenSnvty4 (4 = RainSenSnvty4), 5=RainSenSnvty5 (5 = RainSenSnvty5), 6=RainSenSnvty6 (6 = RainSenSnvty6), 7=RainSenSnvty7 (7 = RainSenSnvty7)  # Rain Sensing Sensitivity
  compu method Ramp1: 0=NoRamp (0 = NoRamp), 1=Ramp1 (1 = Ramp1), 2=Ramp2 (2 = Ramp2), 3=Ramp3 (3 = Ramp3), 4=Ramp4 (4 = Ramp4), 5=Ramp5 (5 = Ramp5), 6=Ramp6 (6 = Ramp6), 7=Ramp7 (7 = Ramp7)
  compu method ReqSt1: 0=NotReqd (0 = NotReqd (Not requested.)), 1=Reqd (1 = Reqd (Requested.))  # Request Status 1
  compu method ReqSt2: 0=Reqd (0 = Reqd (Requested.)), 1=NotReqd (1 = NotReqd (Not requested.))  # Request Status 2
  compu method ReqSts1: 0=NotReqd (0 = NotReqd (Not requested.)), 1=Reqd (1 = Reqd (Requested.))  # Request Status 1
  compu method ReqSts2: 0=Reqd (0 = Reqd (Requested.)), 1=NotReqd (1 = NotReqd (Not requested.))  # Request Status 2
  compu method RoadSt1: 0=Std (0 = Std), 1=Degraded (1 = Degraded)  # Road Status
  compu method RoadSts1: 0=Std (0 = Std), 1=Degraded (1 = Degraded)  # Road Status
  compu method RollovrMod1: 0=NoLoop (0 = NoLoop), 1=LoopRi (1 = LoopRi), 2=LoopLe (2 = LoopLe)  # Vehicle Rollover Mode
  compu method RpmIdentcl: identical; unit Rpm  # Rpm Identical
  compu method RpmLnr1: raw=phys*2 for phys -16384..16383.5; unit Rpm  # Rotational Speed Linear 1 | Generic data type for rotational speed
  compu method RpmPerSecIdentcl: identical; unit RpmPerSec  # Revolutions per minute per Second Identical
  compu method SeatBltRmnWarnSt1: 0=NoWarn (0 = NoWarn (no warning at all)), 1=ActvWarnAtStandStill (1 = ActvWarnAtStandStill (at least one detected occupant not buckled at stand still (e.g. regular at US))), 2=ActvWarnIni (2 = ActvWarnIni (warn state, optional for EURO-NCAP)), 3=ActvWarnInter (3 = ActvWarnInter (warn state, optional for EURO-NCAP)), 4=ActvWarnFinal (4 = ActvWarnFinal (warn state, minimum for EURO-NCAP))  # Seat Belt Reminder Warning State
  compu method Sec1: raw=phys for phys 0..59  # Second 1 | It represents the value of a second in one minute
  compu method SecIdentcl: identical; unit Sec  # Second Identical
  compu method Spd1: raw=phys*256 for phys 0..125; unit MtrPerSec  # Speed 1 | Generic data type for speed
  compu method Spd2: raw=phys*256 for phys -50..50; unit MtrPerSec  # Speed 2 | Generic data type for speed
  compu method Spd3: raw=phys*4 for phys 0..125; unit MtrPerSec  # Speed 3 | Generic data type for speed
  compu method Spd4: raw=phys*32 for phys 0..125; unit MtrPerSec  # Speed 4 | Generic data type for speed
  compu method Spd5: raw=phys*255.9922015 for phys -128..128; unit MtrPerSec  # Speed 5 | Generic data type for speed
  compu method Spd6: raw=phys*255.9922015 for phys -30..30; unit MtrPerSec  # Speed 6 | Generic data type for speed
  compu method SprgCoeff1: raw=phys for phys -150000..150000; unit NwtPerMtr  # Spring Coefficient 1 | Generic data type for spring coefficient
  compu method StOfObjMeasd1: 0=NoObj (0 = NoObj (Object does not exist.)), 1=ObjNew (1 = ObjNew (Object measured first time.)), 2=ObjNotMeasd (2 = ObjNotMeasd (Object not measured, but tracked.)), 3=ObjMeasd (3 = ObjMeasd (Object measured.))  # Status of Object Measured 1
  compu method StabrSt1: 0=On (0 = On (Stabilizer is on (active), e. g. hydraulically coupled and controlled. On-forces could be higher than coupled forces.)), 1=Opend (1 = Opend (Stabilizer is opened (decoupled), hydraulically shortcut no (low) forces.)), 2=Clsd (2 = Clsd (Stabilizer is closed (coupled). Almost like standard stabilizers.)), 3=Off (3 = Off (Hydraulically coupled with control off. )), 4=Flt (4 = Flt (Fault status.))  # Stabilizer Status
  compu method StabrSts1: 0=On (0 = On (Stabilizer is on (active), e. g. hydraulically coupled and controlled. On-forces could be higher than coupled forces.)), 1=Opend (1 = Opend (Stabilizer is opened (decoupled), hydraulically shortcut no (low) forces.)), 2=Clsd (2 = Clsd (Stabilizer is closed (coupled). Almost like standard stabilizers.)), 3=Off (3 = Off (Hydraulically coupled with control off. )), 4=Flt (4 = Flt (Fault status.))  # Stabilizer Status
  compu method SteerMod1: 0=SteerModStd (0 = SteerModStd (Standard mode.)), 1=SteerModCmft (1 = SteerModCmft (Comfort mode.)), 2=SteerModSpt (2 = SteerModSpt (Sport mode.)), 3=SteerModOffroad (3 = SteerModOffroad (Off-road mode.)), 4=SteerModAllWthr (4 = SteerModAllWthr (All weather mode.))  # Steering Mode 1
  compu method SteerVehStabyCtrlMod1: 0=SteerVehStabyCtrlModStd (0 = SteerVehStabyCtrlModStd (Standard mode.)), 1=SteerVehStabyCtrlModSpt (1 = SteerVehStabyCtrlModSpt (Sport mode.))  # Steering Vehicle Stability Control Mode 1
  compu method StgOfSeatClima1: 0=NoClima (0 = NoClima (no climatization)), 1=Cold1 (1 = Cold1 (cold_1 )), 2=Cold2 (2 = Cold2 (cold_2 )), 3=Cold3 (3 = Cold3 (cold_3 )), 4=Heat1 (4 = Heat1 (heat_1 )), 5=Heat2 (5 = Heat2 (heat_2 )), 6=Heat3 (6 = Heat3 (heat_3))  # Seat Clima Stage
  compu method StsOfObjMeasd1: 0=NoObj (0 = NoObj (Object does not exist.)), 1=ObjNew (1 = ObjNew (Object measured first time.)), 2=ObjNotMeasd (2 = ObjNotMeasd (Object not measured, but tracked.)), 3=ObjMeasd (3 = ObjMeasd (Object measured.))  # Status of Object Measured 1
  compu method SuspMod1: 0=SuspModStd (0 = SuspModStd (Standard (default) suspension tuning mode (e.g. stabilizer, damper, switchable spring, active suspension).)), 1=SuspModCmft (1 = SuspModCmft (Suspension tuning mode "Comfort".)), 2=SuspModSpt (2 = SuspModSpt (Suspension tuning mode "Sport".)), 3=SuspModOffroad (3 = SuspModOffroad (Suspension tuning mode "Offroad".))  # Suspension Mode 1
  compu method T1: raw=phys*2 for phys -70..125; unit DegCgrd  # Temperature 1 | Generic data type for temperature
  compu method T3: raw=phys+50 for phys -50..200; unit DegCgrd  # Temperature 3 | Generic data type for temperature
  compu method T4: raw=phys+40 for phys -40..213; unit DegCgrd  # Temperature 4 | Generic data type for temperature
  compu method T5: raw=phys*10 for phys -3276.8..3276.7; unit KelvinAbslt  # Temperature 5 | Generic data type for temperature | Examples for usage: glow plugs temperature, oil temperature, environment temperature, temperature differences
  compu method TSt1: 0=Norm (0 = Norm (normal temperature )), 1=Ovrheatd (1 = Ovrheatd (overheated))  # Temperature Status
  compu method TSts1: 0=Norm (0 = Norm (normal temperature )), 1=Ovrheatd (1 = Ovrheatd (overheated))  # Temperature Status
  compu method TerminalPosnMod1: 0=Off (0 = Off (Key position & power mode: Off)), 1=Acsy (1 = Acsy (Key position & power mode: Accessory)), 2=IgnOn (2 = IgnOn (Key position & power mode: IgnitionOn)), 3=Strt (3 = Strt (Key position & power mode: Start))  # Terminal Position Mode
  compu method Ti2: raw=phys*10 for phys 0..3.1; unit Sec  # Time 2 | Generic data type for time
  compu method Ti3: raw=phys*1000 for phys 0..65.535; unit Sec  # Time 3 | Generic data type for time
  compu method Ti4: raw=phys*4000000 for phys 0..0.01638375; unit Sec  # Time 4 | Generic data type for time
  compu method TirePMonWarnSt1: 0=NoPLoss (0 = NoPLoss (No Pressure lost, normal operation.)), 1=PLoss (1 = PLoss (Pressure lost, able to warn.))  # TPMS Warning Status 1
  compu method TirePMonWarnSt2: 0=NoPLoss (0 = NoPLoss (No Pressure lost, normal operation.)), 1=SoftWarn (1 = SoftWarn (Pressure lost, able to warn softly (e.g. yellow lamp).)), 2=HardWarn (2 = HardWarn (Pressure lost, able to warn hard (e.g. red lamp).)), 3=FastLossWarn (3 = FastLossWarn (Warning due to fast pressure lost (e.g. red lamp blinking).)), 4=SigNotAvl (4 = SigNotAvl (The pressure signal is currently not available (e.g. due to a temporary error like bad HF transmission).)), 5=WaitForPVal (5 = WaitForPVal (The system is currently waiting to receive pressure values.))  # TPMS Warning Status 2
  compu method TirePMonWarnSt3: 0=SpdMaxNotExcdd (0 = SpdMaxNotExcdd (Maximum allowed speed not exceeded.)), 1=SpdMaxExcdd (1 = SpdMaxExcdd (Maximum allowed speed exceeded.)), 2=SpdMaxExcddAtPAct (2 = SpdMaxExcddAtPAct (Maximum allowed speed exceeded at actual pressure.))  # TPMS Warning Status 3
  compu method TirePMonWarnSts1: 0=NoPLoss (0 = NoPLoss (No Pressure lost, normal operation.)), 1=PLoss (1 = PLoss (Pressure lost, able to warn.))  # TPMS Warning Status 1
  compu method TirePMonWarnSts2: 0=NoPLoss (0 = NoPLoss (No Pressure lost, normal operation.)), 1=SoftWarn (1 = SoftWarn (Pressure lost, able to warn softly (e.g. yellow lamp).)), 2=HardWarn (2 = HardWarn (Pressure lost, able to warn hard (e.g. red lamp).)), 3=FastLossWarn (3 = FastLossWarn (Warning due to fast pressure lost (e.g. red lamp blinking).)), 4=SigNotAvl (4 = SigNotAvl (The pressure signal is currently not available (e.g. due to a temporary error like bad HF transmission).)), 5=WaitForPVal (5 = WaitForPVal (The system is currently waiting to receive pressure values.))  # TPMS Warning Status 2
  compu method TirePMonWarnSts3: 0=SpdMaxNotExcdd (0 = SpdMaxNotExcdd (Maximum allowed speed not exceeded.)), 1=SpdMaxExcdd (1 = SpdMaxExcdd (Maximum allowed speed exceeded.)), 2=SpdMaxExcddAtPAct (2 = SpdMaxExcddAtPAct (Maximum allowed speed exceeded at actual pressure.))  # TPMS Warning Status 3
  compu method Tq1: raw=phys*256 for phys -30..30; unit NwtMtr  # Torque 1 | Generic data type for torque
  compu method Tq10: raw=phys for phys 0..20000; unit NwtMtr  # Torque 10 | Generic data type for torque
  compu method Tq12: raw=phys for phys 0..60000; unit NwtMtr  # Torque 12 | Generic data type for torque
  compu method Tq13: raw=phys for phys -10000..10000; unit NwtMtr  # Torque 13 | Generic data type for torque | Examples for usage: Differential Torques
  compu method Tq14: raw=phys for phys 0..10000; unit NwtMtr  # Torque 14 | Generic data type for torque
  compu method Tq15: raw=phys*255.7544757 for phys -10..10; unit NwtMtr  # Torque 15 | Generic data type for torque
  compu method Tq16: raw=phys-2048 for phys -2048..2045; unit NwtMtr  # Torque 16 | Generic torque compumethod
  compu method Tq2: raw=phys for phys -20000..20000; unit NwtMtr  # Torque 2 | Generic data type for torque
  compu method Tq3: raw=phys*0.25 for phys 0..20000; unit NwtMtr  # Torque 3 | Generic data type for torque
  compu method Tq4: raw=phys*0.25 for phys 0..80000; unit NwtMtr  # Torque 4 | Generic data type for torque
  compu method Tq5: raw=phys*16 for phys -2048..2047.9375; unit NwtMtr  # Torque 5 | Generic data type for torque | Examples for usage: torque at clutch and torque at crankshaft signals
  compu method Tq6: raw=phys*16 for phys -2048..0; unit NwtMtr  # Torque 6 | Generic data type for torque
  compu method Tq7: raw=phys*16 for phys -131072..131071.9375; unit NwtMtr  # Torque 7 | Generic data type for torque | Examples for usage: torque at wheels signals
  compu method TqGrdt1: raw=phys*0.0625 for phys 0..1000000; unit NwtMtrPerSec  # Torque Gradient 1 | Generic data type for torque gradient
  compu method TrsmIntvModReqForTqCluReqForShiftIntvTyp1: 0=NoRestrctn (0 = NoRestrctn (no restriction)), 1=IgnAgAndCylCutOff (1 = IgnAgAndCylCutOff (ignition angle and cylinder cut-off)), 2=IgnAg (2 = IgnAg (ignition angle)), 3=IgnAgAndAir (3 = IgnAgAndAir (ignition angle and air)), 4=Air (4 = Air (air)), 5=CylCutOff (5 = CylCutOff (cylinder cut-off)), 6=CylCutOffAndAir (6 = CylCutOffAndAir (cylinder cut-off and air))  # Transmission Torque Clutch Request for Fast Intervention Mode Type 1
  compu method TrsmPosnGearLvr1: 0=Neut (0 = Neut (neutral position)), 1=Prkg (1 = Prkg (parking position)), 2=Rvs (2 = Rvs (reverse gear position)), 3=Drv (3 = Drv (driving position)), 4=Spt (4 = Spt (sportive position)), 5=Drv1 (5 = Drv1 (driving position gear 1)), 6=Drv2 (6 = Drv2 (driving position gear 2)), 7=Drv3 (7 = Drv3 (driving position gear 3))  # Transmission Position Gear Lever
  compu method TrsmPwrSt1: 0=Open (0 = Open (open)), 1=OpenTouch (1 = OpenTouch (open touch)), 2=SlipCtrld (2 = SlipCtrld (slip controlled)), 3=SlipMicro (3 = SlipMicro (slip micro)), 4=Clsd (4 = Clsd (closed)), 5=NotDetrm (5 = NotDetrm (not determined)), 6=Hyddyn (6 = Hyddyn (hydrodynamic))
  compu method TrsmPwrStCtrl1: 0=Open (0 = Open (open)), 1=OpenTouch (1 = OpenTouch (open touch)), 2=Cdng (2 = Cdng (conditioning)), 3=TqCtrld (3 = TqCtrld (torque controlled)), 4=SlipCtrld (4 = SlipCtrld (slip controlled)), 5=SlipMicro (5 = SlipMicro (slip micro)), 6=Clsd (6 = Clsd (closed)), 7=NotDetrm (7 = NotDetrm (not determined)), 8=Hyddyn (8 = Hyddyn (hydrodynamic))  # Control State of Power Transmission
  compu method TrsmTqReqMaxMinTyp1: 0=Abslt (0 = Abslt (absolute)), 1=Rel (1 = Rel (relative))  # Transmission Torque Request Max Min Type 1
  compu method TrsmTqReqTyp1: 0=NoReq (0 = NoReq (no request)), 1=AbsltMin (1 = AbsltMin (absolute minimum)), 2=AbsltMax (2 = AbsltMax (absolute maximum)), 3=AbsltExact (3 = AbsltExact (absolute exact)), 4=Rel (4 = Rel (relative)), 5=NotUsed5 (5 = NotUsed5 (not used)), 6=NotUsed6 (6 = NotUsed6 (not used)), 7=NotUsed7 (7 = NotUsed7 (not used))  # Transmission Torque Requested Type 1
  compu method TrsmTqReqTyp2: 0=NoReq (0 = NoReq (no request)), 1=AbsltMax (1 = AbsltMax (absolute maximum)), 2=AbsltMin (2 = AbsltMin (absolute minimum)), 3=AbsltExact (3 = AbsltExact (absolute exact)), 4=Rel (4 = Rel (relative))  # Transmission Torque Requested Type 2
  compu method TrsmTyp1: 0=Mt (0 = Mt (manual transmission)), 1=At (1 = At (automatic transmission)), 2=Amt (2 = Amt (direct shift/ automated Mt)), 3=Cvt (3 = Cvt (continuously variable transmission)), 4=Dct (4 = Dct (twin-clutch gearbox or dual or double clutch transmission (Dct)))  # Transmission Type
  compu method U1: raw=phys*10 for phys 0..25.2; unit Volt  # Voltage 1 | Generic data type for voltage
  compu method UsrReqForWipg1: 4=UsrReqForWipgSpdHi (4 = UsrReqForWipgSpdHi), 2=UsrReqForWipgIntl (2 = UsrReqForWipgIntl), 3=UsrReqForWipgSpdLo (3 = UsrReqForWipgSpdLo), 0=UsrReqForWipgOff (0 = UsrReqForWipgOff), 1=WipgStrikeSngReqByUsr (1 = WipgStrikeSngReqByUsr)  # User Request for Wiping
  compu method VehHldSt1: 0=NoVehHld (0 = NoVehHld (Vehicle not held.)), 1=VehHldByEsc (1 = VehHldByEsc (Vehicle held by Electronic Stability Controller (ESC).)), 2=VehHldByEpb (2 = VehHldByEpb (Vehicle held by Electric Parking Brake (EPB).))  # Vehicle Hold State 1
  compu method VehMod1: 0=PlaMod (0 = PlaMod (Plant/Factory Mode)), 1=SaleMod (1 = SaleMod (Sale/Show Room Mode)), 2=CustMod (2 = CustMod (Customer Mode))  # Vehicle Mode
  compu method VehMtnSt1: 0=RollgBackw (0 = RollgBackw (Rolling backwards.)), 1=StandStill (1 = StandStill (Standstill)), 2=RollgFwd (2 = RollgFwd (Rolling forwards)), 3=Ukwn (3 = Ukwn (Unknown))  # Vehicle Motion State 1
  compu method VoltIdentcl: identical; unit Volt  # Volt Identical
  compu method WhlRotlDirMeasd1: 0=Undefd (0 = Undefd (Status of wheel rotation "undefined".)), 1=StandStill (1 = StandStill (Status of wheel rotation "stand still".)), 2=Fwd (2 = Fwd (Status of wheel rotation "forward".)), 3=Backw (3 = Backw (Status of wheel rotation "backward".))  # Wheel Rotational Direction Measured 1
  compu method WhlRotlDirStd1: 0=Undefd (0 = Undefd (Status of wheel rotation "undefined".)), 1=StandStill (1 = StandStill (Status of wheel rotation "stand still".)), 2=Fwd (2 = Fwd (Status of wheel rotation "forward".)), 3=Backw (3 = Backw (Status of wheel rotation "backward".))  # Wheel Rotational Direction Standard 1
  compu method Wipg1: 1=WipgIntl1 (1 = WipgIntl1 (Interval wiping with longest interval time)), 2=WipgIntl2 (2 = WipgIntl2), 3=WipgIntl3 (3 = WipgIntl3), 4=WipgIntl4 (4 = WipgIntl4), 5=WipgIntl5 (5 = WipgIntl5), 6=WipgIntl6 (6 = WipgIntl6), 7=WipgIntl7 (7 = WipgIntl7 (Interval wiping with shortest interval time, but non-continuous wiping.)), 0=WipgOff (0 = WipgOff), 8=WipgSpd1 (8 = WipgSpd1 (Continuous wiping with lowest speed)), 9=WipgSpd2 (9 = WipgSpd2), 10=WipgSpd3 (10 = WipgSpd3), 11=WipgSpd4 (11 = WipgSpd4), 12=WipgSpd5 (12 = WipgSpd5), 13=WipgSpd6 (13 = WipgSpd6), 14=WipgSpd7 (14 = WipgSpd7), 15=WipgSpd8 (15 = WipgSpd8 (Continuous wiping with highest speed)), 16=WipgMod1 (16 = WipgMod1), 17=WipgMod2 (17 = WipgMod2)  # Wiping
  compu method WipgSpdIntl1: 0=WipgSpdIntlImps (0 = WipgSpdIntlImps), 1=WipgSpdIntl1 (1 = WipgSpdIntl1 (Interval wiping with longest interval time.)), 2=WipgSpdIntl2 (2 = WipgSpdIntl2), 3=WipgSpdIntl3 (3 = WipgSpdIntl3), 4=WipgSpdIntl4 (4 = WipgSpdIntl4), 5=WipgSpdIntl5 (5 = WipgSpdIntl5), 6=WipgSpdIntl6 (6 = WipgSpdIntl6), 7=WipgSpdIntl7 (7 = WipgSpdIntl7 (Interval wiping with shortest interval time, but non-continuous wiping.))  # Wiping Speed Interval
  compu method WiprPosnMeasd1: 5=WiprPosnMeasdForPosnInter (5 = WiprPosnMeasdForPosnInter (intermediate position)), 1=WiprPosnMeasdForPosnLowrRvs (1 = WiprPosnMeasdForPosnLowrRvs (Lower direction change position)), 0=WiprPosnMeasdForPrkg (0 = WiprPosnMeasdForPrkg (Long time parking position)), 3=WiprPosnMeasdForSrv (3 = WiprPosnMeasdForSrv (Position to replace wiper blade)), 2=WiprPosnMeasdForPosnUpprRvs (2 = WiprPosnMeasdForPosnUpprRvs (Upper direction change position)), 4=WiprPosnMeasdForPosnWntr (4 = WiprPosnMeasdForPosnWntr (Position to place freezing protection or sun protection on the windscreen))  # Wiper Position Measured
  compu method WiprPosnReqd1: 1=WiprPosnReqdForPosnLowrRvs (1 = WiprPosnReqdForPosnLowrRvs (Lower direction change position)), 0=WiprPosnReqdForPrkg (0 = WiprPosnReqdForPrkg (Long time parking position)), 3=WiprPosnReqdForSrv (3 = WiprPosnReqdForSrv (Position to replace wiper blade)), 2=WiprPosnReqdForPosnUpprRvs (2 = WiprPosnReqdForPosnUpprRvs (Upper direction change position)), 4=WiprPosnReqdForPosnWntr (4 = WiprPosnReqdForPosnWntr (Position to place freezing protection or sun protection on the windscreen))  # Wiper Position Requested
  compu method WshrFldLvlLo1: 2=WshrFldEmpty (2 = WshrFldEmpty (Pump protection)), 0=WshrFldEngh (0 = WshrFldEngh (above threshold)), 1=WshrFldLvlLo (1 = WshrFldLvlLo (below threshold; Hmi information; ))  # Washer Fluid Level Low
  compu method Yr1: raw=phys for phys 0..99  # Year 1 | It represents the value of a year in a century
