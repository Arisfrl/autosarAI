AUTOSAR XML (schema 00054)
package /AUTOSAR_AISpecification/Units
  34 x unit:
    Ampr: display-name=A, factor-si-to-unit=1.0, offset-si-to-unit=0.0, physical-dimension=I1  # Ampere
    Bar: display-name=bar, factor-si-to-unit=1.0E-5, physical-dimension=LenNeg1M1TiNeg2  # pressure, no SI unit; 1 bar = 100,000 Pascal (Pa)
    DegCgrd: display-name=degC, factor-si-to-unit=1.0, offset-si-to-unit=-273.15, physical-dimension=T1  # Degree Centigrade | temperature, no SI unit, (degC = K - 273.15)
    HectoPa: display-name=hPa, factor-si-to-unit=0.01, physical-dimension=LenNeg1M1TiNeg2  # Hecto Pascal | SI derived unit of pressure with prefix | It is equivalent to one Newton per square meter. In everyday life, the Pascal is perhaps best known from meteorological air-pressure reports, where it occurs in the form of hecto Pascal (1 hPa = 100 Pa).
    Hz: display-name=Hz, factor-si-to-unit=1.0, physical-dimension=TiNeg1  # Hertz | SI derived unit of frequency
    Kelvin: display-name=K, factor-si-to-unit=1.0, physical-dimension=T1  # SI base unit of thermodynamic temperature (absolute temperature)
    KelvinAbslt: display-name=K, factor-si-to-unit=1.0, offset-si-to-unit=0.0, physical-dimension=T1  # Kelvin (Absolute Temperature)
    KelvinRel: display-name=K, factor-si-to-unit=1.0, physical-dimension=T1_1  # Kelvin Relative | SI base Unit for temperature differences (relative temperature)
    KiloGr: display-name=kg, factor-si-to-unit=1.0, physical-dimension=M1  # Kilo Gram | SI base unit of mass
    KiloHz: display-name=kHz, factor-si-to-unit=0.001, physical-dimension=TiNeg1  # Kilo Hertz | SI derived unit of frequency with prefix
    KiloMtr: display-name=km, factor-si-to-unit=0.001, physical-dimension=Len1  # Kilo Meter | SI base unit of length with prefix
    MolPerMtrCubd: display-name=mol/(m^3), factor-si-to-unit=1.0, offset-si-to-unit=0.0, physical-dimension=LenNeg3Amnt1  # Mole Per Cubic Meter
    Mtr: display-name=m, factor-si-to-unit=1.0, physical-dimension=Len1  # Meter | SI base unit of length
    MtrPerSec: display-name=m/s, factor-si-to-unit=1.0, physical-dimension=Len1TiNeg1  # Meter per Second | SI derived unit of velocity
    MtrPerSecCubd: display-name=m/s^3, factor-si-to-unit=1.0, physical-dimension=Len1TiNeg3  # Meter per Second Cubed | jerk (derived from SI units), also called jolt (esp. in British English), surge or lurch, is the rate of change of acceleration; more precisely, the derivative of acceleration with respect to time, the second derivative of velocity, or the third derivative of displacement.
    MtrPerSecSqd: display-name=m/s^2, factor-si-to-unit=1.0, physical-dimension=Len1TiNeg2  # Meter per Second Squared | SI derived unit of acceleration
    MtrRecpr: display-name=1/m, factor-si-to-unit=1.0, physical-dimension=LenNeg1  # Meter Reciprocal | SI derived unit of wave number for electromagnetic fields or curvature as reciprocal of curve radius
    NoUnit: display-name=-, factor-si-to-unit=1.0, physical-dimension=NoDimension  # No Unit | Unit for dimensionless continuous value data types like numbers, factors and coefficients
    Nwt: display-name=N, factor-si-to-unit=1.0, physical-dimension=Len1M1TiNeg2  # Newton | SI derived unit of force
    NwtMtr: display-name=Nm, factor-si-to-unit=1.0, physical-dimension=Len2M1TiNeg2  # Newton Meter | SI derived unit of moment of force (torque = kg m^2/s^2)
    NwtMtrPerSec: display-name=Nm/s, factor-si-to-unit=1.0, physical-dimension=Len2M1TiNeg3  # Newton Meter per Second | SI derived unit of time-derivative of torque
    NwtPerMtr: display-name=N/m, factor-si-to-unit=1.0, physical-dimension=M1TiNeg2  # Newton per Meter | surface tension (derived from SI units)
    NwtSecPerMtr: display-name=Ns/m, factor-si-to-unit=1.0, physical-dimension=M1TiNeg1  # Newton Second per Meter | damping factor or coefficient (derived from SI units)
    Pa: display-name=Pa, factor-si-to-unit=1.0, physical-dimension=LenNeg1M1TiNeg2  # Pascal | SI derived unit of pressure | The Pascal (symbol: Pa) is the SI derived unit of pressure or stress (also: Young's modulus and tensile strength). It is equivalent to one Newton per square meter. In everyday life, the Pascal is perhaps best known from meteorological air-pressure reports.
    Perc: display-name=%, factor-si-to-unit=100.0, physical-dimension=NoDimension_1  # Percent | a percentage is a way of expressing a number as a fraction of 100 (no SI unit).
    PercPerSec: display-name=%/s, factor-si-to-unit=100.0, physical-dimension=TiNeg1_1  # Percent per Second | time-derivative of percent
    PerMtr: display-name=1/m, factor-si-to-unit=1.0, offset-si-to-unit=0.0, physical-dimension=LenNeg1  # Per Meter
    Rad: display-name=rad, factor-si-to-unit=1.0, physical-dimension=NoDimension_2  # Radian | SI derived unit of plane angle (dimensionless)
    RadPerSec: display-name=rad/s, factor-si-to-unit=1.0, physical-dimension=TiNeg1_2  # Radian per Second | SI derived unit of angular velocity
    RadPerSecSqd: display-name=rad/s^2, factor-si-to-unit=1.0, physical-dimension=TiNeg2  # Radian per Second Squared | SI derived unit of angular acceleration
    Rpm: display-name=rpm, factor-si-to-unit=60.0, physical-dimension=TiNeg1_2  # revolutions per minute - no SI unit
    RpmPerSec: display-name=rpm/s, factor-si-to-unit=60.0, physical-dimension=TiNeg2  # Revolutions per minute per Second | time-derivative of revolutions per minute - no SI unit
    Sec: display-name=s, factor-si-to-unit=1.0, physical-dimension=Ti1  # Second | SI base unit of time
    Volt: display-name=V, factor-si-to-unit=1.0, physical-dimension=Len2M1TiNeg3INeg1  # SI derived unit of electric potential difference
