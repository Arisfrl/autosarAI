[part 1 of 2: package /AUTOSAR_AISpecification/PortInterfaces]
AUTOSAR XML (schema 00054)
package /AUTOSAR_AISpecification/PortInterfaces
  691 x sender receiver interface:
    AArbnRes1  # Acceleration Arbitration Result 1 | Feedback from Vehicle Longitudinal Control to driver assistant systems (e.g. Adaptive Cruise Control) and other systems: information about which acceleration value is output from arbitration of Vehicle Longitudinal Control.
      data AArbnRes: type=A1
    ACenForOccptPedSfty1  # Acceleration Central for Occupant Pedestrian Safety | High-g acceleration, measured in center by different acceleration measurement sensors
      data A: type=A8
    ACenForOccptPedSfty2  # Acceleration Central for Occupant Pedestrian Safety | High-g acceleration, measured in center by different acceleration measurement sensors
      data A: type=A13
    AExtForOccptPedSfty1  # Acceleration External for Occupant Pedestrian Safety | High-g acceleration, measured by different acceleration measurement satellite sensors
      data A: type=A9
    AExtForOccptPedSfty2  # Acceleration External for Occupant Pedestrian Safety | High-g acceleration, measured by different acceleration measurement satellite sensors
      data A: type=A14
    ALat1  # Acceleration Lateral 1 | Generic interface for Lateral acceleration
      data ALat: type=A4
    ALgt1  # Acceleration Longitudinal 1 | Generic interface for Longitudinal acceleration
      data ALgt: type=A4
    ALgt2  # Acceleration Longitudinal 2 | Control value for acceleration control. This value has to be calculated also when SW-C "Follow control and acceleration arbitration" is not in control, i.e. also in driver override situations.
      data AConsol: type=A1
    ALoForOccptPedSfty1  # Acceleration Low Range Central for Occupant Pedestrian Safety | Low-Range-g acceleration, measured in center by different acceleration measurement sensors
      data A: type=A11
    AMidForOccptPedSfty1  # Acceleration Middle Range Central for Occupant Pedestrian Safety | Mid-Range-g acceleration, measured in center by different acceleration measurement sensors
      data A: type=A12
    AbsCtrlActvForWhl1  # ABS Control Active for Wheel | Antilock Braking System (ABS) control is active (e.g. information for Roll Stability System (RSC)).
      data AbsCtrlActvForWhl  # 0 = Wheel is not in Antilock Braking System (ABS) control, 1 = Wheel is in Antilock Braking System (ABS) control
    AbsCtrlIndcn1  # ABS Control Indication | Antilock braking system (ABS) control active for other domains (e.g. for Human Machine Interface (HMI))
      data AbsCtrlIndcn: type=DevSt4
    AbsCtrlIntvg1  # ABS Control Intervening 1 | Antilock braking system (ABS) control is active (at least one wheel)
      data AbsCtrlIntvg: type=CtrlSt1  # 0 = No wheel has Antilock Braking System (ABS) intervening 1 = At least one wheel has Antilock Braking System (ABS) intervening
    AcTq1  # Actual Mechanical Torque for A/C Compressor | Actual mechanical torque for Air Conditioning (A/C) compressor
    AcTqReq1  # Requested Mechanical Torque for A/C Compressor | Requested mechanical torque for Air Conditioning (A/C) compressor. This value represents the torque consumption in a predicted future state. It is converted to engine crankshaft torque by the provider. Examples of realization: Before activation of the Air Conditioning (A/C) compressor this interface could contain either - the predicted highest torque consumption during the activation process. - the predicted torque consumption in steady state after the activation is finished. | Default value after reset is zero.
    AccActv1  # Adaptive Cruise Control Active 1 | Switch operated by driver to set Adaptive Cruise Control stand-by mode on.
      data St: type=OnOff1  # 0: off 1: on
    AccCtrlActv1  # Adaptive Cruise Control Control Active 1 | Adaptive Cruise Control is engaged and active. This information is used for display feedback for driver as well.
      data AccCtrlActv: type=DevSt4
    AccVehDetd1  # Adaptive Cruise Control Vehicle Detected 1 | Target vehicle for Adaptive Cruise Control is detected. This information is used for display feedback for driver.
      data St: type=DetnSt1  # 0: not detected 1: detected
    AccrPedlGrdt1  # Accelerator Pedal Gradient | time-derivative of the position of the accelerator pedal
    AccrPedlMeasd1  # Accelerator Pedal Measured Value | Position of the accelerator pedal, not "estimated" value. Evaluated signal jitter free without time filtering, including plausibility check, monitoring and replacement value. 0% is driver off the pedal, offsets are removed. 100% must be ensured at end point of the pedal. Shall cover the 100% as well. REMARK: signal is sent with initialisation
      data AccrPedlMeasd: type=Perc1
    AccrPedlRat1  # Accelerator Pedal Ratio | Position of the accelerator pedal, not "simulated" value for e.g. Adaptive Cruise Control (ACC) driver. Evaluated signal jitter free without time filtering, including plausibility check, monitoring and replacement value. 0% is driver off the pedal, offsets are removed. 100% must be ensured at end point of the pedal. Shall cover the 100% as well | signal is sent with initialisation
      data AccrPedlRat: type=Perc1
    AccrPedlRatFild1  # Filtered Accelerator Pedal Ratio | shaped / time filtered value based on accelerator pedal ratio. (e.g. PT1 with calibratable time constant) Calibration shall make it sure that the signal range is 0 - 100%. 0% is driver off the pedal, offsets are removed. 100% must be ensured at end point of the pedal. Shall cover the 100% as well;
      data AccrPedlRatFild: type=Perc1
    AccrPedlRatGrdt1  # Accelerator Pedal Ratio Gradient | time-derivative of the position of the accelerator pedal
      data AccrPedlRatGrdt: type=PercGrdt1
    ActrBodyLvlSt1  # Actuator Body Level Status 1 | Status provided by body level actuator system
      data ActrBodyLvlSt: type=DevSt4
    ActrBodyLvlSts1  # Actuator Body Level Status 1 | Status provided by body level actuator system
      data ActrBodyLvlSts: type=DevSts4
    ActrTqDbnd1  # Actuator Torque Deadband 1 | Generic interface for minimum and maximum increase of the requested torque (relative to the current actual value) which will lead to a change in the current torque
      data Uppr: type=Tq3  # upper value
      data Lowr: type=Tq3  # lower value
    ActrYawCpbyExt1  # Actuator Yaw Capability External | Indicates yaw torque capability of the external yaw rate controller using additional actuators (steering, suspension, ...)
      data ActrYawCpbyExt: type=Tq2
    ActvSuspMod1  # Active Suspension Mode 1 | Full active suspension tuning mode displayed to the driver and provided to other systems
      data ActvSuspMod: type=SuspMod1
    ActvSuspSt1  # Active Suspension Status 1 | Status provided by full active suspension system.
      data ActvSuspSt: type=DevSt4
    ActvSuspSts1  # Active Suspension Status 1 | Status provided by full active suspension system.
      data ActvSuspSts: type=DevSts4
    ActvnOfActrForOccptPedSfty1  # Activation of Actuator for Occupant Pedestrian Safety | Request to activate actuators of pedestrian protection or occupant restraint system
      data Actvt: type=ReqSt1  # 0: keep actuator in position (normal operation mode) 1: activate actuator for protection position
    ActvtWipgAutReq1  # Activate Wiping Automatic Request | Represents user's demand to activate/ deactivate automatic front wiping. Supersedes off and interval modes of normal Wiping Request. As long as automatic front wiping is requested, the value is on.
      data Req: type=OnOff1
    AlrmAcoustCmd1  # Alarm Acoustic Command | request to start/stop alarm sequence by audible device like alarm horn/vehicle horn/Battery backed sounder (BBS)
      data Cmd: type=OnOff1  # OFF - acoustic alarm not requested ON - acoustic alarm requested
    AlrmSt1  # Alarm Status | Alarm global status
      data St: type=AlrmSt1
    AlrmSts1  # Alarm Status | Alarm global status
      data Sts: type=AlrmSts1
    AlrmVisCmd1  # Visual Alarm Command | Visual alarm activation request
      data Cmd: type=OnOff1  # OFF - visual alarm not requested ON - visual alarm requested
    AltTq1  # Alternator Load | Consolidated Alternator Load | This value must take into account all relevant dynamic effects. It is converted to engine crankshaft torque by the provider.Default value after reset is zero.
      data AltTq: type=Tq6
    AltTqReq1  # Requested Mechanical Torque for Alternator (Generator) at Engine Crank Shaft | Requested mechanical load for alternator (generator) at engine crank shaft.
      data AltTqReq: type=Tq6
    AntithftPasSt1  # Key Authentification Status | Status of Passive Antitheft System (PATS) - Immobilizer - key identification
      data St: type=DevSt6
    AntithftPasSts1  # Key Authentification Status | Status of Passive Antitheft System (PATS) - Immobilizer - key identification
      data Sts: type=DevSts6
    Authn1  # Authorization | Generic interface for authorization request or status | It contains the immobilizer identifier, the engine identifier or the fob identifier for its validation.
      data AuthnData
    BattU1  # Battery Voltage | This interface provides the actual voltage level as measured at the battery.
      data BattU: type=U1
    BltLockChgInfo1  # Belt Lock Change Information | Information of belt lock changed
      data Info: type=ChgInfo1  # 0: state of belt locks not changed 1: state of belt lock changed
    BltLockSt1  # Belt Lock State | Belt lock state for seat position
      data BltLockSt: type=BltLockSt1
    BmpT1  # Bumper Temperature | Temperature measured at/in bumper
      data T: type=T3
    BodyLvlCtrl1  # Body Level Control 1 | Activity of the body level control
      data BodyLvlCtrl: type=BodyLvlCtrl1
    BodyLvlMod1  # Body Level Mode 1 | Actual body level displayed to the driver and provided to other systems
      data BodyLvlMod: type=BodyLvlMod1
    BodyLvlModReq1  # Requested Body Level Mode | Height level request by the driver from suspension system/-s
      data BodyLvlModReq: type=BodyLvlMod1
    BodyPitchAg1  # Body Pitch Angle 1 | Generic interface for body pitch angle
      data BodyPitchAg: type=Ag1
    BodyRollAg1  # Body Roll Angle 1 | Generic interface for body roll angle
      data BodyRollAg: type=Ag1
    BodyRollAg2  # Body Roll Angle 2 | Generic interface for body roll angle
      data BodyRollAg: type=Ag2
    BriReq1  # Brightness Request | Requests the brightness of a light source or the control panel. The percentage value (independent of light actuator type and environment e.g. voltage of electrical system) depends on the functionality that the light source shall be switched on for. | 100 percent means full power of the light actuator. Invalid is chosen for emergency illumination in case of jammed network.
      data Req: type=Perc2
    BrkActrFailrForBrkOnDmd1  # Brake Actuator Failure for Brake on Demand 1 | Brake actuator failure status with respect to brake-on-demand functions
      data BrkActrFailrForBrkOnDmd: type=DevErrSt2  # 0: no failure 1: failure
    BrkActrIntvg1  # Brake Actuator Intervening 1 | Brake actuator is used to slow down the vehicle (either due to brake pedal being applied or external brake request, e.g. from Adaptive Cruise Control (ACC))
      data BrkActrIntvg: type=OnOff1  # 0: off 1: on
    BrkActrMod1  # Brake Actuator Mode 1 | Brake actuator action or status, with regards to parking brake functionality.
      data BrkActrMod: type=BrkActrMod1
    BrkActrOvrheatd1  # Brake Actuator Overheated 1 | One flag indicating that temperature of at least one actuator component is high, e.g. valves overheated. If this flag is set the actuator is in a critical condition. The external function, e.g. Roll Stability Controller can decide whether to use the brake or not.
      data BrkActrOvrheatd: type=TSt1  # 0: normal brake temperature 1: brake overheated
    BrkActrSatn1  # Brake Actuator Saturation 1 | Brake actuator saturation status. This is a not wheel individual but global information.
      data BrkActrSatn: type=BrkActrSatn1  # 0:No saturation 1:Saturation due to actuator limitation
    BrkAssiReq1  # Brake Assist Request 1 | Indicates that the brake system should modify its brake assist mode for hazard situations.
      data BrkAssiReq: type=ReqSt1  # 0: no brake assist request 1: brake assist request
    BrkLiInten1  # Brake Light Intensity 1 | Requested intensity of brake lights.
      data BrkLiInten: type=Perc2  # 0: no brake light activation 100: full intensity
    BrkLiOnReq1  # Brake Light On Request 1 | Request to illuminate brake lights. | Electronic Stability Control (ESC) intervention does not illuminate brake lights (e.g. active booster).
      data BrkLiOnReq: type=ReqSt1  # 0: brake lights off 1: if brake lights are to be illuminated (driver braking or active controlled deceleration (e.g. Adaptive Cruise Control brakes slowly));
    BrkModReq1  # Brake Mode Request 1 | Indicates whether the brake request is comfort or safety related.
      data BrkReqMod: type=BrkMod1  # 0 : comfort relevant 1 : safety relevant
    BrkPedlOvrd1  # Brake Pedal Override 1 | Information that driver overrides SW-C "Follow control and acceleration arbitration" with brake pedal as a result of brake torque arbitration
      data BrkPedlOvrd: type=OvrdnSt1  # 0: no override 1: override
    BrkPedlPsd1  # Brake Pedal Pressed 1 | Information that the brake pedal is pressed. | When other brake system elements (an active booster for example) are in use, a combination of the state of the brake light switch (on) and the brake hydraulic pressure (above a threshold) do not necessarily indicate that the brake pedal is pressed.
      data BrkPedlPsd: type=PsdNotPsd1  # 0: not pressed 1: pressed
    BrkPedlVal1  # Brake Pedal Value 1 | position of the brake pedal physical lower limit: no pedal activation physical upper limit: full pedal stroke
      data BrkPedlVal: type=Perc1  # 0 to 100 %
    BrkPrevn1  # Brake Prevention 1 | Request to avoid braking, e.g. for Adaptive Cruise Control and Vehicle Longitudinal Control. Request includes aspects from traffic point of view. Final decision remains in the actuator control. | Allowed acceleration offset has higher priority than this request.
      data BrkPrevn: type=ReqSt1  # 0: No request 1: Inhibit brake
    BrkRdyReq1  # Brake Ready Request 1 | Indicates that the brake system has to be prepared for braking (e.g. air gap elimination)
      data BrkRdyReq: type=ReqSt1  # 0: no brake ready request 1: brake ready request
    BrkReqTyp1  # Brake Request Type 1 | Type of vehicle deceleration force requested by e.g. Stand Still Manager to Electric Parking Brake.
      data BrkReqTyp: type=BrkReqTyp1
    BrkReqTyp2  # Brake Request Type 2 | Type of vehicle deceleration force requested by e.g. Stand Still Manager to Electronic Stability Control
      data BrkReqTyp: type=BrkReqTyp2
    BrkTracCtrlIntvg1  # Brake Traction Control Intervening 1 | Brake traction control intervention status. True if intervening at at least one wheel.
      data BrkTracCtrlIntvg: type=CtrlSt1  # 0 = Traction Control is off or Traction Control does not use the brakes 1 = At least one wheel has traction brake control intervening
    BrkYawCtrlIntvgPerWhl1  # Brake Yaw Control Intervening for Wheel | Wheel with yaw stability brake control intervention. Wheel individual. (E.g. information for Roll Stability Control (Rsc) and Suspension (Susp))
      data BrkYawCtrlIntvgPerWhl  # 0 = No brake intervention from yaw control 1 = Wheel has yaw stability brake control intervening
    BtnMplSt256  # Multi State Button 256 States | user input to system: Information which of the 256 states of the user interface device (button, switch, knob, slider, ...) is selected
      data St: type=Nr2
    BtnMplSt4  # Multi State Button 4 States | user input to system: Information which of the four states of the user interface device (button, switch, knob, slider, ...) is selected
      data St: type=Nr7
    BtnMplSt8  # Multi State Button 8 States | user input to system: Information which of the eight states of the user interface device (button, switch, knob, slider, ...) is selected
      data St: type=Nr5
    BtnSimple1  # Button Simple | user input to system: Information if the button was pressed or not pressed.
      data St: type=PsdNotPsd1
    BypSlipCtrlReq1  # Bypass Slip Control Request 1 | Request from Roll Stability Control (RSC) only to inhibit internal Electronic Stability Control (ESC) slip control. | To be able to brake beyond pressure corresponding to slip control (e.g. for wheel lift detection).
      data BypSlipCtrlReqPerWhl  # 0 = Slip Control shall not be bypassed 1 = Slip Control shall be bypassed
    CarFindrReq1  # Car Finder Request | Demand to activate / deactivate car finder functionality. The request can be set e.g. manually by the user or via user settings in the Man Machine Interface (MMI).
      data Req: type=OnOff1
    CarHeiSt1  # Car Height Status | Information on the height of the vehicle
      data St: type=Perc2  # value greater than 100% means invalid; initial value = value greater than 100%
    CarHeiSts1  # Car Height Status | Information on the height of the vehicle
      data Sts: type=Perc2  # value greater than 100% means invalid; initial value = value greater than 100%
    ChdProtnCmd1  # Child Protection Command | This is the functional command to the actuator component to execute activation or deactivation of child lock.
      data Cmd: type=ChdProtnCmd1
    ChdProtnSt1  # Child Protection Status | Status if child protection is activated or not.
      data Cmd: type=OnOff1
    ChdProtnSts1  # Child Protection Status | Status if child protection is activated or not.
      data Cmd: type=OnOff1
    ChimerCmd1  # Chimer Command | Command to turn On/Off the chimer in the cluster. The type of the chimer sequence is up to the driver implementation in the cluster.
      data Cmd: type=OnOff1  # OFF - chimer driver activation not requested ON - chimer driver activation requested.
    CluPedlRat1  # Clutch Pedal Ratio | Position of the clutch pedal | Evaluated signal jitter free without time filtering, plausibility check, monitored, including replacement value. 0% is driver off the pedal, offsets are removed. 100% must be ensured at end point of the pedal. Shall cover the 100% as well;signal is sent with initialisation
      data CluPedlRat: type=Perc1
    CmdForSnsr1  # Command for Sensor | Command for the sensor adapters
      data Cmd
    CogPosn1  # Cog Position | Center of gravity relative to the center of front axle referring to ISO standard.
      data CogPosn: type=Len5
    CogPosnEstimd1  # Cog Position Estimated | Estimation of the center of gravity relative to the center of front axle referring to ISO standard.
      data CogPosnEstimd: type=Len5
    CornrMkrReq1  # Corner Marker Request | Request to activate the corner markers.
      data Req: type=CornrMkr1
    CrashSev1  # Crash Severity | Crash severity - calculated (after t0 = time of first contact of involved objects in crash situations) or estimated (before t0) | Each algorithm must be able to provide the maximum '100%', even if only binary decision is possible.
      data Sev: type=Perc2  # 0% means no crash (default) 100% means maximum detectable crash severity (e.g. in case of binary detectable severity 100% is to give in case of detected crash) | increasing crash severity results in increasing value
    CrashSt1  # Crash Status | This interface provides the actual crash status pre-crash and post-crash
      data St: type=CrashSt1
    CrashSts1  # Crash Status | This interface provides the actual crash status pre-crash and post-crash
      data Sts: type=CrashSts1
    CrashYpos1  # Crash Ypos | Y position of crash event - measured or estimated
      data Locn: type=Perc6  # -100%: most right hand side of vehicle front 0%: geometric middle front position 100%: most left hand side of vehicle front
    CrsCtrlActv1  # Cruise Control Active 1 | Switch operated by driver to set stand-by mode of Cruise Control to on.
      data St: type=OnOff1  # 0: off 1: on
    CrsCtrlAndAccDrvrOvrd1  # Cruise Control and Adaptive Cruise Control Driver Override 1 | Adaptive Cruise Control or Cruise Control is overridden by driver.
      data St: type=OvrdnSt1  # 0: not overridden 1: overridden
    CrsCtrlAndAccSwtStEngd1  # Cruise Control and Adaptive Cruise Control Switch Status Engaged 1 | Status of the switch to engage, disengage, or resume Adaptive Cruise Control or Cruise Control.
      data CrsCtrlAndAccSwtStEngd: type=CrsCtrlAndAccSwtSt1
    CrsCtrlAndAccSwtStsEngd1  # Cruise Control and Adaptive Cruise Control Switch Status Engaged 1 | Status of the switch to engage, disengage, or resume Adaptive Cruise Control or Cruise Control.
      data CrsCtrlAndAccSwtStsEngd: type=CrsCtrlAndAccSwtSts1
    CrsCtrlAndAccVehSpdLgt1  # Cruise Control and Adaptive Cruise Control Vehicle Longitudinal Speed 1 | Based on vehicle longitudinal speed. Filtered for Cruise Control or Adaptive Cruise Control specific purpose.
      data CrsCtrlAndAccVehSpdLgt: type=Spd1
    CrsCtrlCtrlActv1  # Cruise Control Control Active | Cruise Control is engaged and active. This information is used for display feedback for driver as well.
      data CrsCtrlCtrlActv: type=DevSt4
    CtrlOfActrForOccptPedSfty1  # Control of Actuator for Occupant Pedestrian Safety | Special adjustment control interface for occupant and pedestrian safety actuators, e.g. belt load limiters at predefined force levels or airbag inflation control based on volume or stiffness target values
      data Ppty: type=Perc2  # - 0% means lowest possible control property of actuator - 100% means highest possible control property of actuator
    CtrlOvrdnByRsc1  # Control Overridden by RSC 1 | Generic interface for a control of a system that is overridden by Roll Stability Control (RSC)
      data CtrlOvrdnByRsc
    DamprCtrlMod1  # Damper Control Mode 1 | Damper tuning mode displayed to the driver
      data DamprCtrlMod: type=SuspMod1
    DamprCtrlTunReq1  # Requested Damper Control Tuning | Damper control tuning mode request by the driver
      data DamprCtrlTunReq: type=SuspMod1
    DamprSt1  # Damper Status 1 | Status provided by the semi-active or switchable damper
      data DamprSt: type=DevSt4
    DamprSts1  # Damper Status 1 | Status provided by the semi-active or switchable damper
      data DamprSts: type=DevSts4
    DefrstReq1  # Defrost Request | Request for Defrost activation
      data Req: type=OnOff1
    DefrstSt1  # Defrost Status | Status of Defrost (Actuator or Telltale)
      data St: type=OnOff1
    DefrstSts1  # Defrost Status | Status of Defrost (Actuator or Telltale)
      data Sts: type=OnOff1
    DftlCoorrSt1  # Differential Coordinator Status 1 | Status of a differential Coordinator
      data DftlCoorrSt: type=DevErrSt3
    DftlCoorrSts1  # Differential Coordinator Status 1 | Status of a differential Coordinator
      data DftlCoorrSts: type=DevErrSts3
    DftlTqReq1  # Diiferential Torque Request 1 | Requested Torque at a Differential | Sign convention: positive to the right or front or from faster to slower shaft depending on the available device.
      data DftlTqReq: type=Tq13
    DispBltLockAck1  # Display Belt Lock Acknowledge | Acknowledge of driver for switch off belt lock state display
      data Ack: type=ReqSt1  # 0: keep display request unchanged according to its internal rules 1: user has acknowledged the belt state display
    DispBltLockReq1  # Display Belt Lock Request | Request to display the belt lock state of seats not under occupant detection control
      data Req: type=ReqSt1  # 0: switch off display 1: switch on display
    DispBltLockSt1  # Display Belt Lock State | Belt lock state of seat position to display (position not under control of occupant detection)
      data St: type=BltLockSt2  # belt lock state to display
    DispBucdStOfOccpt1  # Display Buckled State of Occupant | Buckled state of occupant (under control of occupant detection) at seat position to display
      data St: type=BucdSt1  # buckled state of seat position
    DispDfct1  # Display Defect | Display an error on Human Machine Interface (HMI)
      data Disp: type=OnOff1
    DispPaseDfct1  # Display Passive Entry Defect | Display of number of Passive Entry (PASE) defects
      data DispPaseDfct: type=Nr2
    DispRainSnsr1  # Display Rain Sensor | Informs driver, if rain sensor is currently active.
      data DispRainSnsr: type=OnOff1
    DoorHndlSenSt1  # Door Handle Sensor Status | Information given by a touched sensor implemented on the door handle
      data St: type=DoorHndlSt1
    DoorHndlSenSts1  # Door Handle Sensor Status | Information given by a touched sensor implemented on the door handle
      data Sts: type=DoorHndlSts1
    DoorHndlSt1  # Door Handle Status | Information given by a pull detector implemented on the door handle
      data St: type=DoorHndlSt1
    DoorHndlSts1  # Door Handle Status | Information given by a pull detector implemented on the door handle
      data Sts: type=DoorHndlSts1
    DoorSt1  # Door Status | Provides information whether a door or a lid is open or closed. As long as the status is valid, the value should be provided.
      data St: type=DoorSt1
    DoorSts1  # Door Status | Provides information whether a door or a lid is open or closed. As long as the status is valid, the value should be provided.
      data Sts: type=DoorSts1
    DrvReqTqCluSlow1  # Driver Request of Clutch Torque (Slow Torque Path) | Torque at clutch requested by the driver to be generated by the powertrain (slow path).
      data DrvReqTqCluSlow: type=Tq5
    DrvReqTqWhlFast1  # Driver Request of Wheel Torque (Fast Torque Path) | Wheel torque (to all the driven wheels) requested by the driver to be generated by the powertrain.
      data DrvReqTqWhlFast: type=Tq7
    DrvReqTqWhlSlow1  # Driver Request of Wheel Torque (Slow Torque Path) | Anticipated wheel torque (to all the driven wheels) requested by the driver to be generated by the powertrain.
      data DrvReqTqWhlSlow: type=Tq7
    DrvgSide1  # Driving Side | Information on the position of the driver in the car. For instance, in England, the driver is on the right side of the car and in France or Germany the driver is on the left
      data St: type=LeRi1  # - Left Side - Right Side
    DrvrSteerTq1  # Driver Steering Torque 1 | Measured driver steer torque at the column (does not include the wheel inertia effect, some friction between the sensor and the steering wheel, the steering kinematics...) (includes pinion torque sensor for rack drive system and ONLY denotes the driver torque)
      data DrvrSteerTq: type=Tq1
    DstTrvld1  # Distance Travelled | Travelled distance since last engine start
      data Dst: type=Len6
    DtTqDistbnStIndcn1  # DTD Status Indication 1 | Indication of Drivetrain torque distribution functional status.
      data DtTqDistbnStIndcn: type=DevSt4
    DtTqDistbnStsIndcn1  # DTD Status Indication 1 | Indication of Drivetrain torque distribution functional status.
      data DtTqDistbnStsIndcn: type=DevSts4
    EgyMngtSt1  # Energy Management Status | This interface is used to optimize the energy available in the vehicle. This interface provides the information whether all, basic or only keep-alive components/functionalities are allowed to run.
      data St: type=EgyMngtSt1
    EgyMngtSts1  # Energy Management Status | This interface is used to optimize the energy available in the vehicle. This interface provides the information whether all, basic or only keep-alive components/functionalities are allowed to run.
      data Sts: type=EgyMngtSts1
    EmTqDynJ1  # Electric Machine Dynamic Moment of Inertia | Inertia torque of the electric machine at clutch level. Definition of the sign: Increasing speed creates a negative sign, decreasing speed creates a positive sign. | The signal contains the dynamic torque created by the inertia of the electric machine which, on parallel hybrid projects, increases or decreases the torque at clutch.
      data EmTqDynJ: type=Tq5  # Electric Machine Dynamic Moment of Inertia
    EngHoodSt1  # Engine Hood Status | Provides information whether the engine hood is open or closed. As long as the status is valid the corresponding value should be provided.
      data St: type=OpendClsd1
    EngHoodSts1  # Engine Hood Status | Provides information whether the engine hood is open or closed. As long as the status is valid the corresponding value should be provided.
      data Sts: type=OpendClsd1
    EngN1  # Engine Speed | The consolidated rotational speed of the engine crankshaft. | E.g. evaluated from a segment synchronous source.
      data EngN: type=N1
    EngNGearTar1  # Engine Speed at Target Gear | Used for Dual Clutch Transmission (DCT) to provide the transmission with a predicted engine torque. The transmission precalculates this speed.
      data EngNGearTar: type=N1
    EngNGrdt1  # Engine Speed Gradient | Actual Engine Speed Gradient
      data EngNGrdt: type=NGrdt1
    EngNMax1  # Maximum Permitted Engine Speed | Maximum permitted engine speed for engine protection, must not be exceeded by shifting | default value after reset: max value
      data EngNMax: type=N1
    EngNMin1  # Minimum Engine Speed Setpoint | Minimum engine speed from engine control point of view. | E.g. engine idle speed to be arbitrated by Powertrain Coordinator (PTC) with all other requested engine speeds (Air Conditioner (A/C), alternator, transmission, ...).Signal is sent with initialisation
      data EngNMin: type=N1
    EngPAmbAir1  # Engine Ambient Air Pressure | measured or model based ambient air pressure | signal is sent with initialisation
      data EngPAmbAir: type=P4
    EngRunngDirSt1  # Engine: Engine Running Direction State | Engine running direction state. | Rotation direction of the combustion engine. Used, for example, for engine stop/start systems. Sign of the engine running direction: If the vehicle is moving in the forward direction, and the drivetrain is closed, and a forward gear is engaged, then the engine running direction is positive. During initialization, the engine sends the value "0". 0 = undefined running direction, no direction information available 1 = positive running direction 2 = negative running direction 3 = invalid running direction due to error
      data EngRunngDirSt: type=EngRunngDir1  # Engine: Engine Running Direction State
    EngStrtRemReq1  # Remote Engine Start Request 1 | Information to start the engine from a remote control
      data EngStrtReq: type=EngStrtRemReq1
    EngT1  # Engine: Engine Temperature | Consolidated engine temperature. | For engines with water cooling systems, the signal shows the coolant temperature. Example for the accuracy requirement on this signal in a typical series project: ±5 K. The accuracy requirement is a „goal“. Project-specific requirements must be defined in close cooperation with transmission and engine engineering.
      data EngT: type=T4  # Engine: Engine Temperature
    EngTqCluMin1  # Minimum Engine Torque at Clutch | Minimum engine torque at clutch level of not fired engine at current engine speed. | Minimum engine torque at clutch considers following contributors if present 1) internal engine torque losses like friction, pumping, mechanical driven water pump etc. 2) losses with influence on torque at clutch caused by alternator, airconditioning, power steering etc. Loss differences from engine to engine and variable torque losses over life cycle have to be considered. Usually this signal corresponds to the drag torque of the combustion engine at current speed.
      data EngTqCluMin: type=Tq5  # Minimum Engine Torque at Clutch
    EngTqCluStrtPred1  # Engine: Predicted Clutch Torque to Start the Engine | Predicted torque necessary to start the combustion engine by slipstart. | This signal must be provided from engine start until a project-dependent combustion engine speed. The calculation of this signal must consider the influences on this start torque, for example: Additionally, from standstill until the first expansion stroke, the signal must include the predicted maximum torque that is necessary to overcome the first compression stroke. The calculation of this signal by the provider is not permitted to consider the inertia, which has an effect on the torque at clutch. This means that the signal must be calculated as if the inertia is 0 kg*(m^2). sticking friction and sliding friction, compression effects depending on crankshaft angle, auxiliaries and ancillaries/PTO, combustion engine temperature, coolant temperature.
      data EngTqCluStrtPred: type=Tq5  # Engine: Predicted Clutch Torque to Start the Engine
    EngTqCrksft1  # Engine: Torque at Crankshaft | Indicated torque of combustion engine plus internal engine torque losses. The effect of inertia on the torque is not considered. | Torque at crankshaft considers the following contributors, if present: 1) Indicated torque of combustion engine, calculated based on injection timing and injected fuel, ignition angle and air mass. 2) Internal engine torque losses such as friction, pumping, mechanically driven water pump, etc. Ancillary torque losses caused by the alternator, air conditioning, power steering, etc., are not considered. The calculation of this signal by the provider is not permitted to consider the inertia, which has an effect on the torque at clutch. This means that the signal must be calculated as if the inertia is 0 kg*(m^2). Loss differences from engine to engine and variable torque losses over the life cycle must be considered. The signal includes all torque requests from the accelerator pedal, cruise control, speed limiter, etc., and all interventions, e.g., torque and speed interventions. Example of implementation: The torque is a cylinder average, not a time average, via two crankshaft revolutions of all cylinders, in consideration of the current operating parameters. The operating parameters include the engine temperature, ignition timing and air mass measured or calculated, lambda, fuel cut level, fuel quantity, injection timing, knock control adaption, geographic altitude and others.
      data EngTqCrksft: type=Tq5  # Engine: Torque at Crankshaft
    EngTqCrksftMax1  # Maximum Available Engine Torque at Crankshaft | The maximum torque at crankshaft at the current engine speed and actual air mass (both gasoline and diesel), including the static power limitation of the engine (e.g. calibrated restrictions for engine protection) | Example of realization: The maximum torque is realized by fast and slow path [e.g. with the earliest possible ignition angle at current lambda (gasoline in homogeneous mode) or the maximum fuel mass and injection timing (diesel)] including average knocking (average of cylinders), smoke limitation.'''''' The signal is valid if the engine speed is higher than a certain engine speed threshold. This threshold depends on the engine (e.g. about 500 rpm for four cylinder engines). Below this limit the accuracy of this value may decrease significantly. For hybrid stop/start strategy the engine speed of the fired engine should always be above the speed threshold. Default value after reset is zero
      data EngTqCrksftMax: type=Tq5
    EngTqCrksftMaxEngNCur1  # Engine: Maximum Torque at Crankshaft at Current Engine Speed | Maximum possible torque at crankshaft at current speed with maximum possible air mass at current ambient pressure and air temperature, including static power limitation of the engine. | Theoretical full load engine torque at crankshaft at current engine speed. Maximally charged for turbo systems. The static power limitation contains, e.g., restrictions for protection and static soot limitation. Permanent knock limitation is considered, knock control is not considered.
      data EngTqCrksftMaxEngNCur: type=Tq5  # Engine: Maximum Torque at Crankshaft at Current Engine Speed
    EngTqCrksftMaxFast1  # Maximum Engine Torque at Crankshaft Fast Path | Maximum engine torque at crankshaft fast path including current engine speed, the actual air mass (both gasoline and diesel) and the static power limitation of the engine (e.g. calibrated restrictions for engine protection). This signal is relevant for torque requests realized by fast path. | Example of realization: The maximum torque is realized by fast path [e.g. with the earliest possible ignition angle at current lambda (gasoline in homogeneous mode) or the maximum fuel mass and optimum injection timing concerning torque (diesel)], including average knocking (average of cylinders), smoke limitation.
      data EngTqCrksftMaxFast: type=Tq5
    EngTqCrksftMaxOptmCdn1  # Maximum Engine Torque at Crankshaft at Optimum Conditions | The maximum torque at crankshaft at the current engine speed, maximum air mass, current ambient pressure and air temperature (both gasoline and diesel), including the static power limitation of the engine (e.g. calibrated restrictions for engine protection). It is calculated for ideal conditions. | Example of Realization: The maximum torque is realized by fast and slow path [e.g. with the earliest possible ignition angle at optimum lambda concerning torque (gasoline) or the maximum fuel mass and injection timing (diesel)]. Smoke limitation is included in the signal. Average knocking is not considered (without knock control), but the precalibrated knocking limitation.'''''' The signal is valid if the engine speed is higher than a certain engine speed threshold. This threshold depends on the engine (e.g. about 500 rpm for four cylinder engines). Below this limit the accuracy of this value may decrease significantly. For hybrid stop/start strategy the engine speed of the fired engine should always be above the speed threshold. Default value after reset is zero
      data EngTqCrksftMaxOptmCdn: type=Tq5
    EngTqCrksftMaxProtn1  # Maximum Allowed Torque at Crankshaft for Engine Protection | Maximum crankshaft torque including engine protection. If no protection function is active, the value of this interface will be the upper limit of the chosen data type. | Example of realization: Including catalyst protection, over heating, intake air system protection and fail safe etc.signal is sent with initialisation
      data EngTqCrksftMaxProtn: type=Tq5
    EngTqCrksftMaxSpdCur1  # Engine: Maximum Torque at Crankshaft at Current Speed | Maximum possible torque at crankshaft at current speed with maximum possible air mass at current ambient pressure and air temperature, including static power limitation of the engine. | Theoretical full load engine torque at crankshaft at actual engine speed. Maximally charged for turbo systems. Static power limitation contains e.g. restrictions for protection and static smoke limitation. Permanent knock limitation is considered, knock control not.
      data EngTqCrksftMaxSpdCur: type=Tq5  # Engine: Maximum Torque at Crankshaft at Current Speed
    EngTqCrksftMin1  # Engine: Minimum Engine Torque at Crankshaft Considering Engine Internal Torque Losses | Minimum engine torque at crankshaft level of not fired engine at current engine speed. | The minimum engine torque at crankshaft considers the internal engine torque losses such as friction, pumping, mechanically driven water pump, etc. Loss differences from engine to engine and variable torque losses over the life cycle must be considered. Usually, this signal corresponds to the drag torque of the combustion engine at current speed.
      data EngTqCrksftMin: type=Tq5  # Engine: Minimum Engine Torque at Crankshaft Considering Engine Internal Torque Losses
    EngTqCrksftMinBasc1  # Minimum Engine Torque at Crankshaft for Powertrain Realized by Slow Path | The minimum torque at crankshaft at the current engine speed and the minimum air mass (both gasoline and diesel) not including spark retard (gasoline) and fuel cut off. | Example of realization: The minimum torque is realized by slow path [e.g. normal ignition timing for the minimum mass air at current lambda (gasoline homogeneous) or the minimum fuel mass and injection timing (diesel)]. For diesel engines this interface is possibly equivalent to the torque losses, because minimum fuel mass could be zero. Otherwise minimum torque for fired engine.'''''' The signal is valid if the engine speed is higher than a certain engine speed threshold. This threshold depends on the engine (e.g. about 500 rpm for four cylinder engines). Below this limit the accuracy of this value may decrease significantly. For hybrid stop/start strategy the engine speed of the fired engine should always be above the speed threshold. Default value after reset is zero
      data EngTqCrksftMinBasc: type=Tq5
    EngTqCrksftMinFast1  # Engine: Minimum Torque at Crankshaft Fast Path | Minimum torque at crankshaft of combustion engine at latest possible ignition angle. Calculated at current engine speed with current air mass, current ambient pressure and current air temperature. | Signal is relevant for gasoline engines only. The latest possible ignition angle, also called "max. ignition retard", depends on exhaust temperature, catalyst protection, etc. A torque decrease request from the transmission down to this torque level should only be implemented by ignition retard and not by cylinder cut off. For diesel engines, this signal depends on the minimum fuel mass, which is usually zero. In parallel hybrid projects, this is the minimum torque the combustion engine can implement.
      data EngTqCrksftMinFast: type=Tq5  # Engine: Minimum Torque at Crankshaft Fast Path
    EngTqCrksftMinWoCutOff1  # Minimum Engine Torque at Crankshaft for Powertrain Realized by Slow and Fast Path | The minimum torque at crankshaft at the current engine speed and the minimum air mass (both gasoline and diesel) including spark retard (gasoline), not including fuel cut off. | Example of realization: The minimum torque is realized by slow and fast path [e.g. considering a certain spark retard for the minimum air mass at current lambda (gasoline homogeneous) or the minimum fuel mass and injection timing (diesel)]. The possible amount of spark retard can be defined depending on the application, e.g. according to drive ability criteria. For diesel engines this interface is possibly equivalent to the torque losses, because minimum fuel mass could be zero. Otherwise minimum torque for fired engine.'''''' cylinder engines). Below this limit the accuracy of this value may decrease significantly. The signal is valid if the engine speed is higher than a certain engine speed threshold. This threshold depends on the engine (e.g. about 500 rpm for four For hybrid stop/start strategy the engine speed of the fired engine should always be above the speed threshold. Default value after reset is zero
      data EngTqCrksftMinWoCutOff: type=Tq5
    EngTqCrksftRedByAncllryLoss1  # Engine: Torque at Crankshaft Reduced by Ancillary Losses | Torque at crankshaft reduced by ancillary losses. | Indicated engine torque calculated based on injection timing and injected fuel, ignition angle and air mass, plus 1) Internal engine torque losses such as friction, pumping, mechanically driven water pump, etc. 2) Ancillary torque losses with an effect on torque at crankshaft caused by i.a., alternator, air conditioning, power steering. The calculation of this signal by the provider is not permitted to consider the inertia, which has an effect on the torque at clutch. This means that the signal must be calculated as if the inertia is 0 kg*(m^2). In series, loss differences from engine to engine and variable torque losses over the life cycle must be considered.
      data EngTqCrksftRedByAncllryLoss: type=Tq5  # Engine: Torque at Crankshaft Reduced by Ancillary Losses
    EngTqCrksftRedByAncllryLossMin1  # Engine: Minimum Torque at Crankshaft Reduced by Ancillary Losses | Minimum engine torque at crankshaft of not fired engine at current engine speed decreased by ancillary losses. | The minimum engine torque at crankshaft considers the following contributors, if present: 1) Internal engine torque losses such as friction, pumping, mechanically driven water pump, etc. 2) Ancillary torque losses with an effect on torque at crankshaft caused by i.a., alternator, air conditioning, power steering. In series, loss differences from engine to engine and variable torque losses over the life cycle must be considered. Usually, this signal corresponds to the drag torque of the combustion engine at current speed. Example for timing and accuracy requirements in a typical series project: Max. 40 ms delay time, accuracy: ±7 % or ±5 Nm (max. selection), max. deviation ±20 Nm.
      data EngTqCrksftRedByAncllryLossMin: type=Tq5  # Engine: Minimum Torque at Crankshaft Reduced by Ancillary Losses
    EngTqDecAtCluReqByEscFast1  # Engine Torque Decrease at Clutch Request by ESC Fast | Decreased engine torque at clutch requested by Electronic stability control below the driver input torque including virtual driver request. Fast refers to the immediate / instant torque request, typically achieved by ignition timing.
      data EngTqDecAtCluReqByEscFast: type=Tq5
    EngTqDecAtCluReqByEscSlow1  # Engine Torque Decrease at Clutch Request by ESC Slow | Decreased engine torque at clutch requested by Electronic stability control below the driver input torque including virtual driver request. Slow refers to the longer term or torque reserve request, usually the input to throttle control.
      data EngTqDecAtCluReqByEscSlow: type=Tq5
    EngTqIncAtCluReqByEsc1  # Engine Torque Increase at Clutch Request by ESC | Increased engine torque at clutch requested by Electronic stability control over the driver input torque including virtual driver request.
      data EngTqIncAtCluReqByEsc: type=Tq5
    EngTqJCrksft1  # Engine: Engine Torque of Inertia at Crankshaft | Inertia torque of combustion engine at clutch level. Definition of the sign: An increasing speed produces a negative sign; a decreasing speed produces a positive sign. | The signal contains the dynamic torque caused by the inertia, which increases or decreases the torque at clutch. The engine internal inertia and the inertia of the ancillaries up to the clutch must be considered.
      data EngTqJCrksft: type=Tq5  # Engine: Engine Torque of Inertia at Crankshaft
    EngTqResvPt1  # Torque Reserve Request from Engine to Powertrain | Reserved torque request to be coordinated by the Powertrain Coordinator (PTC). This reserved torque could be realized either by the combustion engine or by another torque source (e.g. electric motor in a hybrid system). It does not include reserved torque requests which will be coordinated inside the combustion engine, e.g. torque reserve for catalyst heating or torque reserve to realize a change in the engine operation mode. | Default value after reset is zero
      data EngTqResvPt: type=Tq5
    EngTqResvReqPt1  # Torque Reserve Request from Engine to Powertrain | Reserved torque request to be coordinated by the Powertrain Coordinator (PTC). This reserved torque could be realized either by the combustion engine or by another torque source (e.g. electric motor in a hybrid system). It does not include reserved torque requests which will be coordinated inside the combustion engine, e.g. torque reserve for catalyst heating or torque reserve to realize a change in the engine operation mode. | Default value after reset is zero.
      data EngTqResvReqPt: type=Tq5
    EngTracCtrlIntvg1  # Engine Traction Control Intervening 1 | Traction control is intervening when a torque reduction at the wheels is requested. Traction control is not intervening when a torque reduction at the wheels is not requested.
      data EngTracCtrlIntvg: type=CtrlSt1  # 0: not intervening 1: intervening
    EntryReq1  # Entry Request | Request to move the seat to a certain position for easy-entry functionality.
      data Req: type=EntryEasy1
    EpbActrFltSt1  # EPB Actuator Fault Status 1 | Failure state of the parking brake actuators
      data EpbActrFltSt: type=DevErrSt2
    EpbActrFltSts1  # EPB Actuator Fault Status 1 | Failure state of the parking brake actuators
      data EpbActrFltSts: type=DevErrSts2
    EpbActrMod1  # EPB Actuator Mode 1 | Indication of the action executed by the parking brake actuator or its status.
      data EpbActrMod: type=BrkActrMod1
    EpbActrTq1  # EPB Actuator Torque 1 | Brake torque applied by Electric Parking Brake actuator, e.g. based on nominal brake parameters (e.g. constant pads friction) and (estimated or measured) brake clamp forces.
      data EpbActrTq: type=Tq4
    EpbActvn1  # EPB Activation | Activation or deactivation of the Electric Parking Brake
      data EpbActvn: type=DevSt4
    EpbBtnCtrlSt1  # EPB Button Control Status 1 | Status of Electric Parking Brake (EPB) control button. NOTE: Depending on implementation: - Case 1: push only type will use values 0,3,4 - Case 2: push/pull type will use values 0,1,2,4
      data EpbBtnCtrlSt: type=EpbBtnCtrlSt1
    EpbBtnCtrlSts1  # EPB Button Control Status 1 | Status of Electric Parking Brake (EPB) control button. NOTE: Depending on implementation: - Case 1: push only type will use values 0,3,4 - Case 2: push/pull type will use values 0,1,2,4
      data EpbBtnCtrlSts: type=EpbBtnCtrlSts1
    EpbDrvrActvnIndcn1  # EPB Driver Activation Indication | Indication to the cockpit (HMI) that the driver has applied/released the parking brake.
      data EpbDrvrActvnIndcn: type=DevSt4
    EscCtrlIndcn1  # ESC Control Indication | Electronic stability control (ESC) controller is intervening
      data EscCtrlIndcn: type=DevSt4
    EscReqPasMod1  # ESC Request Passive Mode 1 | Request to switch the Electronic Stability Control (ESC) system to a passive mode
      data EscReqPasMod: type=DevSt4
    EscSt1  # ESC Status 1 | Status of activation/ deactivation of Electronic Stability Control (ESC)
      data EscSt: type=DevSt7
    EscStIndcn1  # ESC Status Indication | Electronic stability control is turned on.
      data EscStIndcn: type=DevSt4
    EscSts1  # ESC Status 1 | Status of activation/ deactivation of Electronic Stability Control (ESC)
      data EscSts: type=DevSts7
    EscStsIndcn1  # ESC Status Indication | Electronic stability control is turned on.
      data EscStsIndcn: type=DevSts4
    ExtrLiBriCmd1  # Exterior Light Brightness Command | Brightness command for light actuators.
      data Cmd: type=Perc2
    ExtrLiDisp1  # Exterior Light Display | Provides the information whether a certain exterior light function is on or off. As long as the function is on (activated), the value "on" should be provided. This interface can be used e.g. to provide feedback to the driver via Man Machine Interface (MMI). This is considered as a status signal, which carries continuously a certain value as long as its semantic condition is present.
      data Disp: type=OnOff1
    FanSt1  # Fan State | Activation state of climatization or ventilation
      data FanSt: type=DevSt4
    FltStOfSeatClima1  # Fault Status of Seat Climatization | Fault information from seat climatization actuator
      data FltSt: type=DevErrSt2  # 0: Not Present; the seat climatization actuator is working properly with no fault 1: Present; the seat climatization actuator has a fault present and is not working properly
    FltStsOfSeatClima1  # Fault Status of Seat Climatization | Fault information from seat climatization actuator
      data FltSts: type=DevErrSts2  # 0: Not Present; the seat climatization actuator is working properly with no fault 1: Present; the seat climatization actuator has a fault present and is not working properly
    FricCoeff1  # Friction Coefficient | Used road friction coefficient
      data FricCoeff: type=FricCoeff1
    FricCoeffEstimd1  # Estimated Friction Coefficient | Estimated used road friction coefficient
      data FricCoeffEstimd: type=FricCoeff1
    GearParkReq1  # Gear Park Request 1 | Parking lock request from Stand Still Manager to automatic transmission to set parking position
      data GearParkReq: type=ReqSt1  # 0 : No request 1 : Request active
    GearShiftDwnReqFromDrvr1  # Driver Flag Gear Shift Down Request | Activation from gear lever or steering wheel to shift down (pushed = 1, not pushed = 0) This signal does not indicate that a gear shift is actually performed.
      data GearShiftDwnReqFromDrvr: type=PsdNotPsd1
    GearShiftPrevn1  # Gear Shift Prevention 1 | generic interface for gear shift prevention
      data GearShiftPrevn: type=GearShiftPrevn1
    GearShiftUpReqFromDrvr1  # Driver Flag Gear Shift Up Request | Activation from gear lever or steering wheel to shift up (pushed = 1, not pushed = 0). This signal does not indicate that a gear shift is actually performed.
      data GearShiftUpReqFromDrvr: type=PsdNotPsd1
    HldOnDmdSt1  # Hold on Demand Status 1 | Failure status of the Hold on Demand function
      data HldOnDmdSt: type=HldOnDmdSt1
    HldOnDmdSts1  # Hold on Demand Status 1 | Failure status of the Hold on Demand function
      data HldOnDmdSts: type=HldOnDmdSt1
    HmiBtn1  # Hmi Button | Button on Human Machine Interface (HMI) for activation
      data HmiBtn: type=OnOff1  # Activation/Deactivation
    HndbrkSwt1  # Handbrake Switch 1 | Binary information whether the handbrake is applied or not. Measured signal from the handbrake switch.
      data HndbrkSwt: type=OnOff1  # 0: not applied 1: applied
    HndlgBalCoeff1  # Handling Balance Coefficient 1 | (Estimated) handling balance coefficient defined as deviation from defined understeering characteristics. | Ranging from maximum applicable understeering to maximum applicable oversteering. (-100% understeering, 100% oversteering)
      data HndlgBalCoeff: type=Perc6
    HomeCmngAndHomeLvngReq1  # Home Coming and Home Leaving Request | Demand to activate/ deactivate coming home/ leaving home functionalities. The request can be set e.g. manually by the user or via user settings in the Man Machine Interface (MMI).
      data Req: type=HomeCmngAndHomeLvngReq1
    HoopRollCmd1  # Hoop Roll Command | Command for roll hoop
      data Cmd: type=OnOff1
    HoopRollSt1  # Hoop Roll Status | Status of roll hoop actuator
      data St: type=DevErrSt2
    HoopRollSts1  # Hoop Roll Status | Status of roll hoop actuator
      data Sts: type=DevErrSts2
    HornCmd1  # Horn Activation Command | Command to the horn actuator
      data Cmd: type=OnOff1
    HornReq1  # Horn Request | Request for horn
      data Req: type=OnOff1
    HornSt1  # Horn Status | Status of the horn actuator
      data St: type=DevErrSt2
    HornSts1  # Horn Status | Status of the horn actuator
      data Sts: type=DevErrSts2
    HtlModReq1  # Hotel Mode Request | User request to activate hotel mode of the central door locking system. This feature allows to keep just the driver door open, while the rest (including glove box to secure private goods) of the car is locked. "On" means hotel mode.
      data Req: type=OnOff1
    HtlModSt1  # Hotel Mode Status | Status if hotel mode is activated or not. "on" means hotel mode activated.
      data St: type=OnOff1
    HtlModSts1  # Hotel Mode Status | Status if hotel mode is activated or not. "on" means hotel mode activated.
      data Sts: type=OnOff1
    HumAirFilDsConsold1  # Consolidated Value for Air humidity downstream air filter | Air humidity downstream air filter: Consolidated physical value, either a measured value or a modeled value. | Finally filtered and offset corrected, consolidated value. Virtual physical sensor value that comes as close as possible to the technical signal. In case of inability to provide a physical sensor value (e.g. failure, implausibility or other reasons) a substitute value or a default value or a frozen value is provided.
      data HumAirFilDsConsold1: type=Perc11  # Consolidated Value for Air humidity downstream air filter | Air humidity downstream air filter: Consolidated physical value, either a measured value or a modeled value. | Finally filtered and offset corrected, consolidated value. Virtual physical sensor value that comes as close as possible to the technical signal. In case of inability to provide a physical sensor value (e.g. failure, implausibility or other reasons) a substitute value or a default value or a frozen value is provided.
    HumAirFilDsEstimd1  # Estimated Value of Air humidity downstream air filter | Air humidity downstream air filter: Modeled physical sensor value or standard sensor value. | The estimated value can be used as a replacement for the finally filtered and offset corrected physical sensor value.
      data HumAirFilDsEstimd1: type=Perc11  # Estimated Value of Air humidity downstream air filter | Air humidity downstream air filter: Modeled physical sensor value or standard sensor value. | The estimated value can be used as a replacement for the finally filtered and offset corrected physical sensor value.
    HumAirFilDsMeasd1  # Measured Value of Air humidity downstream air filter | Air humidity downstream air filter: Final filtered and offset corrected physical sensor value. | Physical sensor value/standard sensor value. The physical sensor value is the linearized and filtered physical raw sensor value including offset. At this step, a significant phase shift could be possible.
      data HumAirFilDsMeasd1: type=Perc11  # Measured Value of Air humidity downstream air filter | Air humidity downstream air filter: Final filtered and offset corrected physical sensor value. | Physical sensor value/standard sensor value. The physical sensor value is the linearized and filtered physical raw sensor value including offset. At this step, a significant phase shift could be possible.
    HumAirFilDsRaw1  # Raw Value of Air humidity downstream air filter | Air humidity downstream air filter: Physical raw sensor value. | Simple conversion of basic filtered electrical to physical value.
      data HumAirFilDsRaw1: type=Perc11  # Raw Value of Air humidity downstream air filter | Air humidity downstream air filter: Physical raw sensor value. | Simple conversion of basic filtered electrical to physical value.
    HumGasAndeUsConsold1  # Consolidated Value for Gas humidity at upstream of anode | Gas humidity at upstream of anode: Consolidated physical value, either a measured value or a modeled value. | Finally filtered and offset corrected, consolidated value. Virtual physical sensor value that comes as close as possible to the technical signal. In case of inability to provide a physical sensor value (e.g. failure, implausibility or other reasons) a substitute value or a default value or a frozen value is provided.
      data HumGasAndeUsConsold1: type=Perc11  # Consolidated Value for Gas humidity at upstream of anode | Gas humidity at upstream of anode: Consolidated physical value, either a measured value or a modeled value. | Finally filtered and offset corrected, consolidated value. Virtual physical sensor value that comes as close as possible to the technical signal. In case of inability to provide a physical sensor value (e.g. failure, implausibility or other reasons) a substitute value or a default value or a frozen value is provided.
    HumGasAndeUsEstimd1  # Estimated Value of Gas humidity at upstream of anode | Gas humidity at upstream of anode: Modeled physical sensor value or standard sensor value. | The estimated value can be used as a replacement for the finally filtered and offset corrected physical sensor value.
      data HumGasAndeUsEstimd1: type=Perc11  # Estimated Value of Gas humidity at upstream of anode | Gas humidity at upstream of anode: Modeled physical sensor value or standard sensor value. | The estimated value can be used as a replacement for the finally filtered and offset corrected physical sensor value.
    HumGasAndeUsMeasd1  # Measured Value of Gas humidity at upstream of anode | Gas humidity at upstream of anode: Final filtered and offset corrected physical sensor value. | Physical sensor value/standard sensor value. The physical sensor value is the linearized and filtered physical raw sensor value including offset. At this step, a significant phase shift could be possible.
      data HumGasAndeUsMeasd1: type=Perc11  # Measured Value of Gas humidity at upstream of anode | Gas humidity at upstream of anode: Final filtered and offset corrected physical sensor value. | Physical sensor value/standard sensor value. The physical sensor value is the linearized and filtered physical raw sensor value including offset. At this step, a significant phase shift could be possible.
    HumGasAndeUsRaw1  # Raw Value of Gas humidity at upstream of anode | Gas humidity at upstream of anode: Physical raw sensor value. | Simple conversion of basic filtered electrical to physical value.
      data HumGasAndeUsRaw1: type=Perc11  # Raw Value of Gas humidity at upstream of anode | Gas humidity at upstream of anode: Physical raw sensor value. | Simple conversion of basic filtered electrical to physical value.
    HumGasBypHumrCtdeUsConsold1  # Consolidated Value for Gas humidity at bypass of humidifer on cathode side | Gas humidity at bypass of humidifer on cathode side: Consolidated physical value, either a measured value or a modeled value. | Finally filtered and offset corrected, consolidated value. Virtual physical sensor value that comes as close as possible to the technical signal. In case of inability to provide a physical sensor value (e.g. failure, implausibility or other reasons) a substitute value or a default value or a frozen value is provided.
      data HumGasBypHumrCtdeUsConsold1: type=Perc11  # Consolidated Value for Gas humidity at bypass of humidifer on cathode side | Gas humidity at bypass of humidifer on cathode side: Consolidated physical value, either a measured value or a modeled value. | Finally filtered and offset corrected, consolidated value. Virtual physical sensor value that comes as close as possible to the technical signal. In case of inability to provide a physical sensor value (e.g. failure, implausibility or other reasons) a substitute value or a default value or a frozen value is provided.
    HumGasBypHumrCtdeUsEstimd1  # Estimated Value of Gas humidity at bypass of humidifer on cathode side | Gas humidity at bypass of humidifer on cathode side: Modeled physical sensor value or standard sensor value. | The estimated value can be used as a replacement for the finally filtered and offset corrected physical sensor value.
      data HumGasBypHumrCtdeUsEstimd1: type=Perc11  # Estimated Value of Gas humidity at bypass of humidifer on cathode side | Gas humidity at bypass of humidifer on cathode side: Modeled physical sensor value or standard sensor value. | The estimated value can be used as a replacement for the finally filtered and offset corrected physical sensor value.
    HumGasBypHumrCtdeUsMeasd1  # Measured Value of Gas humidity at bypass of humidifer on cathode side | Gas humidity at bypass of humidifer on cathode side: Final filtered and offset corrected physical sensor value. | Physical sensor value/standard sensor value. The physical sensor value is the linearized and filtered physical raw sensor value including offset. At this step, a significant phase shift could be possible.
      data HumGasBypHumrCtdeUsMeasd1: type=Perc11  # Measured Value of Gas humidity at bypass of humidifer on cathode side | Gas humidity at bypass of humidifer on cathode side: Final filtered and offset corrected physical sensor value. | Physical sensor value/standard sensor value. The physical sensor value is the linearized and filtered physical raw sensor value including offset. At this step, a significant phase shift could be possible.
    HumGasBypHumrCtdeUsRaw1  # Raw Value of Gas humidity at bypass of humidifer on cathode side | Gas humidity at bypass of humidifer on cathode side: Physical raw sensor value. | Simple conversion of basic filtered electrical to physical value.
      data HumGasBypHumrCtdeUsRaw1: type=Perc11  # Raw Value of Gas humidity at bypass of humidifer on cathode side | Gas humidity at bypass of humidifer on cathode side: Physical raw sensor value. | Simple conversion of basic filtered electrical to physical value.
    HvacTq1  # Actual Mechanical Torque for A/C Compressor | Actual mechanical torque for Air Conditioning (A/C) compressor
      data HvacTq: type=Tq6
    HvacTqReq1  # Requested Mechanical Torque for A/C Compressor | Requested mechanical torque for Air Conditioning (A/C) compressor. This value represents the torque consumption in a predicted future state. It is converted to engine crankshaft torque by the provider. Examples of realization: Before activation of the Air Conditioning (A/C) compressor this interface could contain either - the predicted highest torque consumption during the activation process. - the predicted torque consumption in steady state after the activation is finished. | Default value after reset is zero.
      data HvacTqReq: type=Tq6
    IdCfmdSt1  # Identifier Comfirmed Status | This information is needed to confirm to other functionalities that the Passive Entry (PASE) emitter is known
      data IdCfmdSt: type=OnOff1
    IdCfmdSts1  # Identifier Comfirmed Status | This information is needed to confirm to other functionalities that the Passive Entry (PASE) emitter is known
      data IdCfmdSts: type=OnOff1
    ImobSt1  # Immobilizer Status | Status of the Immobilizer
      data ImobSt: type=ImobSt1
    ImobSts1  # Immobilizer Status | Status of the Immobilizer
      data ImobSts: type=ImobSts1
    ImobnWirelsReq1  # Wireless Immobilizer Request | Immobilization of the vehicle by a phone call
      data ImobnWirels: type=ImobnWirelsReq1
    InclnSt1  # Inclination Status | Information given to know the inclination of the vehicle in order to adapt the beam of the exterior lights
      data St: type=Perc2  # value greater than 100% means invalid; initial value = value greater than 100%
    InclnSts1  # Inclination Status | Information given to know the inclination of the vehicle in order to adapt the beam of the exterior lights
      data Sts: type=Perc2  # value greater than 100% means invalid; initial value = value greater than 100%
    IndcrDisp1  # Indicator Display | Turn indicator activation status on cluster
      data St: type=IndcrSt1
    IndcrTurnCmd1  # Indicator Turn Command | Command to turn on or off the turn indicators according to a requested pattern.
      data Cmd
    IndcrTurnReq1  # Indicator Turn Request | Demand to activate / deactivate left or right indicator blinking or temporary blinking left / right. As long as direction indication is requested, the corresponding value should be set. The temporary information can be generated by the sensor component due to special switches or by an adapter component generating it due to timing calculations.
      data Req: type=IndcrTypExt1
    IntrLiReq1  # Interior Light Request | Request to activate / deactivate an interior light actuator or a virtual interior light group. Faulty switch requires (in-band) invalidation. Also there might be a separate value required for initialization. | This interface is not necessary for each interior light actuator; it is not intended for hardwired interior lights.
      data Req: type=IntrLiReq1
    KeyInsertSt1  # Key Insert Status | state whether the key is inserted into key cylinder or not
      data KeyInsertSt: type=KeyInsertSt1
    KeyInsertSts1  # Key Insert Status | state whether the key is inserted into key cylinder or not
      data KeyInsertSts: type=KeyInsertSts1
    KnobRotyBndlsStep15  # Boundless Rotary Knob 15 Steps | user input to system: The value represents the relative number of steps/positions (out of 15 values) the knob has been moved since the last reported movement. Positive values denote clockwise, negative counter clockwise rotation.
      data Step: type=Nr1
    KnobRotyBndlsStep7  # Boundless Rotary Knob 7 Steps | user input to system: The value represents the relative number of steps/positions (out of 7 values) the knob has been moved since the last reported movement. Positive values denote clockwise, negative counter clockwise rotation.
      data Step: type=Nr9
    LedCmd1  # Led Command | Command to activate the Antitheft Warning System (ATWS) Light Emitting Diode (LED) on board
      data Cmd: type=OnOff1  # OFF - LED not requested by alarm ON - LED requested by alarm
    LiDimGlbCmd1  # Light Dim Global Command | This is the command of light master to give a global exterior and interior light dimming information based on the outside brightness level. It is used e. g. to dim the exterior light depending on outside brightness. | 0% means full darkness 100% means maximum brightness This interface gives the information of the actual outside brightness. E.g. exterior or interior light can use this information to adapt their own dimming calculation.
      data Cmd: type=Perc2
    LiExtCmd1  # Exterior Light Command | Generic command from light manager to light adapter components to turn on/off selected lights.
      data Cmd: type=OnOff1  # Turning On or OFF
    LiExtReq1  # Light External Request | Generic exterior lights request
      data Req: type=OnOff1  # Turning On or OFF
    LiFltSt1  # Light Fault Status | Used as feedback from an actuator component to indicate that the light source is broken or not. | Note that no details of the fault are transmitted, but just an operational / defective fault indication. This enables a control component to decide whether a broken light has to be replaced by another light source.The interface is not used for detailed diagnostics. If the light source contains more than one e. g. bulb, it shall be defined how many actuators have to be broken to reach the state defective. The decision to give the status defective is done by the actuator component
      data St: type=DevErrSt2
    LiFltSts1  # Light Fault Status | Used as feedback from an actuator component to indicate that the light source is broken or not. | Note that no details of the fault are transmitted, but just an operational / defective fault indication. This enables a control component to decide whether a broken light has to be replaced by another light source.The interface is not used for detailed diagnostics. If the light source contains more than one e. g. bulb, it shall be defined how many actuators have to be broken to reach the state defective. The decision to give the status defective is done by the actuator component
      data Sts: type=DevErrSts2
    LiOnWarnReq1  # Light On Warning Request | Request for acoustic signaling of "forgotten" lights turned on status.
      data Disp: type=LiOnWarn1
    LockCmd1  # Lock Command | This is the functional command to the actuator component to execute the command unlock, lock or safe (double lock) at the latch.
      data Cmd: type=LockActvn1
    LockSt1  # Lock Status | Status of the latch. This interface provides the information about the current locking state of the latch. It does not distinguish between the source through which it was operated (mechanical key, the internal motor or the internal knob). This Status is provided to the central locking in order to unlock/lock/save the other latches of the vehicle.
      data St: type=LockSt1
    LockStOfSteerCol1  # Steering Column Lock Status | Indication about the locking status of the steering column
      data LockStOfSteerCol: type=LockStOfSteerCol1
    LockSts1  # Lock Status | Status of the latch. This interface provides the information about the current locking state of the latch. It does not distinguish between the source through which it was operated (mechanical key, the internal motor or the internal knob). This Status is provided to the central locking in order to unlock/lock/save the other latches of the vehicle.
      data Sts: type=LockSts1
    LockStsOfSteerCol1  # Steering Column Lock Status | Indication about the locking status of the steering column
      data LockStsOfSteerCol: type=LockStsOfSteerCol1
    LockUnlckReq1  # Lock Unlock Request | User request for emergency locking in case of danger.
      data St: type=LockUnlckReq1
    LockgFbReq1  # Locking Feedback Request | Request special blinking for feedback that the locking system was unlocked, locked or safed by user request. The blink sequence is represented by a separate interface.
      data St: type=LockActvn1
    LtchRelsReq1  # Latch Release Request | User request to release/unlock the latch of rear lid or tank flap or backlite window. "On" means latch release to unlock or open a lid or backlite window
      data Req: type=OnOff1
    LvlDefrstCmd1  # Level Defrost Command | Command the defrost actuator level
      data Cmd: type=Perc2
    LvlDefrstReq1  # Level Defrost Request | Request for defrost activation with a desired percentage
      data Req: type=Perc2
    LvlDefrstSt1  # Level Defrost Status | Status of defrost activation with feedback on percentage value
      data St: type=Perc2
    LvlDefrstSts1  # Level Defrost Status | Status of defrost activation with feedback on percentage value
      data Sts: type=Perc2
    LvlWtrSepAndeConsold1  # Consolidated Value for Level in water seperator of anode | Level in water seperator of anode: Consolidated physical value, either a measured value or a modeled value. | Finally filtered and offset corrected, consolidated value. Virtual physical sensor value that comes as close as possible to the technical signal. In case of inability to provide a physical sensor value (e.g. failure, implausibility or other reasons) a substitute value or a default value or a frozen value is provided.
      data LvlWtrSepAndeConsold1: type=Perc11  # Consolidated Value for Level in water seperator of anode | Level in water seperator of anode: Consolidated physical value, either a measured value or a modeled value. | Finally filtered and offset corrected, consolidated value. Virtual physical sensor value that comes as close as possible to the technical signal. In case of inability to provide a physical sensor value (e.g. failure, implausibility or other reasons) a substitute value or a default value or a frozen value is provided.
    LvlWtrSepAndeEstimd1  # Estimated Value of Level in water seperator of anode | Level in water seperator of anode: Modeled physical sensor value or standard sensor value. | The estimated value can be used as a replacement for the finally filtered and offset corrected physical sensor value.
      data LvlWtrSepAndeEstimd1: type=Perc11  # Estimated Value of Level in water seperator of anode | Level in water seperator of anode: Modeled physical sensor value or standard sensor value. | The estimated value can be used as a replacement for the finally filtered and offset corrected physical sensor value.
    LvlWtrSepAndeMeasd1  # Measured Value of Level in water seperator of anode | Level in water seperator of anode: Final filtered and offset corrected physical sensor value. | Physical sensor value/standard sensor value. The physical sensor value is the linearized and filtered physical raw sensor value including offset. At this step, a significant phase shift could be possible.
      data LvlWtrSepAndeMeasd1: type=Perc11  # Measured Value of Level in water seperator of anode | Level in water seperator of anode: Final filtered and offset corrected physical sensor value. | Physical sensor value/standard sensor value. The physical sensor value is the linearized and filtered physical raw sensor value including offset. At this step, a significant phase shift could be possible.
    LvlWtrSepAndeRaw1  # Raw Value of Level in water seperator of anode | Level in water seperator of anode: Physical raw sensor value. | Simple conversion of basic filtered electrical to physical value.
      data LvlWtrSepAndeRaw1: type=Perc11  # Raw Value of Level in water seperator of anode | Level in water seperator of anode: Physical raw sensor value. | Simple conversion of basic filtered electrical to physical value.
    LvlgCmd1  # Leveling Command | Command the position of a headlamp leveling actuator. 100% means most upward position (of the headlamps). 0% means most downward position (e.g. low beam adjusted maximum down to the road).101% means invalid. Initial value = Invalid
      data Cmd: type=Perc2
    LvlgReq1  # Leveling Request | Request the position of a headlamp leveling actuator. 100% means most upward position (of the headlamps). 0% means most downward position (e.g. low beam adjusted maximum down to the road).101% means invalid. Initial value = Invalid
      data Req: type=Perc2
    Milg1  # Mileage 1 | Travelled total distance (in km) of the vehicle.
      data Milg: type=Len6
    MirrFltSt1  # Mirror Fault Status | Used as feedback from an actuator component to indicate that the mirror is broken or not. Note that no details of the fault are transmitted, but just an operational / defective fault indication. This enables a control component to decide whether a mirror is broken and should not be actuated. | The interface is not used for detailed diagnostics.
      data St: type=DevErrSt2
    MirrFltSts1  # Mirror Fault Status | Used as feedback from an actuator component to indicate that the mirror is broken or not. Note that no details of the fault are transmitted, but just an operational / defective fault indication. This enables a control component to decide whether a mirror is broken and should not be actuated. | The interface is not used for detailed diagnostics.
      data Sts: type=DevErrSts2
    MirrMoveAutReq1  # Mirror Move Automatic Request | Request to move the mirror automatically to a certain position. This position could be determined by a user request from the mirror panel, an access from the remote key, a keyless access or if reverse gear was detected, to down outer mirror angle to provide the best view to the curb.
      data Req
    MirrPosnStoreReq1  # Mirror Position Store Request | Request to store the position of a certain mirror to the corresponding profile number.
      data Req
    MirrPosnStoreToMemReq1  # Mirror Position Store to Memory Request | Request to store the position of a certain mirror and axis to the memory position 'profile'.
      data Req
    MirrTintgSt1  # Tinting Status | Current status of mirror tinting as feedback in order to control the tinting command to the actuator component.
      data St: type=DevSt4
    MirrTintgSts1  # Tinting Status | Current status of mirror tinting as feedback in order to control the tinting command to the actuator component.
      data Sts: type=DevSts4
    MonrPReqForTirePMon1  # Monitored Pressure Request for Tire Pressure Monitoring | For direct measuring Tire Pressure Monitoring systems: Indication that the current measured tire pressure values have to be monitored by Tire Pressure Monitoring.
      data MonrPConsolReqForTirePMon: type=ReqSt1
    MonrPTarReqForTirePMon1  # TPMS Monitored Target Pressure Request | For direct measuring Tire Pressure Monitoring systems: Indication that the transmitted target tire pressure values have to be monitored by Tire Pressure Monitoring.
      data MonrPTarReqForTirePMon: type=ReqSt1
    NightPanReq1  # Night Panel Request | This interface provides the information about the "Night-Panel-Switch" (e.g. switch for dimming down all interior lights except for speedometer)
      data Req: type=OnOff1
    NoFuCutOffReq1  # No Fuel Cut Off Request 1 | suppress engine fuel cut off
      data NoFuCutOffReq: type=ReqSt1  # 0: no suppression of fuel cut off 1: suppression of fuel cut off
    NozHeatrCmd1  # Nozzle Heater Command | Command to turn on or off the heating element within a washer nozzle
      data Cmd: type=OnOff1
    NozHeatrSt1  # Nozzle Heater Status | Status of the heating element of a nozzle
      data Failr: type=DevErrSt2
      data St: type=OnOff1
    NozHeatrSts1  # Nozzle Heater Status | Status of the heating element of a nozzle
      data Failr: type=DevErrSts2
      data Sts: type=OnOff1
    OccptClass1  # Occupant Class | Classification of occupant
      data Class: type=OccptClass1
    OccptOutOfPos1  # Occpant Out of Position | Out of position of occupant
      data OutOfPos: type=OccptOutOfPos1
    OccptWght1  # Occupant Weight | Weight of occupant
      data Wght: type=M2
    OpendClsdSt1  # Opened Closed Status | Provides information about opened or closed status.
      data St: type=OpendClsd1
    OpendClsdSts1  # Opened Closed Status | Provides information about opened or closed status.
      data Sts: type=OpendClsd1
    OperModSt1  # Operation Mode Status | This interface provides the vehicle operation states. It can be seen as an abstraction and extension of the normal ignition switch position (also called "clamp position") which is traditionally used to guide functional operation of the vehicle. It also includes information about what state the engine is in, i.e. running or not. This interface should be used to control which functionalities / components are active in the vehicle. All states have to be implemented in all vehicles, but not necessarily used.
      data St: type=OperModSt1
    OperModSts1  # Operation Mode Status | This interface provides the vehicle operation states. It can be seen as an abstraction and extension of the normal ignition switch position (also called "clamp position") which is traditionally used to guide functional operation of the vehicle. It also includes information about what state the engine is in, i.e. running or not. This interface should be used to control which functionalities / components are active in the vehicle. All states have to be implemented in all vehicles, but not necessarily used.
      data Sts: type=OperModSts1
    OutdBriSt1  # Outside Brightness Status | This is the outside brightness quantized in some levels. It is e.g. used by exterior light master to provide a global exterior and interior dimming information based on the outside brightness
      data St: type=OutdBriSt1
    OutdBriSts1  # Outside Brightness Status | This is the outside brightness quantized in some levels. It is e.g. used by exterior light master to provide a global exterior and interior dimming information based on the outside brightness
      data Sts: type=OutdBriSts1
    OutpMplSt256  # Multi State Output 256 States | System output to user: The value is used to generate feedback to the user about the system's current state. The value represents one of 256 states, mutually excluding each other, the system can be in or has changed to.
      data St: type=Nr2
    OutpMplSt4  # Multi State Output 4 States | System output to user: The value is used to generate feedback to the user about the system's current state. The value represents one of four states, mutually excluding each other, the system can be in or has changed to.
      data St: type=Nr7
    OutpMplSt8  # Multi State Output 8 States | System output to user: The value is used to generate feedback to the user about the system's current state. The value represents one of eight states, mutually excluding each other, the system can be in or has changed to.
      data St: type=Nr5
    PAirComprHiUsConsold1  # Consolidated Value for Air pressure upstream high pressure compressor | Air pressure upstream high pressure compressor: Consolidated physical value, either a measured value or a modeled value. | Finally filtered and offset corrected, consolidated value. Virtual physical sensor value that comes as close as possible to the technical signal. In case of inability to provide a physical sensor value (e.g. failure, implausibility or other reasons) a substitute value or a default value or a frozen value is provided.
      data PAirComprHiUsConsold1: type=P7  # Consolidated Value for Air pressure upstream high pressure compressor | Air pressure upstream high pressure compressor: Consolidated physical value, either a measured value or a modeled value. | Finally filtered and offset corrected, consolidated value. Virtual physical sensor value that comes as close as possible to the technical signal. In case of inability to provide a physical sensor value (e.g. failure, implausibility or other reasons) a substitute value or a default value or a frozen value is provided.
    PAirComprHiUsEstimd1  # Estimated Value of Air pressure upstream high pressure compressor | Air pressure upstream high pressure compressor: Modeled physical sensor value or standard sensor value. | The estimated value can be used as a replacement for the finally filtered and offset corrected physical sensor value.
      data PAirComprHiUsEstimd1: type=P7  # Estimated Value of Air pressure upstream high pressure compressor | Air pressure upstream high pressure compressor: Modeled physical sensor value or standard sensor value. | The estimated value can be used as a replacement for the finally filtered and offset corrected physical sensor value.
    PAirComprHiUsMeasd1  # Measured Value of Air pressure upstream high pressure compressor | Air pressure upstream high pressure compressor: Final filtered and offset corrected physical sensor value. | Physical sensor value/standard sensor value. The physical sensor value is the linearized and filtered physical raw sensor value including offset. At this step, a significant phase shift could be possible.
      data PAirComprHiUsMeasd1: type=P7  # Measured Value of Air pressure upstream high pressure compressor | Air pressure upstream high pressure compressor: Final filtered and offset corrected physical sensor value. | Physical sensor value/standard sensor value. The physical sensor value is the linearized and filtered physical raw sensor value including offset. At this step, a significant phase shift could be possible.
    PAirComprHiUsRaw1  # Raw Value of Air pressure upstream high pressure compressor | Air pressure upstream high pressure compressor: Physical raw sensor value. | Simple conversion of basic filtered electrical to physical value.
      data PAirComprHiUsRaw1: type=P7  # Raw Value of Air pressure upstream high pressure compressor | Air pressure upstream high pressure compressor: Physical raw sensor value. | Simple conversion of basic filtered electrical to physical value.
    PAirFilDsConsold1  # Consolidated Value for Air pressure downstream air filter | Air pressure downstream air filter: Consolidated physical value, either a measured value or a modeled value. | Finally filtered and offset corrected, consolidated value. Virtual physical sensor value that comes as close as possible to the technical signal. In case of inability to provide a physical sensor value (e.g. failure, implausibility or other reasons) a substitute value or a default value or a frozen value is provided.
      data PAirFilDsConsold1: type=P7  # Consolidated Value for Air pressure downstream air filter | Air pressure downstream air filter: Consolidated physical value, either a measured value or a modeled value. | Finally filtered and offset corrected, consolidated value. Virtual physical sensor value that comes as close as possible to the technical signal. In case of inability to provide a physical sensor value (e.g. failure, implausibility or other reasons) a substitute value or a default value or a frozen value is provided.
    PAirFilDsEstimd1  # Estimated Value of Air pressure downstream air filter | Air pressure downstream air filter: Modeled physical sensor value or standard sensor value. | The estimated value can be used as a replacement for the finally filtered and offset corrected physical sensor value.
      data PAirFilDsEstimd1: type=P7  # Estimated Value of Air pressure downstream air filter | Air pressure downstream air filter: Modeled physical sensor value or standard sensor value. | The estimated value can be used as a replacement for the finally filtered and offset corrected physical sensor value.
    PAirFilDsMeasd1  # Measured Value of Air pressure downstream air filter | Air pressure downstream air filter: Final filtered and offset corrected physical sensor value. | Physical sensor value/standard sensor value. The physical sensor value is the linearized and filtered physical raw sensor value including offset. At this step, a significant phase shift could be possible.
      data PAirFilDsMeasd1: type=P7  # Measured Value of Air pressure downstream air filter | Air pressure downstream air filter: Final filtered and offset corrected physical sensor value. | Physical sensor value/standard sensor value. The physical sensor value is the linearized and filtered physical raw sensor value including offset. At this step, a significant phase shift could be possible.
    PAirFilDsRaw1  # Raw Value of Air pressure downstream air filter | Air pressure downstream air filter: Physical raw sensor value. | Simple conversion of basic filtered electrical to physical value.
      data PAirFilDsRaw1: type=P7  # Raw Value of Air pressure downstream air filter | Air pressure downstream air filter: Physical raw sensor value. | Simple conversion of basic filtered electrical to physical value.
    PAirHumrCtdeUsConsold1  # Consolidated Value for Air pressure upstream cathode humidifier | Air pressure upstream cathode humidifier: Consolidated physical value, either a measured value or a modeled value. | Finally filtered and offset corrected, consolidated value. Virtual physical sensor value that comes as close as possible to the technical signal. In case of inability to provide a physical sensor value (e.g. failure, implausibility or other reasons) a substitute value or a default value or a frozen value is provided.
      data PAirHumrCtdeUsConsold1: type=P7  # Consolidated Value for Air pressure upstream cathode humidifier | Air pressure upstream cathode humidifier: Consolidated physical value, either a measured value or a modeled value. | Finally filtered and offset corrected, consolidated value. Virtual physical sensor value that comes as close as possible to the technical signal. In case of inability to provide a physical sensor value (e.g. failure, implausibility or other reasons) a substitute value or a default value or a frozen value is provided.
    PAirHumrCtdeUsEstimd1  # Estimated Value of Air pressure upstream cathode humidifier | Air pressure upstream cathode humidifier: Modeled physical sensor value or standard sensor value. | The estimated value can be used as a replacement for the finally filtered and offset corrected physical sensor value.
      data PAirHumrCtdeUsEstimd1: type=P7  # Estimated Value of Air pressure upstream cathode humidifier | Air pressure upstream cathode humidifier: Modeled physical sensor value or standard sensor value. | The estimated value can be used as a replacement for the finally filtered and offset corrected physical sensor value.
    PAirHumrCtdeUsMeasd1  # Measured Value of Air pressure upstream cathode humidifier | Air pressure upstream cathode humidifier: Final filtered and offset corrected physical sensor value. | Physical sensor value/standard sensor value. The physical sensor value is the linearized and filtered physical raw sensor value including offset. At this step, a significant phase shift could be possible.
      data PAirHumrCtdeUsMeasd1: type=P7  # Measured Value of Air pressure upstream cathode humidifier | Air pressure upstream cathode humidifier: Final filtered and offset corrected physical sensor value. | Physical sensor value/standard sensor value. The physical sensor value is the linearized and filtered physical raw sensor value including offset. At this step, a significant phase shift could be possible.
    PAirHumrCtdeUsRaw1  # Raw Value of Air pressure upstream cathode humidifier | Air pressure upstream cathode humidifier: Physical raw sensor value. | Simple conversion of basic filtered electrical to physical value.
      data PAirHumrCtdeUsRaw1: type=P7  # Raw Value of Air pressure upstream cathode humidifier | Air pressure upstream cathode humidifier: Physical raw sensor value. | Simple conversion of basic filtered electrical to physical value.
    PCooltPmpMedTDsConsold1  # Consolidated Value for Coolant pressure downstream of coolant pump for medium temperature circuit | Coolant pressure downstream of coolant pump for medium temperature circuit: Consolidated physical value, either a measured value or a modeled value. | Finally filtered and offset corrected, consolidated value. Virtual physical sensor value that comes as close as possible to the technical signal. In case of inability to provide a physical sensor value (e.g. failure, implausibility or other reasons) a substitute value or a default value or a frozen value is provided.
      data PCooltPmpMedTDsConsold1: type=P7  # Consolidated Value for Coolant pressure downstream of coolant pump for medium temperature circuit | Coolant pressure downstream of coolant pump for medium temperature circuit: Consolidated physical value, either a measured value or a modeled value. | Finally filtered and offset corrected, consolidated value. Virtual physical sensor value that comes as close as possible to the technical signal. In case of inability to provide a physical sensor value (e.g. failure, implausibility or other reasons) a substitute value or a default value or a frozen value is provided.
    PCooltPmpMedTDsEstimd1  # Estimated Value of Coolant pressure downstream of coolant pump for medium temperature circuit | Coolant pressure downstream of coolant pump for medium temperature circuit: Modeled physical sensor value or standard sensor value. | The estimated value can be used as a replacement for the finally filtered and offset corrected physical sensor value.
      data PCooltPmpMedTDsEstimd1: type=P7  # Estimated Value of Coolant pressure downstream of coolant pump for medium temperature circuit | Coolant pressure downstream of coolant pump for medium temperature circuit: Modeled physical sensor value or standard sensor value. | The estimated value can be used as a replacement for the finally filtered and offset corrected physical sensor value.
    PCooltPmpMedTDsMeasd1  # Measured Value of Coolant pressure downstream of coolant pump for medium temperature circuit | Coolant pressure downstream of coolant pump for medium temperature circuit: Final filtered and offset corrected physical sensor value. | Physical sensor value/standard sensor value. The physical sensor value is the linearized and filtered physical raw sensor value including offset. At this step, a significant phase shift could be possible.
      data PCooltPmpMedTDsMeasd1: type=P7  # Measured Value of Coolant pressure downstream of coolant pump for medium temperature circuit | Coolant pressure downstream of coolant pump for medium temperature circuit: Final filtered and offset corrected physical sensor value. | Physical sensor value/standard sensor value. The physical sensor value is the linearized and filtered physical raw sensor value including offset. At this step, a significant phase shift could be possible.
    PCooltPmpMedTDsRaw1  # Raw Value of Coolant pressure downstream of coolant pump for medium temperature circuit | Coolant pressure downstream of coolant pump for medium temperature circuit: Physical raw sensor value. | Simple conversion of basic filtered electrical to physical value.
      data PCooltPmpMedTDsRaw1: type=P7  # Raw Value of Coolant pressure downstream of coolant pump for medium temperature circuit | Coolant pressure downstream of coolant pump for medium temperature circuit: Physical raw sensor value. | Simple conversion of basic filtered electrical to physical value.
    PCooltStckInConsold1  # Consolidated Value for Coolant pressure at stack inlet | Coolant pressure at stack inlet: Consolidated physical value, either a measured value or a modeled value. | Finally filtered and offset corrected, consolidated value. Virtual physical sensor value that comes as close as possible to the technical signal. In case of inability to provide a physical sensor value (e.g. failure, implausibility or other reasons) a substitute value or a default value or a frozen value is provided.
      data PCooltStckInConsold1: type=P7  # Consolidated Value for Coolant pressure at stack inlet | Coolant pressure at stack inlet: Consolidated physical value, either a measured value or a modeled value. | Finally filtered and offset corrected, consolidated value. Virtual physical sensor value that comes as close as possible to the technical signal. In case of inability to provide a physical sensor value (e.g. failure, implausibility or other reasons) a substitute value or a default value or a frozen value is provided.
    PCooltStckInEstimd1  # Estimated Value of Coolant pressure at stack inlet | Coolant pressure at stack inlet: Modeled physical sensor value or standard sensor value. | The estimated value can be used as a replacement for the finally filtered and offset corrected physical sensor value.
      data PCooltStckInEstimd1: type=P7  # Estimated Value of Coolant pressure at stack inlet | Coolant pressure at stack inlet: Modeled physical sensor value or standard sensor value. | The estimated value can be used as a replacement for the finally filtered and offset corrected physical sensor value.
    PCooltStckInMeasd1  # Measured Value of Coolant pressure at stack inlet | Coolant pressure at stack inlet: Final filtered and offset corrected physical sensor value. | Physical sensor value/standard sensor value. The physical sensor value is the linearized and filtered physical raw sensor value including offset. At this step, a significant phase shift could be possible.
      data PCooltStckInMeasd1: type=P7  # Measured Value of Coolant pressure at stack inlet | Coolant pressure at stack inlet: Final filtered and offset corrected physical sensor value. | Physical sensor value/standard sensor value. The physical sensor value is the linearized and filtered physical raw sensor value including offset. At this step, a significant phase shift could be possible.
    PCooltStckInRaw1  # Raw Value of Coolant pressure at stack inlet | Coolant pressure at stack inlet: Physical raw sensor value. | Simple conversion of basic filtered electrical to physical value.
      data PCooltStckInRaw1: type=P7  # Raw Value of Coolant pressure at stack inlet | Coolant pressure at stack inlet: Physical raw sensor value. | Simple conversion of basic filtered electrical to physical value.
    PCooltStckOutConsold1  # Consolidated Value for Coolant pressure at stack outlet | Coolant pressure at stack outlet: Consolidated physical value, either a measured value or a modeled value. | Finally filtered and offset corrected, consolidated value. Virtual physical sensor value that comes as close as possible to the technical signal. In case of inability to provide a physical sensor value (e.g. failure, implausibility or other reasons) a substitute value or a default value or a frozen value is provided.
      data PCooltStckOutConsold1: type=P7  # Consolidated Value for Coolant pressure at stack outlet | Coolant pressure at stack outlet: Consolidated physical value, either a measured value or a modeled value. | Finally filtered and offset corrected, consolidated value. Virtual physical sensor value that comes as close as possible to the technical signal. In case of inability to provide a physical sensor value (e.g. failure, implausibility or other reasons) a substitute value or a default value or a frozen value is provided.
    PCooltStckOutEstimd1  # Estimated Value of Coolant pressure at stack outlet | Coolant pressure at stack outlet: Modeled physical sensor value or standard sensor value. | The estimated value can be used as a replacement for the finally filtered and offset corrected physical sensor value.
      data PCooltStckOutEstimd1: type=P7  # Estimated Value of Coolant pressure at stack outlet | Coolant pressure at stack outlet: Modeled physical sensor value or standard sensor value. | The estimated value can be used as a replacement for the finally filtered and offset corrected physical sensor value.
    PCooltStckOutMeasd1  # Measured Value of Coolant pressure at stack outlet | Coolant pressure at stack outlet: Final filtered and offset corrected physical sensor value. | Physical sensor value/standard sensor value. The physical sensor value is the linearized and filtered physical raw sensor value including offset. At this step, a significant phase shift could be possible.
      data PCooltStckOutMeasd1: type=P7  # Measured Value of Coolant pressure at stack outlet | Coolant pressure at stack outlet: Final filtered and offset corrected physical sensor value. | Physical sensor value/standard sensor value. The physical sensor value is the linearized and filtered physical raw sensor value including offset. At this step, a significant phase shift could be possible.
    PCooltStckOutRaw1  # Raw Value of Coolant pressure at stack outlet | Coolant pressure at stack outlet: Physical raw sensor value. | Simple conversion of basic filtered electrical to physical value.
      data PCooltStckOutRaw1: type=P7  # Raw Value of Coolant pressure at stack outlet | Coolant pressure at stack outlet: Physical raw sensor value. | Simple conversion of basic filtered electrical to physical value.
    PExtForOccptPedSfty1  # Pressure External for Occupant Pedestrian Safety | Differential pressure to detect impacts, typically measured in doors
      data P: type=Perc8
    PGasAndeDifConsold1  # Consolidated Value for Gas pressure difference across anode | Gas pressure difference across anode: Consolidated physical value, either a measured value or a modeled value. | Finally filtered and offset corrected, consolidated value. Virtual physical sensor value that comes as close as possible to the technical signal. In case of inability to provide a physical sensor value (e.g. failure, implausibility or other reasons) a substitute value or a default value or a frozen value is provided.
      data PGasAndeDifConsold1: type=P7  # Consolidated Value for Gas pressure difference across anode | Gas pressure difference across anode: Consolidated physical value, either a measured value or a modeled value. | Finally filtered and offset corrected, consolidated value. Virtual physical sensor value that comes as close as possible to the technical signal. In case of inability to provide a physical sensor value (e.g. failure, implausibility or other reasons) a substitute value or a default value or a frozen value is provided.
    PGasAndeDifEstimd1  # Estimated Value of Gas pressure difference across anode | Gas pressure difference across anode: Modeled physical sensor value or standard sensor value. | The estimated value can be used as a replacement for the finally filtered and offset corrected physical sensor value.
      data PGasAndeDifEstimd1: type=P7  # Estimated Value of Gas pressure difference across anode | Gas pressure difference across anode: Modeled physical sensor value or standard sensor value. | The estimated value can be used as a replacement for the finally filtered and offset corrected physical sensor value.
    PGasAndeDifMeasd1  # Measured Value of Gas pressure difference across anode | Gas pressure difference across anode: Final filtered and offset corrected physical sensor value. | Physical sensor value/standard sensor value. The physical sensor value is the linearized and filtered physical raw sensor value including offset. At this step, a significant phase shift could be possible.
      data PGasAndeDifMeasd1: type=P7  # Measured Value of Gas pressure difference across anode | Gas pressure difference across anode: Final filtered and offset corrected physical sensor value. | Physical sensor value/standard sensor value. The physical sensor value is the linearized and filtered physical raw sensor value including offset. At this step, a significant phase shift could be possible.
    PGasAndeDifRaw1  # Raw Value of Gas pressure difference across anode | Gas pressure difference across anode: Physical raw sensor value. | Simple conversion of basic filtered electrical to physical value.
      data PGasAndeDifRaw1: type=P7  # Raw Value of Gas pressure difference across anode | Gas pressure difference across anode: Physical raw sensor value. | Simple conversion of basic filtered electrical to physical value.
    PGasAndeDsConsold1  # Consolidated Value for Gas pressure at downstream of anode | Gas pressure at downstream of anode: Consolidated physical value, either a measured value or a modeled value. | Finally filtered and offset corrected, consolidated value. Virtual physical sensor value that comes as close as possible to the technical signal. In case of inability to provide a physical sensor value (e.g. failure, implausibility or other reasons) a substitute value or a default value or a frozen value is provided.
      data PGasAndeDsConsold1: type=P7  # Consolidated Value for Gas pressure at downstream of anode | Gas pressure at downstream of anode: Consolidated physical value, either a measured value or a modeled value. | Finally filtered and offset corrected, consolidated value. Virtual physical sensor value that comes as close as possible to the technical signal. In case of inability to provide a physical sensor value (e.g. failure, implausibility or other reasons) a substitute value or a default value or a frozen value is provided.
    PGasAndeDsEstimd1  # Estimated Value of Gas pressure at downstream of anode | Gas pressure at downstream of anode: Modeled physical sensor value or standard sensor value. | The estimated value can be used as a replacement for the finally filtered and offset corrected physical sensor value.
      data PGasAndeDsEstimd1: type=P7  # Estimated Value of Gas pressure at downstream of anode | Gas pressure at downstream of anode: Modeled physical sensor value or standard sensor value. | The estimated value can be used as a replacement for the finally filtered and offset corrected physical sensor value.
    PGasAndeDsMeasd1  # Measured Value of Gas pressure at downstream of anode | Gas pressure at downstream of anode: Final filtered and offset corrected physical sensor value. | Physical sensor value/standard sensor value. The physical sensor value is the linearized and filtered physical raw sensor value including offset. At this step, a significant phase shift could be possible.
      data PGasAndeDsMeasd1: type=P7  # Measured Value of Gas pressure at downstream of anode | Gas pressure at downstream of anode: Final filtered and offset corrected physical sensor value. | Physical sensor value/standard sensor value. The physical sensor value is the linearized and filtered physical raw sensor value including offset. At this step, a significant phase shift could be possible.
    PGasAndeDsRaw1  # Raw Value of Gas pressure at downstream of anode | Gas pressure at downstream of anode: Physical raw sensor value. | Simple conversion of basic filtered electrical to physical value.
      data PGasAndeDsRaw1: type=P7  # Raw Value of Gas pressure at downstream of anode | Gas pressure at downstream of anode: Physical raw sensor value. | Simple conversion of basic filtered electrical to physical value.
    PGasAndeUsConsold1  # Consolidated Value for Gas pressure at upstream of anode | Gas pressure at upstream of anode: Consolidated physical value, either a measured value or a modeled value. | Finally filtered and offset corrected, consolidated value. Virtual physical sensor value that comes as close as possible to the technical signal. In case of inability to provide a physical sensor value (e.g. failure, implausibility or other reasons) a substitute value or a default value or a frozen value is provided.
      data PGasAndeUsConsold1: type=P7  # Consolidated Value for Gas pressure at upstream of anode | Gas pressure at upstream of anode: Consolidated physical value, either a measured value or a modeled value. | Finally filtered and offset corrected, consolidated value. Virtual physical sensor value that comes as close as possible to the technical signal. In case of inability to provide a physical sensor value (e.g. failure, implausibility or other reasons) a substitute value or a default value or a frozen value is provided.
    PGasAndeUsEstimd1  # Estimated Value of Gas pressure at upstream of anode | Gas pressure at upstream of anode: Modeled physical sensor value or standard sensor value. | The estimated value can be used as a replacement for the finally filtered and offset corrected physical sensor value.
      data PGasAndeUsEstimd1: type=P7  # Estimated Value of Gas pressure at upstream of anode | Gas pressure at upstream of anode: Modeled physical sensor value or standard sensor value. | The estimated value can be used as a replacement for the finally filtered and offset corrected physical sensor value.
    PGasAndeUsMeasd1  # Measured Value of Gas pressure at upstream of anode | Gas pressure at upstream of anode: Final filtered and offset corrected physical sensor value. | Physical sensor value/standard sensor value. The physical sensor value is the linearized and filtered physical raw sensor value including offset. At this step, a significant phase shift could be possible.
      data PGasAndeUsMeasd1: type=P7  # Measured Value of Gas pressure at upstream of anode | Gas pressure at upstream of anode: Final filtered and offset corrected physical sensor value. | Physical sensor value/standard sensor value. The physical sensor value is the linearized and filtered physical raw sensor value including offset. At this step, a significant phase shift could be possible.
    PGasAndeUsRaw1  # Raw Value of Gas pressure at upstream of anode | Gas pressure at upstream of anode: Physical raw sensor value. | Simple conversion of basic filtered electrical to physical value.
      data PGasAndeUsRaw1: type=P7  # Raw Value of Gas pressure at upstream of anode | Gas pressure at upstream of anode: Physical raw sensor value. | Simple conversion of basic filtered electrical to physical value.
    PGasBypCtdeDsConsold1  # Consolidated Value for Gas pressure downstream cathode bypass | Gas pressure downstream cathode bypass: Consolidated physical value, either a measured value or a modeled value. | Finally filtered and offset corrected, consolidated value. Virtual physical sensor value that comes as close as possible to the technical signal. In case of inability to provide a physical sensor value (e.g. failure, implausibility or other reasons) a substitute value or a default value or a frozen value is provided.
      data PGasBypCtdeDsConsold1: type=P7  # Consolidated Value for Gas pressure downstream cathode bypass | Gas pressure downstream cathode bypass: Consolidated physical value, either a measured value or a modeled value. | Finally filtered and offset corrected, consolidated value. Virtual physical sensor value that comes as close as possible to the technical signal. In case of inability to provide a physical sensor value (e.g. failure, implausibility or other reasons) a substitute value or a default value or a frozen value is provided.
    PGasBypCtdeDsEstimd1  # Estimated Value of Gas pressure downstream cathode bypass | Gas pressure downstream cathode bypass: Modeled physical sensor value or standard sensor value. | The estimated value can be used as a replacement for the finally filtered and offset corrected physical sensor value.
      data PGasBypCtdeDsEstimd1: type=P7  # Estimated Value of Gas pressure downstream cathode bypass | Gas pressure downstream cathode bypass: Modeled physical sensor value or standard sensor value. | The estimated value can be used as a replacement for the finally filtered and offset corrected physical sensor value.
    PGasBypCtdeDsMeasd1  # Measured Value of Gas pressure downstream cathode bypass | Gas pressure downstream cathode bypass: Final filtered and offset corrected physical sensor value. | Physical sensor value/standard sensor value. The physical sensor value is the linearized and filtered physical raw sensor value including offset. At this step, a significant phase shift could be possible.
      data PGasBypCtdeDsMeasd1: type=P7  # Measured Value of Gas pressure downstream cathode bypass | Gas pressure downstream cathode bypass: Final filtered and offset corrected physical sensor value. | Physical sensor value/standard sensor value. The physical sensor value is the linearized and filtered physical raw sensor value including offset. At this step, a significant phase shift could be possible.
    PGasBypCtdeDsRaw1  # Raw Value of Gas pressure downstream cathode bypass | Gas pressure downstream cathode bypass: Physical raw sensor value. | Simple conversion of basic filtered electrical to physical value.
      data PGasBypCtdeDsRaw1: type=P7  # Raw Value of Gas pressure downstream cathode bypass | Gas pressure downstream cathode bypass: Physical raw sensor value. | Simple conversion of basic filtered electrical to physical value.
    PGasBypCtdeUsConsold1  # Consolidated Value for Gas pressure upstream cathode bypass | Gas pressure upstream cathode bypass: Consolidated physical value, either a measured value or a modeled value. | Finally filtered and offset corrected, consolidated value. Virtual physical sensor value that comes as close as possible to the technical signal. In case of inability to provide a physical sensor value (e.g. failure, implausibility or other reasons) a substitute value or a default value or a frozen value is provided.
      data PGasBypCtdeUsConsold1: type=P7  # Consolidated Value for Gas pressure upstream cathode bypass | Gas pressure upstream cathode bypass: Consolidated physical value, either a measured value or a modeled value. | Finally filtered and offset corrected, consolidated value. Virtual physical sensor value that comes as close as possible to the technical signal. In case of inability to provide a physical sensor value (e.g. failure, implausibility or other reasons) a substitute value or a default value or a frozen value is provided.
    PGasBypCtdeUsEstimd1  # Estimated Value of Gas pressure upstream cathode bypass | Gas pressure upstream cathode bypass: Modeled physical sensor value or standard sensor value. | The estimated value can be used as a replacement for the finally filtered and offset corrected physical sensor value.
      data PGasBypCtdeUsEstimd1: type=P7  # Estimated Value of Gas pressure upstream cathode bypass | Gas pressure upstream cathode bypass: Modeled physical sensor value or standard sensor value. | The estimated value can be used as a replacement for the finally filtered and offset corrected physical sensor value.
    PGasBypCtdeUsMeasd1  # Measured Value of Gas pressure upstream cathode bypass | Gas pressure upstream cathode bypass: Final filtered and offset corrected physical sensor value. | Physical sensor value/standard sensor value. The physical sensor value is the linearized and filtered physical raw sensor value including offset. At this step, a significant phase shift could be possible.
      data PGasBypCtdeUsMeasd1: type=P7  # Measured Value of Gas pressure upstream cathode bypass | Gas pressure upstream cathode bypass: Final filtered and offset corrected physical sensor value. | Physical sensor value/standard sensor value. The physical sensor value is the linearized and filtered physical raw sensor value including offset. At this step, a significant phase shift could be possible.
    PGasBypCtdeUsRaw1  # Raw Value of Gas pressure upstream cathode bypass | Gas pressure upstream cathode bypass: Physical raw sensor value. | Simple conversion of basic filtered electrical to physical value.
      data PGasBypCtdeUsRaw1: type=P7  # Raw Value of Gas pressure upstream cathode bypass | Gas pressure upstream cathode bypass: Physical raw sensor value. | Simple conversion of basic filtered electrical to physical value.
    PGasBypHumrCtdeDsConsold1  # Consolidated Value for Gas pressure downstream cathode humidifier bypass | Gas pressure downstream cathode humidifier bypass: Consolidated physical value, either a measured value or a modeled value. | Finally filtered and offset corrected, consolidated value. Virtual physical sensor value that comes as close as possible to the technical signal. In case of inability to provide a physical sensor value (e.g. failure, implausibility or other reasons) a substitute value or a default value or a frozen value is provided.
      data PGasBypHumrCtdeDsConsold1: type=P7  # Consolidated Value for Gas pressure downstream cathode humidifier bypass | Gas pressure downstream cathode humidifier bypass: Consolidated physical value, either a measured value or a modeled value. | Finally filtered and offset corrected, consolidated value. Virtual physical sensor value that comes as close as possible to the technical signal. In case of inability to provide a physical sensor value (e.g. failure, implausibility or other reasons) a substitute value or a default value or a frozen value is provided.
    PGasBypHumrCtdeDsEstimd1  # Estimated Value of Gas pressure downstream cathode humidifier bypass | Gas pressure downstream cathode humidifier bypass: Modeled physical sensor value or standard sensor value. | The estimated value can be used as a replacement for the finally filtered and offset corrected physical sensor value.
      data PGasBypHumrCtdeDsEstimd1: type=P7  # Estimated Value of Gas pressure downstream cathode humidifier bypass | Gas pressure downstream cathode humidifier bypass: Modeled physical sensor value or standard sensor value. | The estimated value can be used as a replacement for the finally filtered and offset corrected physical sensor value.
    PGasBypHumrCtdeDsMeasd1  # Measured Value of Gas pressure downstream cathode humidifier bypass | Gas pressure downstream cathode humidifier bypass: Final filtered and offset corrected physical sensor value. | Physical sensor value/standard sensor value. The physical sensor value is the linearized and filtered physical raw sensor value including offset. At this step, a significant phase shift could be possible.
      data PGasBypHumrCtdeDsMeasd1: type=P7  # Measured Value of Gas pressure downstream cathode humidifier bypass | Gas pressure downstream cathode humidifier bypass: Final filtered and offset corrected physical sensor value. | Physical sensor value/standard sensor value. The physical sensor value is the linearized and filtered physical raw sensor value including offset. At this step, a significant phase shift could be possible.
    PGasBypHumrCtdeDsRaw1  # Raw Value of Gas pressure downstream cathode humidifier bypass | Gas pressure downstream cathode humidifier bypass: Physical raw sensor value. | Simple conversion of basic filtered electrical to physical value.
      data PGasBypHumrCtdeDsRaw1: type=P7  # Raw Value of Gas pressure downstream cathode humidifier bypass | Gas pressure downstream cathode humidifier bypass: Physical raw sensor value. | Simple conversion of basic filtered electrical to physical value.
    PGasBypHumrCtdeUsConsold1  # Consolidated Value for Gas pressure upstream cathode humidifier bypass | Gas pressure upstream cathode humidifier bypass: Consolidated physical value, either a measured value or a modeled value. | Finally filtered and offset corrected, consolidated value. Virtual physical sensor value that comes as close as possible to the technical signal. In case of inability to provide a physical sensor value (e.g. failure, implausibility or other reasons) a substitute value or a default value or a frozen value is provided.
      data PGasBypHumrCtdeUsConsold1: type=P7  # Consolidated Value for Gas pressure upstream cathode humidifier bypass | Gas pressure upstream cathode humidifier bypass: Consolidated physical value, either a measured value or a modeled value. | Finally filtered and offset corrected, consolidated value. Virtual physical sensor value that comes as close as possible to the technical signal. In case of inability to provide a physical sensor value (e.g. failure, implausibility or other reasons) a substitute value or a default value or a frozen value is provided.
    PGasBypHumrCtdeUsEstimd1  # Estimated Value of Gas pressure upstream cathode humidifier bypass | Gas pressure upstream cathode humidifier bypass: Modeled physical sensor value or standard sensor value. | The estimated value can be used as a replacement for the finally filtered and offset corrected physical sensor value.
      data PGasBypHumrCtdeUsEstimd1: type=P7  # Estimated Value of Gas pressure upstream cathode humidifier bypass | Gas pressure upstream cathode humidifier bypass: Modeled physical sensor value or standard sensor value. | The estimated value can be used as a replacement for the finally filtered and offset corrected physical sensor value.
    PGasBypHumrCtdeUsMeasd1  # Measured Value of Gas pressure upstream cathode humidifier bypass | Gas pressure upstream cathode humidifier bypass: Final filtered and offset corrected physical sensor value. | Physical sensor value/standard sensor value. The physical sensor value is the linearized and filtered physical raw sensor value including offset. At this step, a significant phase shift could be possible.
      data PGasBypHumrCtdeUsMeasd1: type=P7  # Measured Value of Gas pressure upstream cathode humidifier bypass | Gas pressure upstream cathode humidifier bypass: Final filtered and offset corrected physical sensor value. | Physical sensor value/standard sensor value. The physical sensor value is the linearized and filtered physical raw sensor value including offset. At this step, a significant phase shift could be possible.
    PGasBypHumrCtdeUsRaw1  # Raw Value of Gas pressure upstream cathode humidifier bypass | Gas pressure upstream cathode humidifier bypass: Physical raw sensor value. | Simple conversion of basic filtered electrical to physical value.
      data PGasBypHumrCtdeUsRaw1: type=P7  # Raw Value of Gas pressure upstream cathode humidifier bypass | Gas pressure upstream cathode humidifier bypass: Physical raw sensor value. | Simple conversion of basic filtered electrical to physical value.
    PGasCtdeDsConsold1  # Consolidated Value for Gas pressure downstream cathode | Gas pressure downstream cathode: Consolidated physical value, either a measured value or a modeled value. | Finally filtered and offset corrected, consolidated value. Virtual physical sensor value that comes as close as possible to the technical signal. In case of inability to provide a physical sensor value (e.g. failure, implausibility or other reasons) a substitute value or a default value or a frozen value is provided.
      data PGasCtdeDsConsold1: type=P7  # Consolidated Value for Gas pressure downstream cathode | Gas pressure downstream cathode: Consolidated physical value, either a measured value or a modeled value. | Finally filtered and offset corrected, consolidated value. Virtual physical sensor value that comes as close as possible to the technical signal. In case of inability to provide a physical sensor value (e.g. failure, implausibility or other reasons) a substitute value or a default value or a frozen value is provided.
    PGasCtdeDsEstimd1  # Estimated Value of Gas pressure downstream cathode | Gas pressure downstream cathode: Modeled physical sensor value or standard sensor value. | The estimated value can be used as a replacement for the finally filtered and offset corrected physical sensor value.
      data PGasCtdeDsEstimd1: type=P7  # Estimated Value of Gas pressure downstream cathode | Gas pressure downstream cathode: Modeled physical sensor value or standard sensor value. | The estimated value can be used as a replacement for the finally filtered and offset corrected physical sensor value.
    PGasCtdeDsMeasd1  # Measured Value of Gas pressure downstream cathode | Gas pressure downstream cathode: Final filtered and offset corrected physical sensor value. | Physical sensor value/standard sensor value. The physical sensor value is the linearized and filtered physical raw sensor value including offset. At this step, a significant phase shift could be possible.
      data PGasCtdeDsMeasd1: type=P7  # Measured Value of Gas pressure downstream cathode | Gas pressure downstream cathode: Final filtered and offset corrected physical sensor value. | Physical sensor value/standard sensor value. The physical sensor value is the linearized and filtered physical raw sensor value including offset. At this step, a significant phase shift could be possible.
    PGasCtdeDsRaw1  # Raw Value of Gas pressure downstream cathode | Gas pressure downstream cathode: Physical raw sensor value. | Simple conversion of basic filtered electrical to physical value.
      data PGasCtdeDsRaw1: type=P7  # Raw Value of Gas pressure downstream cathode | Gas pressure downstream cathode: Physical raw sensor value. | Simple conversion of basic filtered electrical to physical value.
    PGasCtdeUsConsold1  # Consolidated Value for Gas pressure upstream cathode | Gas pressure upstream cathode: Consolidated physical value, either a measured value or a modeled value. | Finally filtered and offset corrected, consolidated value. Virtual physical sensor value that comes as close as possible to the technical signal. In case of inability to provide a physical sensor value (e.g. failure, implausibility or other reasons) a substitute value or a default value or a frozen value is provided.
      data PGasCtdeUsConsold1: type=P7  # Consolidated Value for Gas pressure upstream cathode | Gas pressure upstream cathode: Consolidated physical value, either a measured value or a modeled value. | Finally filtered and offset corrected, consolidated value. Virtual physical sensor value that comes as close as possible to the technical signal. In case of inability to provide a physical sensor value (e.g. failure, implausibility or other reasons) a substitute value or a default value or a frozen value is provided.
    PGasCtdeUsEstimd1  # Estimated Value of Gas pressure upstream cathode | Gas pressure upstream cathode: Modeled physical sensor value or standard sensor value. | The estimated value can be used as a replacement for the finally filtered and offset corrected physical sensor value.
      data PGasCtdeUsEstimd1: type=P7  # Estimated Value of Gas pressure upstream cathode | Gas pressure upstream cathode: Modeled physical sensor value or standard sensor value. | The estimated value can be used as a replacement for the finally filtered and offset corrected physical sensor value.
    PGasCtdeUsMeasd1  # Measured Value of Gas pressure upstream cathode | Gas pressure upstream cathode: Final filtered and offset corrected physical sensor value. | Physical sensor value/standard sensor value. The physical sensor value is the linearized and filtered physical raw sensor value including offset. At this step, a significant phase shift could be possible.
      data PGasCtdeUsMeasd1: type=P7  # Measured Value of Gas pressure upstream cathode | Gas pressure upstream cathode: Final filtered and offset corrected physical sensor value. | Physical sensor value/standard sensor value. The physical sensor value is the linearized and filtered physical raw sensor value including offset. At this step, a significant phase shift could be possible.
    PGasCtdeUsRaw1  # Raw Value of Gas pressure upstream cathode | Gas pressure upstream cathode: Physical raw sensor value. | Simple conversion of basic filtered electrical to physical value.
      data PGasCtdeUsRaw1: type=P7  # Raw Value of Gas pressure upstream cathode | Gas pressure upstream cathode: Physical raw sensor value. | Simple conversion of basic filtered electrical to physical value.
    PGasH2BlowrDsConsold1  # Consolidated Value for Gas pressure at downstream of hydrogen recirculation blower | Gas pressure at downstream of hydrogen recirculation blower: Consolidated physical value, either a measured value or a modeled value. | Finally filtered and offset corrected, consolidated value. Virtual physical sensor value that comes as close as possible to the technical signal. In case of inability to provide a physical sensor value (e.g. failure, implausibility or other reasons) a substitute value or a default value or a frozen value is provided.
      data PGasH2BlowrDsConsold1: type=P7  # Consolidated Value for Gas pressure at downstream of hydrogen recirculation blower | Gas pressure at downstream of hydrogen recirculation blower: Consolidated physical value, either a measured value or a modeled value. | Finally filtered and offset corrected, consolidated value. Virtual physical sensor value that comes as close as possible to the technical signal. In case of inability to provide a physical sensor value (e.g. failure, implausibility or other reasons) a substitute value or a default value or a frozen value is provided.
    PGasH2BlowrDsEstimd1  # Estimated Value of Gas pressure at downstream of hydrogen recirculation blower | Gas pressure at downstream of hydrogen recirculation blower: Modeled physical sensor value or standard sensor value. | The estimated value can be used as a replacement for the finally filtered and offset corrected physical sensor value.
      data PGasH2BlowrDsEstimd1: type=P7  # Estimated Value of Gas pressure at downstream of hydrogen recirculation blower | Gas pressure at downstream of hydrogen recirculation blower: Modeled physical sensor value or standard sensor value. | The estimated value can be used as a replacement for the finally filtered and offset corrected physical sensor value.
    PGasH2BlowrDsMeasd1  # Measured Value of Gas pressure at downstream of hydrogen recirculation blower | Gas pressure at downstream of hydrogen recirculation blower: Final filtered and offset corrected physical sensor value. | Physical sensor value/standard sensor value. The physical sensor value is the linearized and filtered physical raw sensor value including offset. At this step, a significant phase shift could be possible.
      data PGasH2BlowrDsMeasd1: type=P7  # Measured Value of Gas pressure at downstream of hydrogen recirculation blower | Gas pressure at downstream of hydrogen recirculation blower: Final filtered and offset corrected physical sensor value. | Physical sensor value/standard sensor value. The physical sensor value is the linearized and filtered physical raw sensor value including offset. At this step, a significant phase shift could be possible.
    PGasH2BlowrDsRaw1  # Raw Value of Gas pressure at downstream of hydrogen recirculation blower | Gas pressure at downstream of hydrogen recirculation blower: Physical raw sensor value. | Simple conversion of basic filtered electrical to physical value.
      data PGasH2BlowrDsRaw1: type=P7  # Raw Value of Gas pressure at downstream of hydrogen recirculation blower | Gas pressure at downstream of hydrogen recirculation blower: Physical raw sensor value. | Simple conversion of basic filtered electrical to physical value.
    PGasH2BlowrUsConsold1  # Consolidated Value for Gas pressure at upstream of hydrogen recirculation blower | Gas pressure at upstream of hydrogen recirculation blower: Consolidated physical value, either a measured value or a modeled value. | Finally filtered and offset corrected, consolidated value. Virtual physical sensor value that comes as close as possible to the technical signal. In case of inability to provide a physical sensor value (e.g. failure, implausibility or other reasons) a substitute value or a default value or a frozen value is provided.
      data PGasH2BlowrUsConsold1: type=P7  # Consolidated Value for Gas pressure at upstream of hydrogen recirculation blower | Gas pressure at upstream of hydrogen recirculation blower: Consolidated physical value, either a measured value or a modeled value. | Finally filtered and offset corrected, consolidated value. Virtual physical sensor value that comes as close as possible to the technical signal. In case of inability to provide a physical sensor value (e.g. failure, implausibility or other reasons) a substitute value or a default value or a frozen value is provided.
    PGasH2BlowrUsEstimd1  # Estimated Value of Gas pressure at upstream of hydrogen recirculation blower | Gas pressure at upstream of hydrogen recirculation blower: Modeled physical sensor value or standard sensor value. | The estimated value can be used as a replacement for the finally filtered and offset corrected physical sensor value.
      data PGasH2BlowrUsEstimd1: type=P7  # Estimated Value of Gas pressure at upstream of hydrogen recirculation blower | Gas pressure at upstream of hydrogen recirculation blower: Modeled physical sensor value or standard sensor value. | The estimated value can be used as a replacement for the finally filtered and offset corrected physical sensor value.
    PGasH2BlowrUsMeasd1  # Measured Value of Gas pressure at upstream of hydrogen recirculation blower | Gas pressure at upstream of hydrogen recirculation blower: Final filtered and offset corrected physical sensor value. | Physical sensor value/standard sensor value. The physical sensor value is the linearized and filtered physical raw sensor value including offset. At this step, a significant phase shift could be possible.
      data PGasH2BlowrUsMeasd1: type=P7  # Measured Value of Gas pressure at upstream of hydrogen recirculation blower | Gas pressure at upstream of hydrogen recirculation blower: Final filtered and offset corrected physical sensor value. | Physical sensor value/standard sensor value. The physical sensor value is the linearized and filtered physical raw sensor value including offset. At this step, a significant phase shift could be possible.
    PGasH2BlowrUsRaw1  # Raw Value of Gas pressure at upstream of hydrogen recirculation blower | Gas pressure at upstream of hydrogen recirculation blower: Physical raw sensor value. | Simple conversion of basic filtered electrical to physical value.
      data PGasH2BlowrUsRaw1: type=P7  # Raw Value of Gas pressure at upstream of hydrogen recirculation blower | Gas pressure at upstream of hydrogen recirculation blower: Physical raw sensor value. | Simple conversion of basic filtered electrical to physical value.
    PGasH2InjrUsConsold1  # Consolidated Value for Gas pressure at upstream of hydrogen gas injector | Gas pressure at upstream of hydrogen gas injector: Consolidated physical value, either a measured value or a modeled value. | Finally filtered and offset corrected, consolidated value. Virtual physical sensor value that comes as close as possible to the technical signal. In case of inability to provide a physical sensor value (e.g. failure, implausibility or other reasons) a substitute value or a default value or a frozen value is provided.
      data PGasH2InjrUsConsold1: type=P7  # Consolidated Value for Gas pressure at upstream of hydrogen gas injector | Gas pressure at upstream of hydrogen gas injector: Consolidated physical value, either a measured value or a modeled value. | Finally filtered and offset corrected, consolidated value. Virtual physical sensor value that comes as close as possible to the technical signal. In case of inability to provide a physical sensor value (e.g. failure, implausibility or other reasons) a substitute value or a default value or a frozen value is provided.
    PGasH2InjrUsEstimd1  # Estimated Value of Gas pressure at upstream of hydrogen gas injector | Gas pressure at upstream of hydrogen gas injector: Modeled physical sensor value or standard sensor value. | The estimated value can be used as a replacement for the finally filtered and offset corrected physical sensor value.
      data PGasH2InjrUsEstimd1: type=P7  # Estimated Value of Gas pressure at upstream of hydrogen gas injector | Gas pressure at upstream of hydrogen gas injector: Modeled physical sensor value or standard sensor value. | The estimated value can be used as a replacement for the finally filtered and offset corrected physical sensor value.
    PGasH2InjrUsMeasd1  # Measured Value of Gas pressure at upstream of hydrogen gas injector | Gas pressure at upstream of hydrogen gas injector: Final filtered and offset corrected physical sensor value. | Physical sensor value/standard sensor value. The physical sensor value is the linearized and filtered physical raw sensor value including offset. At this step, a significant phase shift could be possible.
      data PGasH2InjrUsMeasd1: type=P7  # Measured Value of Gas pressure at upstream of hydrogen gas injector | Gas pressure at upstream of hydrogen gas injector: Final filtered and offset corrected physical sensor value. | Physical sensor value/standard sensor value. The physical sensor value is the linearized and filtered physical raw sensor value including offset. At this step, a significant phase shift could be possible.
    PGasH2InjrUsRaw1  # Raw Value of Gas pressure at upstream of hydrogen gas injector | Gas pressure at upstream of hydrogen gas injector: Physical raw sensor value. | Simple conversion of basic filtered electrical to physical value.
      data PGasH2InjrUsRaw1: type=P7  # Raw Value of Gas pressure at upstream of hydrogen gas injector | Gas pressure at upstream of hydrogen gas injector: Physical raw sensor value. | Simple conversion of basic filtered electrical to physical value.
    PH2BlowrDifConsold1  # Consolidated Value for Pressure difference across hydrogen recirculation blower | Pressure difference across hydrogen recirculation blower: Consolidated physical value, either a measured value or a modeled value. | Finally filtered and offset corrected, consolidated value. Virtual physical sensor value that comes as close as possible to the technical signal. In case of inability to provide a physical sensor value (e.g. failure, implausibility or other reasons) a substitute value or a default value or a frozen value is provided.
      data PH2BlowrDifConsold1: type=P7  # Consolidated Value for Pressure difference across hydrogen recirculation blower | Pressure difference across hydrogen recirculation blower: Consolidated physical value, either a measured value or a modeled value. | Finally filtered and offset corrected, consolidated value. Virtual physical sensor value that comes as close as possible to the technical signal. In case of inability to provide a physical sensor value (e.g. failure, implausibility or other reasons) a substitute value or a default value or a frozen value is provided.
    PH2BlowrDifEstimd1  # Estimated Value of Pressure difference across hydrogen recirculation blower | Pressure difference across hydrogen recirculation blower: Modeled physical sensor value or standard sensor value. | The estimated value can be used as a replacement for the finally filtered and offset corrected physical sensor value.
      data PH2BlowrDifEstimd1: type=P7  # Estimated Value of Pressure difference across hydrogen recirculation blower | Pressure difference across hydrogen recirculation blower: Modeled physical sensor value or standard sensor value. | The estimated value can be used as a replacement for the finally filtered and offset corrected physical sensor value.
    PH2BlowrDifMeasd1  # Measured Value of Pressure difference across hydrogen recirculation blower | Pressure difference across hydrogen recirculation blower: Final filtered and offset corrected physical sensor value. | Physical sensor value/standard sensor value. The physical sensor value is the linearized and filtered physical raw sensor value including offset. At this step, a significant phase shift could be possible.
      data PH2BlowrDifMeasd1: type=P7  # Measured Value of Pressure difference across hydrogen recirculation blower | Pressure difference across hydrogen recirculation blower: Final filtered and offset corrected physical sensor value. | Physical sensor value/standard sensor value. The physical sensor value is the linearized and filtered physical raw sensor value including offset. At this step, a significant phase shift could be possible.
    PH2BlowrDifRaw1  # Raw Value of Pressure difference across hydrogen recirculation blower | Pressure difference across hydrogen recirculation blower: Physical raw sensor value. | Simple conversion of basic filtered electrical to physical value.
      data PH2BlowrDifRaw1: type=P7  # Raw Value of Pressure difference across hydrogen recirculation blower | Pressure difference across hydrogen recirculation blower: Physical raw sensor value. | Simple conversion of basic filtered electrical to physical value.
    PHumrCtdeDsConsold1  # Consolidated Value for Air pressure downstream cathode humidifier | Air pressure downstream cathode humidifier: Consolidated physical value, either a measured value or a modeled value. | Finally filtered and offset corrected, consolidated value. Virtual physical sensor value that comes as close as possible to the technical signal. In case of inability to provide a physical sensor value (e.g. failure, implausibility or other reasons) a substitute value or a default value or a frozen value is provided.
      data PHumrCtdeDsConsold1: type=P7  # Consolidated Value for Air pressure downstream cathode humidifier | Air pressure downstream cathode humidifier: Consolidated physical value, either a measured value or a modeled value. | Finally filtered and offset corrected, consolidated value. Virtual physical sensor value that comes as close as possible to the technical signal. In case of inability to provide a physical sensor value (e.g. failure, implausibility or other reasons) a substitute value or a default value or a frozen value is provided.
    PHumrCtdeDsEstimd1  # Estimated Value of Air pressure downstream cathode humidifier | Air pressure downstream cathode humidifier: Modeled physical sensor value or standard sensor value. | The estimated value can be used as a replacement for the finally filtered and offset corrected physical sensor value.
      data PHumrCtdeDsEstimd1: type=P7  # Estimated Value of Air pressure downstream cathode humidifier | Air pressure downstream cathode humidifier: Modeled physical sensor value or standard sensor value. | The estimated value can be used as a replacement for the finally filtered and offset corrected physical sensor value.
    PHumrCtdeDsMeasd1  # Measured Value of Air pressure downstream cathode humidifier | Air pressure downstream cathode humidifier: Final filtered and offset corrected physical sensor value. | Physical sensor value/standard sensor value. The physical sensor value is the linearized and filtered physical raw sensor value including offset. At this step, a significant phase shift could be possible.
      data PHumrCtdeDsMeasd1: type=P7  # Measured Value of Air pressure downstream cathode humidifier | Air pressure downstream cathode humidifier: Final filtered and offset corrected physical sensor value. | Physical sensor value/standard sensor value. The physical sensor value is the linearized and filtered physical raw sensor value including offset. At this step, a significant phase shift could be possible.
    PHumrCtdeDsRaw1  # Raw Value of Air pressure downstream cathode humidifier | Air pressure downstream cathode humidifier: Physical raw sensor value. | Simple conversion of basic filtered electrical to physical value.
      data PHumrCtdeDsRaw1: type=P7  # Raw Value of Air pressure downstream cathode humidifier | Air pressure downstream cathode humidifier: Physical raw sensor value. | Simple conversion of basic filtered electrical to physical value.
    PanicAlrmAcoustCmd1  # Panic Alarm Acoustic Command | Request to start/stop panic alarm sequence by audible device like alarm horn/vehicle horn/Battery Backed Sounder (BBS)
      data Cmd: type=OnOff1  # OFF - acoustic alarm not requested ON - acoustic alarm requested
    PanicAlrmSt1  # Panic Alarm Status | Status of panic alarm information about panic alarm for usage of the other components: management of priorities between alarm and panic horn sequences
      data St: type=OnOff1  # Off - inactive On - active
    PanicAlrmSts1  # Panic Alarm Status | Status of panic alarm information about panic alarm for usage of the other components: management of priorities between alarm and panic horn sequences
      data Sts: type=OnOff1  # Off - inactive On - active
    PanicAlrmVisCmd1  # Panic Alarm Visual Command | Visual panic alarm activation request
      data Cmd: type=OnOff1  # OFF - visual alarm not requested ON - visual alarm requested
    PanicTog1  # Panic Toggle | Toggle switch for panic alarm activation
      data Req: type=OnOff1
    PaseActvnSt1  # Pase Activation Status | Activate or deactivate the Passive Entry (PASE) system considering vehicle mode information
      data St: type=OnOff1  # - Not Activated - Activated
    PaseActvnSts1  # Pase Activation Status | Activate or deactivate the Passive Entry (PASE) system considering vehicle mode information
      data Sts: type=OnOff1  # - Not Activated - Activated
    PaseKeylsInvldSt1  # Pase Keyless Invalid Status | Information to know if the Passive Entry (PASE) key is valid or not
      data St: type=InvldVld1  # - Invalid -Valid
    PaseKeylsInvldSts1  # Pase Keyless Invalid Status | Information to know if the Passive Entry (PASE) key is valid or not
      data Sts: type=InvldVld1  # - Invalid -Valid
    PasePanicReq1  # Pase Panic Request | Request to activate panic alarm from Passive Entry (PASE)
      data Req: type=OnOff1  # OFF - no request ON - request active
    PinionSteerAg1  # Pinion Steering Angle 1 | Generic interface for Pinion Steer Angle
      data PinionSteerAg: type=Ag4
    PinionSteerAgSpd1  # Pinion Steering Angle Speed 1 | Generic interface for pinion steer angle speed
      data PinionSteerAgSpd: type=AgSpd1
    PitchRate1  # Pitch Rate 1 | Generic Pitch rate along vehicle y-axis. Coordinate system according to ISO 8855
      data PitchRate: type=AgSpd3
    PitchRate2  # Pitch Rate for Occupant and Pedestrian Safety | Pitch Rate from sensor element. Coordinate system according to ISO 8855. Extended signal range
      data PitchRate: type=AgSpd8
    PosnSt1  # Position Status | Position of the roof
      data St: type=Perc2  # Information related to the position of the roof: 0% means Roof fully opened; 100% means roof fully closed ; between 0% and 100%, information of the aperture proportion of the roof.
    PosnSts1  # Position Status | Position of the roof
      data Sts: type=Perc2  # Information related to the position of the roof: 0% means Roof fully opened; 100% means roof fully closed ; between 0% and 100%, information of the aperture proportion of the roof.
    PresStOfOccpt1  # Presence State of Occupant | Detection of occupant
      data St: type=OccptPresSt1
    PrkgBrkActv1  # Parking Brake Active 1 | Parking brake (conventional or electrical) is activated
      data PrkgBrkActv: type=OnOff1  # 0: not active 1: active
    PrkgBrkAppldIndcn1  # Parking Brake Applied Indication | Indication to Human Machine Interface (HMI) that parking brake is activated
      data PrkgBrkAppldIndcn: type=DevSt4
    PrkgLiIndcn1  # Parking Light Indication | This interface represents the indication to switch on left, right, both or no parking lights. As long as parking lights are requested by Human Machine Interface (HMI) switch, the corresponding value has to be set. It's also used to provide indication to Human Machine Interface (HMI) (feedback for cluster) and other body domain functionalities whether the left parking lights, the right parking lights or the positioning lights are active. As long as this functionality is required the value has to be set to "on".
      data PrkgLi: type=PrkgLiIndcn1
    ProfPenSt1  # Driver Profile | Status of current selected personalization profile from profile manager. It is a common profile selectable from transponder, remote key, keyless access, Human Machine Interface (HMI)...
      data Id: type=ProfPenSt1
    ProfPenSts1  # Driver Profile | Status of current selected personalization profile from profile manager. It is a common profile selectable from transponder, remote key, keyless access, Human Machine Interface (HMI)...
      data Id: type=ProfPenSts1
    PtAccrPedlPosn1  # Powertrain: Accelerator Pedal Position | Accelerator pedal position. Accelerator pedal ratio shaped and filtered. | The calibration must ensure that the used signal range is 0 – 100 %. 0 % is driver off the pedal, offsets are removed. 100 % must be ensured at end point of the pedal. Consolidated physical value, either a measured value (Measd) or a modeled value (Estimd). Final filtered and offset-corrected consolidated actuator value/physical sensor value. Virtual physical sensor value/fused sensor value that comes as close as possible to the technical signal. If it is not possible to provide a physical sensor value (e.g. failure, implausibility or other reasons), then a substitute value/default value or a frozen value is provided.
      data PtAccrPedlPosn: type=Perc1  # Powertrain: Accelerator Pedal Position
    PtAccrPedlPosnVirt1  # Powertrain: Virtual Accelerator Pedal Position | Theoretical accelerator pedal value determined using the physical pedal value and requests from Adaptive Cruise Control or Cruise Control etc. | Example of implementation: Within Adaptive Cruise Control / Cruise Control, this is based on the total requested propulsion wheel torque from the driver or the Vehicle Longitudinal Control, otherwise, this is the "Accelerator Pedal Ratio" value. Evaluated signal, jitter free, including plausibility check, monitoring and substitute value but without filtering. 0 %: (Virtual) driver is off the pedal, offsets are removed. 100 %: Must be ensured at end point of the pedal. Must cover the 100 % as well.
      data PtAccrPedlPosnVirt: type=Perc1  # Powertrain: Virtual Accelerator Pedal Position
    PtCluEngTqMaxCluPCur1  # Powertrain: Engine Clutch Maximum Torque at Current Clutch Pressure | Maximum transmittable torque of engine clutch at current pressure. | No further explanation needed.
      data PtCluEngTqMaxCluPCur: type=Tq5  # Powertrain: Engine Clutch Maximum Torque at Current Clutch Pressure
    PtDrvrReqTqClu1  # Powertrain: Driver Request of Torque at Clutch | Torque at clutch requested by the driver. | Combination of all real and virtual driver requests, project specific including idle speed control. Virtual driver requests include cruise control, distance cruise control, vehicle speed limiter, etc. This signal shows the unfiltered driver requested torque and therefore it is not affected by driving comfort functions. The signal determines the earliest torque information in the torque chain architecture. Used to prepare transmission internal system functions to achieve a proper spontaneity according to the driver request. Predicted torque information, which is determined based on the driver pedal position or on driver assistance systems. Independent of whether the engine is running or not, this signal always delivers the torque information as if the engine is running. The calculation of this signal by the provider is not permitted to consider the inertia, which has an effect on the torque at clutch. This means that the signal must be calculated as if the inertia is 0 kg*(m^2). In hybrid projects, a limitation by the torque of the engine clutch is not visible. In projects with engine clutch, this signal is not permitted to be limited due to the state of the engine clutch.
      data PtDrvrReqTqClu: type=Tq5  # Powertrain: Driver Request of Torque at Clutch
    PtDrvrReqTqCluPredEngN1  # Powertrain: Predicted Driver Request of Torque at Clutch in Target Speed | Predicted driver requested torque at clutch at the engine speed reached in target gear. | Environmental conditions, such as altitude and temperature and engine internal limits, e.g., smoke limitation and full load limit, are considered. The calculation of this signal by the provider is not permitted to consider the inertia, which has an effect on the torque at clutch. This means that the signal must be calculated as if the inertia is 0 kg*(m^2). The calculation of this signal is based on signal See also: “Transmission: Predicted Virtual Clutch Speed in Target Gear”. References to other signals: TrsmCluNPredGearTarTrsmCluNVirtGearTar
      data PtDrvrReqTqCluPredEngN: type=Tq5  # Powertrain: Predicted Driver Request of Torque at Clutch in Target Speed
    PtEmTq1  # Powertrain: Electric Machine Torque | Torque of the electric machine at clutch. | Torque output of the electric machine at clutch level. The gear ratio between the electric machine shaft and the clutch, if present, must be considered. The calculation of this signal by the provider is not permitted to consider the inertia, which has an effect on the torque at clutch. This means that the signal must be calculated as if the inertia is 0 kg*(m^2). Timing and accuracy requirements on this torque signal have to be defined in close cooperation of engine and transmission experts, especially for combined engine and electric machine operation.
      data PtEmTq: type=Tq5  # Powertrain: Electric Machine Torque
    PtEmTqJRotorShaft1  # Powertrain: Electric Machine Torque of Inertia at Rotor Shaft | Inertia torque of the electric machine at clutch level. Definition of the sign: An increasing speed produces a negative sign; a decreasing speed produces a positive sign. | The signal contains the dynamic torque caused by the inertia of the electric machine, which, in parallel hybrid projects, increases or decreases the torque at clutch.
      data PtEmTqJRotorShaft: type=Tq5  # Powertrain: Electric Machine Torque of Inertia at Rotor Shaft
    PtEmTqMaxCluNCur1  # Powertrain: Electric Machine Maximum Torque at Current Clutch Speed | Maximum possible torque of electric machine at clutch at current clutch speed and current operating point, including all system limitations. | Theoretical maximum possible torque output of the electric machine at clutch level with maximum possible inverter phase electric current. The current operating point is defined e.g., by the current DC-link voltage, the rotor temperature and the battery power. System limitations are, e.g., speed limits, temperature limits, electric current limits and voltage limits. The gear ratio between the electric machine shaft and the clutch is considered. The calculation of this signal by the provider is not permitted to consider the inertia, which has an effect on the torque at clutch. This means that the signal must be calculated as if the inertia is 0 kg*(m^2).
      data PtEmTqMaxCluNCur: type=Tq5  # Powertrain: Electric Machine Maximum Torque at Current Clutch Speed
    PtEmTqMinCluNCur1  # Powertrain: Electric Machine Minimum Torque at Current Clutch Speed | Minimum possible torque of electric machine at clutch at current clutch speed and current operating point, including all system limitations. | Theoretical minimum possible torque output of the electric machine at clutch level with maximum possible inverter phase electric current. The current operating point is defined e.g., by the current DC-link voltage, the rotor temperature and the battery power. System limitations are, e.g., speed limits, temperature limits, electric current limits and voltage limits. The gear ratio between the electric machine shaft and the clutch is considered. The calculation of this signal by the provider is not permitted to consider the inertia, which has an effect on the torque at clutch. This means that the signal must be calculated as if the inertia is 0 kg*(m^2).
      data PtEmTqMinCluNCur: type=Tq5  # Powertrain: Electric Machine Minimum Torque at Current Clutch Speed
    PtEmTqRelCluReq1  # Powertrain: Electric Machine Relative Torque at Clutch Requested by Powertrain | Electric machine relative torque at clutch requested by powertrain. | Torque to be implemented by the electric machine additional to the driver requested torque. Typically used to create the electric machine torque which is necessary to start the combustion engine via the engine clutch without influencing the implementation of the driver requested torque. As long as there is no torque request, the signal "Powertrain: Implementation Type of Electric Machine Relative Torque at Clutch Requested by Powertrain” is “0h = no request” and signal "Powertrain: Electric Machine Relative Torque at Clutch Requested by Powertrain” is “FFEh = Init”. This signal is closely related to signal “Powertrain: Implementation Type of the Electric Machine Relative Torque at Clutch Requested by Powertrain”. References to other signals: PtNrTypEmTqRelCluReq
      data PtEmTqRelCluReq: type=Tq5  # Powertrain: Electric Machine Relative Torque at Clutch Requested by Powertrain
    PtEmTqReq1  # Powertrain: Requested Electric Machine Torque | Requested electric machine torque, including all interventions, including all limitations. | The signal contains the limitations which are closely related to the electric machine or which are attributed to the electric machine by the powertrain coordinator. The content of this signal is related to the clutch level, so a possibly installed ratio between the rotor of the electric machine and the clutch is considered. The calculation of this signal by the provider is not permitted to consider the inertia, which has an effect on the torque at clutch. This means that the signal must be calculated as if the inertia is 0 kg*(m^2). The signal contains all interventions. The goal is that the torque information is sent 50 – 80 ms ahead of the desired real/physical torque.
      data PtEmTqReq: type=Tq5  # Powertrain: Requested Electric Machine Torque
    PtEmTqResvReq1  # Powertrain: Torque Reserve Electric Machine Requested by Powertrain | Torque reserve of the electric machine, might be used to start the combustion engine. | This torque reserve is the sum of “Engine: Minimum Torque at Crankshaft Reduced by Ancillary Losses” and the torque necessary to compensate for the inertia, if it is used to start the combustion engine. If no torque reserve is necessary, then the signal is set to 0 Nm. References to other signals: EngTqCrksftRedByAncllryLossMin
      data PtEmTqResvReq: type=Tq5  # Powertrain: Torque Reserve Electric Machine Requested by Powertrain
    PtFlgAcDeactvt1  # Powertrain: Request to Deactivate Air Conditioner (A/C) | Request to deactivate Air Conditioner (A/C) 0 = no deactivation of A/C requested 1 = deactivation of A/C requested
    PtFlgAcDeactvtReq1  # Powertrain: Request to Deactivate Air Conditioner (A/C) | Request to deactivate Air Conditioner (A/C) 0 = no deactivation of A/C requested 1 = deactivation of A/C requested.
      data PtFlgAcDeactvtReq: type=Flg1
    PtFlgAltDeactvt1  # Powertrain: Request to Deactivate Alternator (Generator) | Request to deactivate Alternator (generator) 0 = no deactivation of Alternator requested 1 = deactivation of Alternator requested
      data PtFlgAltDeactvt: type=Flg1
    PtFlgAltDeactvtReq1  # Powertrain: Request to Deactivate Alternator (Generator) | Request to deactivate Alternator (generator) 0 = no deactivation of Alternator requested 1 = deactivation of Alternator requested.
      data PtFlgAltDeactvtReq: type=Flg1
    PtFlgDrvOvrdVlc1  # Powertrain: Driver Request Overrides Vehicle Longitudinal Control (VLC) | Flag is set to 1 if driver request overrides Vehicle Longitudinal Control (VLC), otherwise the flag is set to 0
      data PtFlgDrvOvrdVlc: type=Flg1
    PtFlgEngRun1  # Powertrain: Engine Is Running | Powertrain: Cranking finished and engine is running 0 = engine not running 1 = engine running
      data PtFlgEngRun: type=Flg1
    PtFlgEngStop1  # Powertrain: Engine Is Stopped | Powertrain: Engine is stopped 0 = engine not stopped 1 = engine stopped
      data PtFlgEngStop: type=Flg1
    PtFlgEngStopReq1  # Powertrain: Engine Stop Request | Powertrain: Engine stop request 0 = no request to stop engine 1 = request to stop engine
      data PtFlgEngStopReq: type=Flg1
    PtFlgEngStopReqAllwd1  # Powertrain: Request to Stop Engine Is Allowed | Powertrain: Request to stop engine is allowed 0 = request to stop engine not allowed 1 = request to stop engine allowed
      data PtFlgEngStopReqAllwd: type=Flg1
    PtFlgEngStrtReq1  # Powertrain: Engine Start Request | Powertrain: Engine start request 0 = no request to start engine 1 = request to start engine
      data PtFlgEngStrtReq: type=Flg1
    PtFlgEngStrtReqAllwd1  # Powertrain: Request to Start Engine Is Allowed | Powertrain: Request to start engine is allowed 0 = request to start engine not allowed 1 = request to start engine allowed
      data PtFlgEngStrtReqAllwd: type=Flg1
    PtFlgHvacDeactvt1  # Powertrain: Request to Deactivate Air Conditioner (A/C) | Request to deactivate Air Conditioner (A/C) 0 = no deactivation of A/C requested 1 = deactivation of A/C requested
      data PtFlgHvacDeactvt: type=Flg1
    PtFlgNoTqWhlReq1  # Powertrain: No Torque Request for Wheel Torque | Wheel torque request below or equal a certain threshold. Torque demands considered : Driver (accelerator pedal), Cruise Control, Adaptive Cruise Control, Variable Vehicle Speed Limitation, Torque increase by Electronic Stability Control (ESC) [engine drag torque control (MSR)] | 0: Torque request above threshold 1: Torque request below or equal threshold e.g. threshold could be given by loss torques or a calibration value
      data PtFlgNoTqWhlReq: type=Flg1
    PtFlgTqDecPsbl1  # Powertrain: Torque Decrease Possible | A decrease of powertrain torque is possible (especially for Electronic Stability Control (ESC)). | If the limit of torque realization is reached during an intervention, the bit will change to false. 0 = decrease of powertrain torque is not possible 1 = decrease of powertrain torque is possible
      data PtFlgTqDecPsbl: type=Flg1  # A decrease of powertrain torque is possible (especially for Electronic Stability Control (ESC)). | If the limit of torque realization is reached during an intervention, the bit will change to false. 0 = decrease of powertrain torque is not possible 1 = decrease of powertrain torque is possible
    PtFlgTqIncPsbl1  # Powertrain: Torque Increase Possible | An increase of powertrain torque is possible (especially for Electronic Stability Control (ESC)). | If the limit of torque realization is reached during an intervention, the bit will change to false. 0 = increase of powertrain torque is not possible 1 = increase of powertrain torque is possible
      data PtFlgTqIncPsbl: type=Flg1  # An increase of powertrain torque is possible (especially for Electronic Stability Control (ESC)). | If the limit of torque realization is reached during an intervention, the bit will change to false. 0 = increase of powertrain torque is not possible 1 = increase of powertrain torque is possible
    PtFuCutCoastActv1  # Powertrain: Fuel Cut-Off in Coast Active | Fuel cut-off in coast is active. | Fuel cut-off is active for all cylinders of the combustion engine. Typically used for activating adaptation functions in the transmission controller. At initialization, "fuel cut-off inactive" is sent. 0 = Fuel cut-off is inactive 1 = Fuel cut-off is active
      data PtFuCutCoastActv: type=Flg1  # Powertrain: Fuel Cut-Off in Coast Active
    PtGearLvrLockReq1  # Powertrain: Gear Lever Lock Request | Locking the gear lever is requested by powertrain. | Locking the gear lever is requested by the powertrain. Typically used to lock the gear lever in the parking position until the driver presses the brake to prevent an unintended vehicle acceleration. The signal is also named "Shift Lock Request". 0 = not requested 1 = requested
      data PtGearLvrLockReq: type=ReqSt1  # Powertrain: Gear Lever Lock Request
    PtKdDetd1  # Powertrain: Kickdown Detected | Accelerator pedal is in a kickdown position. | The kickdown switch is pressed or the accelerator pedal position is greater than a threshold. 0 = no kickdown (Flag reset) 1 = kickdown (Flag set)
      data PtKdDetd: type=Flg1  # Powertrain: Kickdown Detected
    PtNClu1  # Speed at Clutch from Powertrain | This interface is used only for vehicles, where the engine speed can be different from the speed at converter or clutch. This signal is a combination of the engine speed and the speed of the electric machine, at the engine/electric machine side of the transmission clutch or converter. | Definition of "Clutch": Signal is sent with initialisation. for Automatic Transmission (AT), Continuously Variable Transmission (CVT) it is the converter clutch for Manual Transmission (MT), Automatic Manual Transmission (AMT) it is the clutch between the gear box and the engine drivetrain.
      data PtNClu: type=N1
    PtNEngSp1  # Powertrain: Engine Speed Setpoint | calculated engine speed setpoint e.g. idle engine speed setpoint during idle | Default value after reset: zero
      data PtNEngSp: type=N1
    PtRatTqDistbnReq1  # Powertrain: Requested Percental Distribution of Torque to Wheels | This interface only considers the torque which can be distributed from one or more central torque producers to the wheels by the transmission system. It does not consider additional torque producers located e.g. at the individual wheels. Where no torque is distributed to the wheels by the transmission system (e.g. one axle not driven or directly driven by an electric machine), the respective values are zero. The sum of all 4 values must be 100%.
      4 x data, all with type=Perc1:
        PtRatTqDistbnReqFrntLe  # Front left wheel
        PtRatTqDistbnReqFrntRi  # Front right wheel
        PtRatTqDistbnReqReLe  # Rear left wheel
        PtRatTqDistbnReqReRi  # Rear right wheel
    PtTqClu1  # Powertrain: Torque at Clutch | Indicated torque of combustion engine plus torque of electric machine, if present, plus internal engine torque losses plus all losses with an effect on the torque at clutch. The effect of inertia on the torque is not considered. | Torque at clutch is a torque at the mechanical interface between engine and transmission. For manual transmissions, the mechanical interface is the primary side of the clutch, for automatic transmissions, this is the primary side of the converter. Torque at clutch considers the following contributors, if present: 1) Indicated torque of combustion engine, calculated on basis of injection timing and injected fuel, ignition angle and air mass. 2) Torque of electric machine at clutch level. 3) Internal engine torque losses such as friction, pumping, mechanically driven water pump, etc. 4) Ancillary torque losses with an effect on the torque at clutch caused by the alternator, air conditioning, power steering, etc. The calculation of this signal by the provider is not permitted to consider the inertia, which has an effect on the torque at clutch. This means that the signal must be calculated as if the inertia is 0 kg*(m^2). Loss differences from engine to engine and variable torque losses over the life cycle must be considered. In parallel hybrid projects, the combustion engine torque must be considered depending on the engine clutch state. If there is a mechanically driven transmission oil pump, then the oil pump is a consumer of the transmission, not a consumer of the engine. So the oil pump drive torque is not permitted to be subtracted by the provider of this signal. The signal can be calculated based on “Engine: Torque at Crankshaft”, so this signal includes all torque requests from accelerator pedal, cruise control, speed limiter, etc. and all interventions such as torque and speed interventions. Hint for implementation: The torque is a cylinder average, not a time average, via two crankshaft revolutions of all cylinders, in consideration of the current operating parameters. The operating parameters include engine temperature, ignition timing and air mass measured or calculated, lambda, fuel cut level, fuel quantity, injection timing, knock control adaption, geographic altitude and others. References to other signals: EngTqCrksft
      data PtTqClu: type=Tq5  # Powertrain: Torque at Clutch
