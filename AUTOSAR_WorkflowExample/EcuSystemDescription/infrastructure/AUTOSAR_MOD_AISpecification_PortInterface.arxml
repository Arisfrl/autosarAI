[part 2 of 2: package /AUTOSAR_AISpecification/PortInterfaces]
AUTOSAR XML (schema 00054)
package /AUTOSAR_AISpecification/PortInterfaces  (continued)
  691 x sender receiver interface:  (continued)
    PtTqCluDyn1  # Powertrain: Dynamic Torque at Clutch | This interface has to consider all engine internal and auxiliary inertia torques, but no transmission inertia torques. | Example of usage: Used for Transmission to calculate a predictive slipping time of the clutch to prepare an ideal termination of shifting. Note the definition of "dynamic torque correction": This signal has to consider all internal inertia torques of specific components. Dynamic Torque at Clutch = Torque At Clutch + Engine dynamic moment of inertia. Default value after reset is zero.
      data PtTqCluDyn: type=Tq5
    PtTqCluEngMaxProtnReq1  # Powertrain: Maximum Torque at Engine Clutch Requested by Powertrain Coordinator for Engine Clutch Protection | Maximum torque for engine clutch protection, independent of direction/ sign of the torque. | The maximum torque is independent of the sign of the torque, i.e. of the direction of the torque flow. The actual torque at engine clutch depends on the combustion engine torque, the electric machine torque, the transmission input torque and on the torque of inertia.
      data PtTqCluEngMaxProtnReq: type=Tq5  # Powertrain: Maximum Torque at Engine Clutch Requested by Powertrain Coordinator for Engine Clutch Protection
    PtTqCluMaxCluNCurLongTerm1  # Powertrain: Maximum Torque at Clutch at Current Clutch Speed Long Term Attainable | Maximum possible torque at clutch at current clutch speed which is long term attainable. | For non-hybrid projects this signal reflects the full load engine torque at clutch at current engine speed which the engine could implement within a long time period, especially when maximally charged. It is calculated at current ambient pressure and air temperature and includes the static power limitation of the engine. In parallel hybrid projects, the signal is the sum of the maximum torque of combustion engine and electric machine, considering the engine clutch state. The static power limitation contains, e.g., restrictions for protection and static soot limitation. Permanent knock limitation is considered, knock control is not considered. The calculation of this signal by the provider is not permitted to consider the inertia, which has an effect on the torque at clutch. This means that the signal must be calculated as if the inertia is 0 kg*(m^2). Example for accuracy requirements in a typical series project: ±5 %.
      data PtTqCluMaxCluNCurLongTerm: type=Tq5  # Powertrain: Maximum Torque at Clutch at Current Clutch Speed Long Term Attainable
    PtTqCluMaxCluNCurShoTerm1  # Powertrain: Maximum Torque at Clutch at Current Clutch Speed Short Term Attainable | Maximum possible torque at clutch at current clutch speed which is short term attainable. | For non-hybrid projects this signal reflects the full load engine torque at clutch at current engine speed, which the engine could implement within a short time period, for example, 200 ms. This period must be defined in close cooperation between engine experts and transmission experts. It is calculated at current ambient pressure and air temperature and includes the static power limitation of the engine. In parallel hybrid projects, the signal is the sum of the maximum torque of combustion engine and electric machine, considering the engine clutch state. The static power limitation contains, e.g., restrictions for protection and static soot limitation. Permanent knock limitation is considered, knock control is not considered. The calculation of this signal by the provider is not permitted to consider the inertia, which has an effect on the torque at clutch. This means that the signal must be calculated as if the inertia is 0 kg*(m^2). Example for accuracy requirements in a typical series project: ±5 %.
      data PtTqCluMaxCluNCurShoTerm: type=Tq5  # Powertrain: Maximum Torque at Clutch at Current Clutch Speed Short Term Attainable
    PtTqCluMaxDrv1  # Powertrain: Maximum Available Torque at Clutch for Driver | Maximum possible torque at clutch at optimum conditions delivered by powertrain for driver. | Example of realization: Could take into account: current engine speed, ambient pressure, air temperature, static power limitation due to engine, auxiliaries (everything with impact to the torque output, e.g. power steering pump, Air Conditioner (A/C), generator or starter generator), smoke limitation, fuel quality correction. Including maximum overboost.
      data PtTqCluMaxDrv: type=Tq5
    PtTqCluMinByIgnRtd1  # Powertrain: Minimum Torque at Clutch By Ignition Retard | Minimum torque at clutch, which the powertrain can provide in the short term, e.g. on engine side by the minimum permitted ignition angle. Cylinder cut-off must NOT be considered. | This signal is needed by the transmission to determine the intensity of the torque intervention. The signal is necessary for the shift strategy to guarantee a comfortable operation of the powertrain system. The engine contribution to this signal is calculated at current engine speed with current air mass, current ambient pressure and current air temperature. In parallel hybrid projects, the torque coordinator must additionally consider the min. torque, which the electric machine(s) could implement at clutch in the current operating point. In projects with engine clutch, the current state of the engine clutch must be considered. The calculation of this signal by the provider is not permitted to consider the inertia, which has an effect on the torque at clutch. This means that the signal must be calculated as if the inertia is 0 kg*(m^2). Example for accuracy requirements in a typical series project: ±7 % or ±5 Nm (max. selection), max. deviation ±20 Nm.
      data PtTqCluMinByIgnRtd: type=Tq5  # Powertrain: Minimum Torque at Clutch By Ignition Retard
    PtTqCluMinDrv1  # Powertrain: Minimum Available Torque at Clutch for Driver | Minimum possible torque at clutch delivered by powertrain for driver. | Example of realization: Could take into account: Losses of auxiliaries, integral part of idle speed controller, indicated torque, engine friction, fuel cut off.
      data PtTqCluMinDrv: type=Tq5
    PtTqCluMinFast1  # Powertrain: Minimum Torque at Clutch Fast Path | Minimum torque at clutch, which the powertrain can provide in the short term, e.g. on engine side by the minimum permitted ignition angle and cylinder cut-off. | This signal is needed by the transmission to determine the intensity of the torque intervention. The engine contribution to this signal is calculated at current engine speed with current air mass, current ambient pressure and current air temperature. In parallel hybrid projects, the torque coordinator must additionally consider the min. torque, which the electric machine(s) could implement at clutch in the current operating point. In projects with engine clutch, the current state of the engine clutch must be considered. The calculation of this signal by the provider is not permitted to consider the inertia, which has an effect on the torque at clutch. This means that the signal must be calculated as if the inertia is 0 kg*(m^2). Example for accuracy requirements in a typical series project: ±7 % or ±5 Nm (max. selection), max. deviation ±20 Nm.
      data PtTqCluMinFast: type=Tq5  # Powertrain: Minimum Torque at Clutch Fast Path
    PtTqCluReqWoTrsmIntv1  # Powertrain: Requested Torque at Clutch without Transmission Intervention | Driver torque request including all interventions except transmission shift interventions and including all limitations. | Limitations include environmental conditions such as altitude, temperature, etc. and engine limitations such as soot limitation, full load limit, etc. The goal is that the torque information is sent 50 – 80 ms ahead of the desired real/physical torque. For further explanation see signal "Powertrain: Driver Request of Torque at Clutch". In parallel hybrid projects, the signal is the sum of the torque request to the electric machine and that part of the torque request to the combustion engine, which is transferred by the engine clutch. The sum does not consider the transmission intervention. References to other signals: PtDrvrReqTqClu
      data PtTqCluReqWoTrsmIntv: type=Tq5  # Powertrain: Requested Torque at Clutch without Transmission Intervention
    PtTqCluTarGear1  # Powertrain: Predicted Torque at Clutch at Target Gear | Used for Dual Clutch Transmission (DCT) to calculate the clutch pressure to terminate the shifting comfortably. This torque is calculated with actual pedal position and an engine speed at target gear. | Default value after reset is zero.
      data PtTqCluTarGear: type=Tq5
    PtTqCluWoTrsmIntv1  # Powertrain: Torque at Clutch without Transmission Intervention | Torque at clutch that would be implemented if no transmission shift interventions are active. | Outside of a transmission intervention, the signal should show the same value as "Powertrain: Torque at Clutch”. Highly dynamic torque contributions by anti jerk are not visible, in contrary to signal “Powertrain: Torque at Clutch”. During interventions, the signal should show the desired torque without considering the intervention, independent of implementation by ignition, air, cylinder cutoff. The effects of the transmission request for shifts on the air path or cylinder cutoff are NOT considered, not even if the fast path request can only be implemented by affecting the air path or cylinder cutoff. The calculation of this signal by the provider is not permitted to consider the inertia, which has an effect on the torque at clutch. This means that the signal must be calculated as if the inertia is 0 kg*(m^2). References to other signals: PtTqClu
      data PtTqCluWoTrsmIntv: type=Tq5  # Powertrain: Torque at Clutch without Transmission Intervention
    PtTqCrksftRedByAncllryLossReq1  # Powertrain: Requested Torque at Crankshaft Reduced by Ancillary Losses | Requested torque at crankshaft reduced by ancillary losses, including all interventions, including all limitations. | The signal contains the limitations which are closely related to the combustion engine or which are attributed to the combustion engine by the powertrain coordinator. The calculation of this signal by the provider is not permitted to consider the inertia, which has an effect on the torque at clutch. This means that the signal must be calculated as if the inertia is 0 kg*(m^2). The signal contains all interventions. The goal is that the torque information is sent 50 – 80 ms ahead of the desired real/physical torque.
      data PtTqCrksftRedByAncllryLossReq: type=Tq5  # Powertrain: Requested Torque at Crankshaft Reduced by Ancillary Losses
    PtTqCrksftReqFast1  # Crankshaft Torque Request to Be Realized by the Fast Path of Powertrain | Required crankshaft torque which should be generated by engine. The engine will restrict this request to its internal limits. | Example of realization: Including fast torque intervention from brake control, transmission control etc.
      data PtTqCrksftReqFast: type=Tq5
    PtTqCrksftReqSlow1  # Crankshaft Torque Request to Be Realized by the Slow Path of Powertrain | Crankshaft torque which should be realized by the slow path to prepare the engine for a future torque setpoint. The engine will restrict this request to its internal limits. | Example of realization: If there is no distinction between slow and fast path control within the engine management (e.g. for a Diesel engine), this signal can be ignored by the engine management. Without fast torque intervention from brake control, transmission control etc.
      data PtTqCrksftReqSlow: type=Tq5
    PtTqJClu1  # Powertrain: Torque of Inertia at Clutch | Dynamic moment of inertia of all components of the drive unit on clutch level. Definition of the sign: An increasing speed produces a negative sign; a decreasing speed produces a positive sign. | The signal contains the dynamic torque caused by the inertia which increases or decreases the torque at clutch. The engine internal inertia and the inertia of the ancillaries up to the clutch must be considered. In parallel hybrid projects, the inertia of combustion engine and electric machine are considered. Additionally, the inertia of engine clutch must be considered.
      data PtTqJClu: type=Tq5  # Powertrain: Torque of Inertia at Clutch
    PtTqMaxAc1  # Powertrain: Maximum Allowed Torque for A/C Compressor | Allowable torque for Air Condition (A/C) compressor. It is an engine crankshaft torque. | Examples of realization: This interface could contain either the torque that the Air Conditioning (A/C) compressor is allowed to consume in steady state the highest torque that the Air Condition (A/C) compressor is allowed to consume at any point in time
    PtTqMaxAlt1  # Powertrain: Maximum Allowed Alternator Load | Allowed mechanical load for alternator (generator) at engine crankshaft.
      data PtTqMaxAlt: type=Tq6
    PtTqMaxHvac1  # Powertrain: Maximum Allowed Torque for A/C Compressor | Allowable torque for Air Condition (A/C) compressor. It is an engine crankshaft torque. | Examples of realization: This interface could contain either the torque that the Air Conditioning (A/C) compressor is allowed to consume in steady state the highest torque that the Air Condition (A/C) compressor is allowed to consume at any point in time
      data PtTqMaxHvac: type=Tq6
    PtTqMaxSteer1  # Powertrain: Maximum Allowed Mechanical Load for Steering at Engine Crankshaft | Allowed mechanical load for steering at engine crankshaft. | In case of electric steering, this should be zero Nm, because the load is included in alternator load.
      data PtTqMaxSteer: type=Tq6
    PtTqMaxTrsmOilPmp1  # Powertrain: Maximum Allowed Transmission Oil Pump Load | Maximum allowed transmission oil pump load at engine crank shaft. | If the oil pump is driven by the engine crank shaft then this value must take into account all relevant dynamic effects. If it is an electric oil pump, the value should be zero Nm, because the load is included in alternator load. The value of this signal is converted to engine crank shaft torque by the provider.
      data PtTqMaxTrsmOilPmp: type=Tq6
    PtTqResvEng1  # Torque Reserve Request from Powertrain to Engine | Reserved torque request coordinated in the Powertrain coordinator (PTC) to be realized by the combustion engine. The coordination can consider multiple reserved torque requirements, e.g. auxiliary loads such as Air Conditioning (A/C) compressor. | Default value after reset is zero.
      data PtTqResvEng: type=Tq5
    PtTqResvReqEng1  # Torque Reserve Request from Powertrain to Engine | Reserved torque request coordinated in the Powertrain coordinator (PTC) to be realized by the combustion engine. The coordination can consider multiple reserved torque requirements, e.g. auxiliary loads such as Air Conditioning (A/C) compressor. | Default value after reset is zero.
      data PtTqResvReqEng: type=Tq5
    PtTqTotAtWhls1  # Total Powertrain Torque at Wheels | Generic interface for total powertrain torque at wheels
      data PtTqTotAtWhls: type=Tq7
    PtTqTotAtWhls2  # Total Powertrain Torque at Wheels (Min/Max) | Generic interface for total powertrain torque at wheels with elements for minimum and maximum value
      data Max: type=Tq7  # Maximum
      data Min: type=Tq7  # Minimum
    PtTqWhl1  # Total Wheel Torque Provided by Powertrain | Total wheel torque provided by powertrain (sum of torques at wheels) | This interface contains a value that is computed from "Actual torque at clutch" and other torque losses with influence on wheel torque (e.g. converter, differential). It considers all torque interventions. It includes the actual torque ratio. Negative values indicate drag torque, independently from driving direction.Default value after reset is zero.
      data PtTqWhl: type=Tq7
    PtTqWhlInd1  # Individual Torque at Wheel delivered by Powertrain | Vector of 4 values. Consolidated torque delivered by the powertrain to the individual wheels. The sum of all 4 values must be equal to actual total powertrain torque at wheels. | In case of actuator/sensor failures or if there is no possibility to determine the correct distribution, a rough estimation is done.
      4 x data, all with type=Tq7:
        PtTqWhlIndFrntLe  # Front left wheel
        PtTqWhlIndFrntRi  # Front right wheel
        PtTqWhlIndReLe  # Rear left wheel
        PtTqWhlIndReRi  # Rear right wheel
    PtTqWhlMax1  # Powertrain: Maximum Possible Total Torque at Wheels | Maximum possible total torque at wheels. | Example of realization: Could take into account: current engine speed, ambient pressure, air temperature, static power limitation due to engine, auxiliaries (everything with impact to the torque output, e.g. power steering pump, Air Conditioner (A/C), generator or starter generator), smoke limitation, fuel quality correction. Including actual overboost (whilst temporarily active triggered by driver request). The calculation of torque at wheel could take into account the current gear, hydraulic converter and all losses in the transmission system.Must be initialised to the upper limit of the chosen data type.
      data PtTqWhlMax: type=Tq7
    PtTqWhlMaxDrv1  # Maximum Possible Total Torque at Wheels at Optimum Conditions Delivered by Powertrain for Driver | Maximum possible total torque at wheels at optimum conditions delivered by powertrain for Driver | Example of realization: Could take into account: current engine speed, ambient pressure, air temperature, static power limitation due to engine, auxiliaries (everything with impact to the torque output, e.g. power steering pump, Air Conditioner (A/C), generator or starter generator), smoke limitation, fuel quality correction. Including maximum overboost. The calculation of torque at wheel could take into account the current gear, hydraulic converter and all losses in the transmission system.Must be initialised to the upper limit of the chosen data type.
      data PtTqWhlMaxDrv: type=Tq7
    PtTqWhlMin1  # Minimum Available Total Powertrain Torque at Wheels | Minimum possible total powertrain torque at wheels "for unfired engine". Lowest possible value of the torque delivered to the wheels by the powertrain assuming that complete fuel cut off is enabled. | Example of realization: Could take into account: Losses of auxiliaries, engine friction, complete fuel cut off'Must be initialised to the lower limit of the chosen data type.'
      data PtTqWhlMin: type=Tq7
    PtTqWhlMinDrv1  # Minimum Possible Total Torque at Wheels Delivered by Powertrain for Driver | Minimum possible total torque at wheels delivered by powertrain for driver | Example of realization: Could take into account: Losses of auxiliaries, integral part of idle speed controller, indicated torque, engine friction, fuel cut off'Must be initialised to the lower limit of the chosen data type.'
      data PtTqWhlMinDrv: type=Tq7
    PtTqWhlMinWoCutOff1  # Minimum Possible Total Powertrain Torque at Wheels without Complete Fuel Cut Off | Minimum possible total powertrain torque at wheels without complete fuel cut off. | Any torque value between minimum and maximum can be requested and it is expected that the Powertrain Coordinator (PTC) will deliver that value. Example of realization: Could take into account: Losses of auxiliaries, integral part of idle speed controller, indicated torque, engine friction, fuel cut off Complete fuel cut off excluded, since these are just the complete losses. This is the minimum torque value which can be achieved without any discontinuity and/or impact on emissions.Must be initialised to the lower limit of the chosen data type.
      data PtTqWhlMinWoCutOff: type=Tq7
    PtTqWhlReq1  # Powertrain: Total Requested Propulsion Wheel Torque | Total requested propulsion wheel torque (sum of torques at wheel). Output wheel torque request from powertrain coordinator (includes wheel torque requests driver / Vehicle Longitudinal Control (VLC) / Electronic Stability Control (ESC) ). | Negative values indicate drag torque, independently from driving direction.
      data PtTqWhlReq: type=Tq7
    PtTqWhlReqDrvVlc1  # Powertrain: Total Requested Propulsion Wheel Torque by the Driver or Vehicle Longitudinal Control (VLC) | Total requested propulsion wheel torque (sum of torques at wheel) by the driver or Vehicle Longitudinal Control (VLC). Result of arbitration of driver vs. driver assistance functions in powertrain coordinator. | Negative values indicate drag torque, independently from driving direction.
      data PtTqWhlReqDrvVlc: type=Tq7
    PullAidCmd1  # Pull Aid Command | This is the functional command to the actuator component to execute activation of pull/ push aid.
      data Cmd: type=PullAidCmd1
    PwrSplySt1  # Power Supply Status | Current power supply status
      data PwrSplySt: type=TerminalPosnMod1
    PwrSplySts1  # Power Supply Status | Current power supply status
      data PwrSplySts: type=TerminalPosnMod1
    RadioFrqPanicReq1  # Radio Frequency Panic Request | Request to activate Panic alarm from Radio Frequency (RF)
      data Req: type=OnOff1  # OFF - no request ON - request active
    RadioSt1  # Radio Status | Radio presence status
      data St: type=OnOff1  # Off - not present On - present
    RadioSts1  # Radio Status | Radio presence status
      data Sts: type=OnOff1  # Off - not present On - present
    RainAmntSt1  # Rain Amount Status | amount of rain detected by the rain sensor | 0 %: no rain, 100 % maximum rain, any percentage in between could be mapped into different rain amount levels
      data Amnt: type=Perc2
    RainAmntSts1  # Rain Amount Status | amount of rain detected by the rain sensor | 0 %: no rain, 100 % maximum rain, any percentage in between could be mapped into different rain amount levels
      data Amnt: type=Perc2
    RainSenErr1  # Rain Sensing Error | Provides information if there is a rain sensor failure detected (e.g. broken or no adaptation to windscreen possible)
      data St: type=DevErrSt2
    RainSenReq1  # Rain Sensing Request | Request switching on / off rain sensing and a rain sensing sensitivity level.
      data SenReq: type=OnOff1  # Request switching on / off rain sensing. After the request the value should be kept as long as no other request is sent.
      data SenSnvtyVal: type=RainSenSnvty1  # Requests the front wiper rain sensing sensitivity. Values are typically provided by Human Machine Interface (HMI). As long as a sensitivity for automatic wipe sequence is requested, the provided value of sensitivity has to be used.
    RideHeiLvl1  # Ride Height Level 1 | Generic interface for ride height level
      data RideHeiLvl: type=Len1
    RlySplyH2BlowrOnConsold1  # Consolidated Value for Switch on supply relay for the hydrogen recirculation blower | Switch on supply relay for the hydrogen recirculation blower: Consolidated physical value, either a measured value or a modeled value. | Finally filtered and offset corrected, consolidated value. Virtual physical sensor value that comes as close as possible to the technical signal. In case of inability to provide a physical sensor value (e.g. failure, implausibility or other reasons) a substitute value or a default value or a frozen value is provided.
      data RlySplyH2BlowrOnConsold1: type=Boolean  # Consolidated Value for Switch on supply relay for the hydrogen recirculation blower | Switch on supply relay for the hydrogen recirculation blower: Consolidated physical value, either a measured value or a modeled value. | Finally filtered and offset corrected, consolidated value. Virtual physical sensor value that comes as close as possible to the technical signal. In case of inability to provide a physical sensor value (e.g. failure, implausibility or other reasons) a substitute value or a default value or a frozen value is provided.
    RlySplyH2BlowrOnCpby1  # Capability for Switch on supply relay for the hydrogen recirculation blower | Switch on supply relay for the hydrogen recirculation blower: The dynamic instant capability. | The dynamic instant capability is based on output limitation but could also contain the limitation on the rate of change of the consolidated value.
      data RlySplyH2BlowrOnCpby1: type=Boolean  # Capability for Switch on supply relay for the hydrogen recirculation blower | Switch on supply relay for the hydrogen recirculation blower: The dynamic instant capability. | The dynamic instant capability is based on output limitation but could also contain the limitation on the rate of change of the consolidated value.
    RlySplyH2BlowrOnOutp1  # Output Value for Switch on supply relay for the hydrogen recirculation blower | Switch on supply relay for the hydrogen recirculation blower: Final controller output. | The output value includes the necessary control actions to reach the requested setpoint in the given system conditions. For example for realizing the requested actuator position a pre-control impulse to overcome the static friction is needed. In the case of a smart actuator, the output value might add a dedicated initialization duty cycle to wake up the actuator.
      data RlySplyH2BlowrOnOutp1: type=Boolean  # Output Value for Switch on supply relay for the hydrogen recirculation blower | Switch on supply relay for the hydrogen recirculation blower: Final controller output. | The output value includes the necessary control actions to reach the requested setpoint in the given system conditions. For example for realizing the requested actuator position a pre-control impulse to overcome the static friction is needed. In the case of a smart actuator, the output value might add a dedicated initialization duty cycle to wake up the actuator.
    RlySplyH2BlowrOnReqd1  # Requested Setpoint for Switch on supply relay for the hydrogen recirculation blower | Switch on supply relay for the hydrogen recirculation blower: Final requested physical setpoint. | The final requested physical setpoint.
      data RlySplyH2BlowrOnReqd1: type=Boolean  # Requested Setpoint for Switch on supply relay for the hydrogen recirculation blower | Switch on supply relay for the hydrogen recirculation blower: Final requested physical setpoint. | The final requested physical setpoint.
    RlySplyH2BlowrOnSp1  # Setpoint Value for Switch on supply relay for the hydrogen recirculation blower | Switch on supply relay for the hydrogen recirculation blower: Final actuator setpoint. | Final actuator setpoint.
      data RlySplyH2BlowrOnSp1: type=Boolean  # Setpoint Value for Switch on supply relay for the hydrogen recirculation blower | Switch on supply relay for the hydrogen recirculation blower: Final actuator setpoint. | Final actuator setpoint.
    RlyUHiScOnConsold1  # Consolidated Value for Switch on high voltage short circuit relay | Switch on high voltage short circuit relay: Consolidated physical value, either a measured value or a modeled value. | Finally filtered and offset corrected, consolidated value. Virtual physical sensor value that comes as close as possible to the technical signal. In case of inability to provide a physical sensor value (e.g. failure, implausibility or other reasons) a substitute value or a default value or a frozen value is provided.
      data RlyUHiScOnConsold1: type=Boolean  # Consolidated Value for Switch on high voltage short circuit relay | Switch on high voltage short circuit relay: Consolidated physical value, either a measured value or a modeled value. | Finally filtered and offset corrected, consolidated value. Virtual physical sensor value that comes as close as possible to the technical signal. In case of inability to provide a physical sensor value (e.g. failure, implausibility or other reasons) a substitute value or a default value or a frozen value is provided.
    RlyUHiScOnCpby1  # Capability for Switch on high voltage short circuit relay | Switch on high voltage short circuit relay: The dynamic instant capability. | The dynamic instant capability is based on output limitation but could also contain the limitation on the rate of change of the consolidated value.
      data RlyUHiScOnCpby1: type=Boolean  # Capability for Switch on high voltage short circuit relay | Switch on high voltage short circuit relay: The dynamic instant capability. | The dynamic instant capability is based on output limitation but could also contain the limitation on the rate of change of the consolidated value.
    RlyUHiScOnOutp1  # Output Value for Switch on high voltage short circuit relay | Switch on high voltage short circuit relay: Final controller output. | The output value includes the necessary control actions to reach the requested setpoint in the given system conditions. For example for realizing the requested actuator position a pre-control impulse to overcome the static friction is needed. In the case of a smart actuator, the output value might add a dedicated initialization duty cycle to wake up the actuator.
      data RlyUHiScOnOutp1: type=Boolean  # Output Value for Switch on high voltage short circuit relay | Switch on high voltage short circuit relay: Final controller output. | The output value includes the necessary control actions to reach the requested setpoint in the given system conditions. For example for realizing the requested actuator position a pre-control impulse to overcome the static friction is needed. In the case of a smart actuator, the output value might add a dedicated initialization duty cycle to wake up the actuator.
    RlyUHiScOnReqd1  # Requested Setpoint for Switch on high voltage short circuit relay | Switch on high voltage short circuit relay: Final requested physical setpoint. | The final requested physical setpoint.
      data RlyUHiScOnReqd1: type=Boolean  # Requested Setpoint for Switch on high voltage short circuit relay | Switch on high voltage short circuit relay: Final requested physical setpoint. | The final requested physical setpoint.
    RlyUHiScOnSp1  # Setpoint Value for Switch on high voltage short circuit relay | Switch on high voltage short circuit relay: Final actuator setpoint. | Final actuator setpoint.
      data RlyUHiScOnSp1: type=Boolean  # Setpoint Value for Switch on high voltage short circuit relay | Switch on high voltage short circuit relay: Final actuator setpoint. | Final actuator setpoint.
    RlyUHiTerminalNegOnConsold1  # Consolidated Value for Switch on high voltage negative terminal relay | Switch on high voltage negative terminal relay: Consolidated physical value, either a measured value or a modeled value. | Finally filtered and offset corrected, consolidated value. Virtual physical sensor value that comes as close as possible to the technical signal. In case of inability to provide a physical sensor value (e.g. failure, implausibility or other reasons) a substitute value or a default value or a frozen value is provided.
      data RlyUHiTerminalNegOnConsold1: type=Boolean  # Consolidated Value for Switch on high voltage negative terminal relay | Switch on high voltage negative terminal relay: Consolidated physical value, either a measured value or a modeled value. | Finally filtered and offset corrected, consolidated value. Virtual physical sensor value that comes as close as possible to the technical signal. In case of inability to provide a physical sensor value (e.g. failure, implausibility or other reasons) a substitute value or a default value or a frozen value is provided.
    RlyUHiTerminalNegOnCpby1  # Capability for Switch on high voltage negative terminal relay | Switch on high voltage negative terminal relay: The dynamic instant capability. | The dynamic instant capability is based on output limitation but could also contain the limitation on the rate of change of the consolidated value.
      data RlyUHiTerminalNegOnCpby1: type=Boolean  # Capability for Switch on high voltage negative terminal relay | Switch on high voltage negative terminal relay: The dynamic instant capability. | The dynamic instant capability is based on output limitation but could also contain the limitation on the rate of change of the consolidated value.
    RlyUHiTerminalNegOnOutp1  # Output Value for Switch on high voltage negative terminal relay | Switch on high voltage negative terminal relay: Final controller output. | The output value includes the necessary control actions to reach the requested setpoint in the given system conditions. For example for realizing the requested actuator position a pre-control impulse to overcome the static friction is needed. In the case of a smart actuator, the output value might add a dedicated initialization duty cycle to wake up the actuator.
      data RlyUHiTerminalNegOnOutp1: type=Boolean  # Output Value for Switch on high voltage negative terminal relay | Switch on high voltage negative terminal relay: Final controller output. | The output value includes the necessary control actions to reach the requested setpoint in the given system conditions. For example for realizing the requested actuator position a pre-control impulse to overcome the static friction is needed. In the case of a smart actuator, the output value might add a dedicated initialization duty cycle to wake up the actuator.
    RlyUHiTerminalNegOnReqd1  # Requested Setpoint for Switch on high voltage negative terminal relay | Switch on high voltage negative terminal relay: Final requested physical setpoint. | The final requested physical setpoint.
      data RlyUHiTerminalNegOnReqd1: type=Boolean  # Requested Setpoint for Switch on high voltage negative terminal relay | Switch on high voltage negative terminal relay: Final requested physical setpoint. | The final requested physical setpoint.
    RlyUHiTerminalNegOnSp1  # Setpoint Value for Switch on high voltage negative terminal relay | Switch on high voltage negative terminal relay: Final actuator setpoint. | Final actuator setpoint.
      data RlyUHiTerminalNegOnSp1: type=Boolean  # Setpoint Value for Switch on high voltage negative terminal relay | Switch on high voltage negative terminal relay: Final actuator setpoint. | Final actuator setpoint.
    RlyUHiTerminalPosOnConsold1  # Consolidated Value for Switch on high voltage positive terminal relay | Switch on high voltage positive terminal relay: Consolidated physical value, either a measured value or a modeled value. | Finally filtered and offset corrected, consolidated value. Virtual physical sensor value that comes as close as possible to the technical signal. In case of inability to provide a physical sensor value (e.g. failure, implausibility or other reasons) a substitute value or a default value or a frozen value is provided.
      data RlyUHiTerminalPosOnConsold1: type=Boolean  # Consolidated Value for Switch on high voltage positive terminal relay | Switch on high voltage positive terminal relay: Consolidated physical value, either a measured value or a modeled value. | Finally filtered and offset corrected, consolidated value. Virtual physical sensor value that comes as close as possible to the technical signal. In case of inability to provide a physical sensor value (e.g. failure, implausibility or other reasons) a substitute value or a default value or a frozen value is provided.
    RlyUHiTerminalPosOnCpby1  # Capability for Switch on high voltage positive terminal relay | Switch on high voltage positive terminal relay: The dynamic instant capability. | The dynamic instant capability is based on output limitation but could also contain the limitation on the rate of change of the consolidated value.
      data RlyUHiTerminalPosOnCpby1: type=Boolean  # Capability for Switch on high voltage positive terminal relay | Switch on high voltage positive terminal relay: The dynamic instant capability. | The dynamic instant capability is based on output limitation but could also contain the limitation on the rate of change of the consolidated value.
    RlyUHiTerminalPosOnOutp1  # Output Value for Switch on high voltage positive terminal relay | Switch on high voltage positive terminal relay: Final controller output. | The output value includes the necessary control actions to reach the requested setpoint in the given system conditions. For example for realizing the requested actuator position a pre-control impulse to overcome the static friction is needed. In the case of a smart actuator, the output value might add a dedicated initialization duty cycle to wake up the actuator.
      data RlyUHiTerminalPosOnOutp1: type=Boolean  # Output Value for Switch on high voltage positive terminal relay | Switch on high voltage positive terminal relay: Final controller output. | The output value includes the necessary control actions to reach the requested setpoint in the given system conditions. For example for realizing the requested actuator position a pre-control impulse to overcome the static friction is needed. In the case of a smart actuator, the output value might add a dedicated initialization duty cycle to wake up the actuator.
    RlyUHiTerminalPosOnReqd1  # Requested Setpoint for Switch on high voltage positive terminal relay | Switch on high voltage positive terminal relay: Final requested physical setpoint. | The final requested physical setpoint.
      data RlyUHiTerminalPosOnReqd1: type=Boolean  # Requested Setpoint for Switch on high voltage positive terminal relay | Switch on high voltage positive terminal relay: Final requested physical setpoint. | The final requested physical setpoint.
    RlyUHiTerminalPosOnSp1  # Setpoint Value for Switch on high voltage positive terminal relay | Switch on high voltage positive terminal relay: Final actuator setpoint. | Final actuator setpoint.
      data RlyUHiTerminalPosOnSp1: type=Boolean  # Setpoint Value for Switch on high voltage positive terminal relay | Switch on high voltage positive terminal relay: Final actuator setpoint. | Final actuator setpoint.
    RoadBnkAEstimn1  # Road Bank Acceleration Estimation 1 | Acceleration component resulting from a banked road. Rotation about x-axis, angle between z-y-axis. Coordinate system according to ISO 8855. | Note that this signal will not be reliable and probably must be replaced by function specific signals, e.g. to prevent wrong interventions
      data RoadBnkAEstimn: type=A3
    RoadCdnSt1  # Road Condition Status | Road condition
      data RoadCdn: type=RoadSt1
    RoadCdnSts1  # Road Condition Status | Road condition
      data RoadCdn: type=RoadSts1
    RoadInclnAEstimn1  # Road Inclination Acceleration Estimation 1 | Acceleration component resulting from road inclination. Measured in vehicle coordinates. Estimated from longitudinal acceleration from wheel speeds and acceleration sensor.
      data RoadInclnAEstimn: type=A3  # the resolution of the inclination is the resolution of A3 divided by the earth gravity (9.81 m/s^2)
    RoadWhlAg1  # Road Wheel Angle 1 | Generic interface for road wheel angle
      data RoadWhlAg: type=Ag3
    RoadWhlAg2  # Road Wheel Angle 2 | Generic interface for total road wheel angle
      data RoadWhlAg: type=Ag4
    RoadWhlAgSpd1  # Road Wheel Angle Speed 1 | Generic interface for road wheel angle speed
      data RoadWhlAgSpd: type=AgSpd2
    RollCmpLvl1  # Roll Compensation Level 1 | The actual compensation level of the body roll angle. (100% = Zero roll angle, 0% = Both stabilizers decoupled)
      data RollCmpLvl: type=Perc2
    RollMomtmDistbn1  # Roll Momentum Distribution 1 | Estimated stabilizer roll torque difference front to rear defined relative to the total stabilizer torque (front and rear) (100%: Only stabilizer torque on front, 0%: Only stabilizer torque on rear)
      data RollMomtmDistbn: type=Perc2
    RollRate1  # Roll Rate 1 | Roll Rate from sensor element. Coordinate system according to ISO 8855.
      data RollRate: type=AgSpd3
    RollRate2  # Roll Rate 2 | Roll Rate from sensor element. Coordinate system according to ISO 8855. Extended signal range
      data RollRate: type=AgSpd4
    RollRate3  # Roll Rate for Occupant and Pedestrian Safety | Roll Rate from sensor element. Coordinate system according to ISO 8855. Extended signal range
      data RollRate: type=AgSpd8
    RoofCnvtbCmd1  # Roof Convertible Command | Command for convertible operation
      data Cmd: type=OnOff1
    RoofCnvtbReq1  # Roof Convertible Request | Request for convertible
      data Req: type=OnOff1
    RoofCnvtbSt1  # Roof Convertible Status | Status of the convertible roof [Opened or closed]
      data St: type=OpendClsd1
    RoofCnvtbSts1  # Roof Convertible Status | Status of the convertible roof [Opened or closed]
      data Sts: type=OpendClsd1
    RscCtrlDi1  # RSC Control Disable 1 | Roll Stability Control is disabled due to detected fault or ECU initialization
      data RscCtrlDi: type=DevErrSt2  # 0= Rsc enabled 1 = Rsc Control Disabled due to detected fault
    SeatAdjMan1  # Seat Adjust Manual | Request to move the axis of the seat manually to a certain direction.
      data Req: type=MovmtTyp1
    SeatBltRmnAcoustWarnReq1  # Seat Belt Reminder Acoustic Warning Request | Request to sound an acoustic warning on unbuckled occupants (only covering seat positions under control of occupant detection) dependent on optionally given adjustments
      data Req: type=ReqSt1  # 0: no acoustic warning 1: sound an acoustic warning
    SeatBltRmnFrqCtrlAcoustWarn1  # Seat Belt Reminder Frequenz Control Acoustic Warning | Control of warning frequency to sound in case of unbuckled occupants detected
      data Frq: type=Frq2
    SeatBltRmnLdnCtrlAcoustWarn1  # Seat Belt Reminder Loudness Control Acoustic Warning | Control of warning loudness to sound in case of unbuckled occupants detected
      data Vol: type=Perc2
    SeatBltRmnOpticWarnReq1  # Seat Belt Reminder Optical Warning Request | Request to display a warning on unbuckled occupants (only covering seat positions under control of occupant detection).
      data Req: type=ReqSt1  # 0: warning not active 1: warning active
    SeatBltRmnWarnSt1  # Seat Belt Reminder Warning State | Warning state of seat belt reminder control
      data WarnSt: type=SeatBltRmnWarnSt1
    SeatClimaCmd1  # Seat Climatization Command | Activation/deactivation of seat climatization actuator
      data SeatClimaCmd: type=OnOff1  # Activation/Deactivation
    SeatFixaSt1  # Seat Fixation Status | Status of seat fixation for seat position
      data St: type=Fixa1  # 0: seat position is not probably fixed (e.g. seat back) or not equipped - occupant is not able to take place on seating position 1: seat position is probably equipped and fixed - occupant is able to take place
    SeatFixaSts1  # Seat Fixation Status | Status of seat fixation for seat position
      data Sts: type=Fixa1  # 0: seat position is not probably fixed (e.g. seat back) or not equipped - occupant is not able to take place on seating position 1: seat position is probably equipped and fixed - occupant is able to take place
    SeatMoveSt1  # Seat Move Status | feedback of the seat manager which kind of action is currently running. It might be necessary to immediately stop automatic positioning if the driver hits any key (panic-stop)
      data MoveSt: type=MoveSt1
    SeatMoveSts1  # Seat Move Status | feedback of the seat manager which kind of action is currently running. It might be necessary to immediately stop automatic positioning if the driver hits any key (panic-stop)
      data MoveSts: type=MoveSts1
    SeatTCmd1  # Seat Temperature Command | Command to the seat adapter with the seat temperature level required
      data SeatT: type=T1
    SeatTVal1  # Seat Temperature Value | Feedback from the seat temperature sensor about its actual temperature level
      data SeatT: type=T1
    SetSpd1  # Set Speed 1 | Actual target speed, set by the driver. This target speed is used to control the vehicle target speed in case of free driving or Cruise Control only.
      data SetSpd: type=Spd4
    SetSpdDec1  # Set Speed Decrease | Request to decrease set speed for driver assistance system, e.g. Adaptive Cruise Control (ACC) or Cruise Control (CC) by driver.
      data SetSpdDec: type=ReqSt1  # 0: nothing 1: decrease set speed
    SetSpdInc1  # Set Speed Increase | Request to increase set speed for driver assistance system, e.g. Adaptive Cruise Control (ACC) or Cruise Control (CC) by driver.
      data SetSpdInc: type=ReqSt1  # 0: nothing 1: increase set speed
    SetSpdIndcn1  # Set Speed Indication 1 | Displayed set speed of driver assistance system, e.g. Cruise Control (CC) or Adaptive Cruise Control (ACC)
      data SetSpdIndcn: type=Spd4
    SetTiGap1  # Set Time Gap 1 | Actual time gap, set by the driver. This time gap is used to control the distance in case of vehicle detected ahead.
      data SetTiGap: type=Ti2
    SnsrAlrmSimpleSt1  # Sensor Alarm Simple Status | Status of simple alarm sensors - individual status of triggering source
      data St: type=OnOff1  # On - sensor triggered Off - sensor not triggered
    SnsrAlrmSimpleSts1  # Sensor Alarm Simple Status | Status of simple alarm sensors - individual status of triggering source
      data Sts: type=OnOff1  # On - sensor triggered Off - sensor not triggered
    SnsrGlassBreakSt1  # Sensor Glass Break Status | Status of glass break sensor - glass OK, glass broken
      data St: type=DevErrSt2  # False - glass not broken True - glass broken
    SnsrGlassBreakSts1  # Sensor Glass Break Status | Status of glass break sensor - glass OK, glass broken
      data Sts: type=DevErrSts2  # False - glass not broken True - glass broken
    SnsrInclInhbReq1  # Sensor Inclination Inhibit Request | Inhibition request by user for the inclination sensor
      data Req: type=OnOff1
    SnsrInclnCmd1  # Sensor Inclination Command | Control command of the Inclination sensor
      data Cmd
    SnsrInclnInhbReq1  # Sensor Inclination Inhibit Request | Inhibition request by user for the inclination sensor
      data Req: type=OnOff1
    SnsrIntrScanrCmd1  # Sensor Interior Scanner Command | Control command of the Interior Scanner sensor
      data Cmd
    SnsrIntrScanrInhbReq1  # Sensor Interior Scanner Inhibit Request | Inhibition request by user for the interior scanner sensor
      data Req: type=OnOff1
    SnsrRoofCnvtbSt1  # Sensor Roof Convertible Status | Status of convertible sensor required for security
      data St: type=OnOff1
    SnsrRoofCnvtbSts1  # Sensor Roof Convertible Status | Status of convertible sensor required for security
      data Sts: type=OnOff1
    SpdLat1  # Speed Lateral 1 | Lateral speed component at Center of Gravity (COG) in vehicle coordinates.
      data SpdLat: type=Spd2
    SprgCtrlTunActvReq1  # Requested Active Spring Control Tuning | Spring control tuning mode request by the driver
      data SprgCtrlTunActvReq: type=SuspMod1
    SprgCtrlTunMod1  # Spring Control Tuning Mode 1 | Spring tuning mode displayed to the driver and provided to other systems
      data SprgCtrlTunMod: type=SuspMod1
    SsmSt1  # SSM Status 1 | Generic failure status of the Stand Still Manager (SSM) request
      data SsmSt: type=DevErrSt2  # Failure status of the Stand Still Manager (SSM) .
    SsmSts1  # SSM Status 1 | Generic failure status of the Stand Still Manager (SSM) request
      data SsmSts: type=DevErrSts2  # Failure status of the Stand Still Manager (SSM) .
    StabrCtrlMod1  # Stabilizer Control Mode 1 | Stabilizer tuning mode displayed to driver and provided to other systems
      data StabrCtrlMod: type=SuspMod1
    StabrCtrlTunReq1  # Requested Stabilizer Control Tuning | Stabilizer control tuning mode request by the driver
      data StabrCtrlTunReq: type=SuspMod1
    StabrSt1  # Stabilizer Status 1 | Status provided by the active or switchable stabilizer on front and rear axle.
      data AxleFrnt: type=StabrSt1  # Front axle
      data AxleRe: type=StabrSt1  # Rear Axle
    StabrSts1  # Stabilizer Status 1 | Status provided by the active or switchable stabilizer on front and rear axle.
      data AxleFrnt: type=StabrSts1  # Front axle
      data AxleRe: type=StabrSts1  # Rear Axle
    StandStillCmftReqByAcc1  # Stand Still Comfort Request by ACC | To keep standstill requested by Adaptive Cruise Control (ACC) to Vehicle Longitudinal Control (VLC).
      data StandStillCmftReq: type=ReqSt1
    SteerAgGrdtSuppsnMaxAllwd1  # Max Allowed Steering Angle Gradient Superposition | Maximum allowed superposition steering angle gradient normalized on road wheel angle (actuator potential).
      data SteerAgGrdtMaxAllwd: type=AgSpd7
    SteerCtrlTunReq1  # Steering Control Tuning Request | Driver's requested steering controller tune
      data SteerCtrlTunReq: type=SteerMod1
    SteerDrvrAsscSysModReq1  # Steering Driver Assistance System Mode Request 1 | Request from driver to Steering Driver Assistance System, which among several functional or tuning modes has to be activated.
      data SteerDrvrAsscSysModReq: type=SteerMod1
    SteerDrvrAsscSysStIndcn1  # Steering Driver Assistance System Status Indication 1 | Indication from Steering Driver Assistance System of which functional status it has.
      data SteerDrvrAsscSysStIndcn: type=DevSt4
    SteerDrvrAsscSysStsIndcn1  # Steering Driver Assistance System Status Indication 1 | Indication from Steering Driver Assistance System of which functional status it has.
      data SteerDrvrAsscSysStsIndcn: type=DevSts4
    SteerLoadHyd1  # Steering Load Hydraulic | Generic interface for hydraulic power steering load at engine crank shaft.
      data SteerLoadHyd: type=Tq6
    SteerMotAgFrnt1  # Steering Motor Angle Front 1 | Angle of the front steering device at the steer motor (for steering angle superposition systems)
      data SteerMotAgFrnt: type=Ag5
    SteerMotAgSpdFrnt1  # Steering Motor Angle Speed Front 1 | Conditioned derivative of the angular position measured at the front steering device with respect to the motor shaft.
      data SteerMotAgSpdFrnt: type=AgSpd5
    SteerSt1  # Steering Status 1 | Error status provided by steering system
      data SteerSt: type=DevErrSt1
    SteerSts1  # Steering Status 1 | Error status provided by steering system
      data SteerSts: type=DevErrSts1
    SteerTqSum1  # Sum Steering Torque | Sum of driver steering torque and delta torque by Steering Vehicle Stability Control
      data SteerTqSum: type=Tq15
    SteerTqSuppsnFrntSt1  # Steer Torque Superposition Front Status 1 | Status of the Basic Steering Torque Superposition that indicates whether it is able to apply the requested delta torque or not.
      data SteerTqSuppsnFrntSt: type=AvlSt1
    SteerTqSuppsnFrntSts1  # Steer Torque Superposition Front Status 1 | Status of the Basic Steering Torque Superposition that indicates whether it is able to apply the requested delta torque or not.
      data SteerTqSuppsnFrntSts: type=AvlSts1
    SteerVehStabyCtrlMod1  # Steering Vehicle Stability Control Mode 1 | Steering vehicle stability mode in operation.
      data SteerVehStabyCtrlMod: type=SteerVehStabyCtrlMod1
    SteerVehStabyCtrlModReq1  # Steering Vehicle Stability Control Mode Request | Driver's requested steering vehicle stability control system mode.
      data SteerVehStabyCtrlModReq: type=SteerVehStabyCtrlMod1
    SteerWhlAg1  # Steering Wheel Angle 1 | generic interface for Steering Wheel Angle
      data SteerWhlAg: type=Ag4
    SteerWhlAgSpd1  # Steering Wheel Angle Speed 1 | Conditioned (offset-compensated, filtered) steering wheel angle speed. E.g. measured by a sensor located between the steering wheel and the Steering Angle Superposition system (if available). Does not include steering kinematic effects. Derived from measured steering wheel angular position.
      data SteerWhlAgSpd: type=AgSpd1
    StgDisp1  # Display Stage | Display feedback of Stage active (cooling or heating) to Human Machine Interface (HMI)
      data StgDisp: type=StgOfSeatClima1  # Cooling/Heating
    StgReq1  # Stage Request | Indication of stage request from button adapter to request for heating or cooling the seat
      data StgReq: type=StgOfSeatClima1  # Cooling/Heating
    SuspCtrlTunReq1  # Requested Suspension Control Tuning | Request to Suspension to switch between several functional or tuning modes
      data SuspCtrlTunReq: type=SuspMod1
    SuspMod1  # Suspension Mode 1 | Suspension tuning mode displayed to the driver
      data SuspMod: type=SuspMod1
    SwilSprgSt1  # Switchable Spring Status 1 | Status provided by switchable spring.
      data SwilSprgSt: type=DevSt4
    SwilSprgSts1  # Switchable Spring Status 1 | Status provided by switchable spring.
      data SwilSprgSts: type=DevSts4
    SwtStrtSt1  # Switch Start Status | Information on push start switch
      data St: type=OnOff1
    SwtStrtSts1  # Switch Start Status | Information on push start switch
      data Sts: type=OnOff1
    TAirComprHiUsConsold1  # Consolidated Value for Air temperature upstream high pressure compressor | Air temperature upstream high pressure compressor: Consolidated physical value, either a measured value or a modeled value. | Finally filtered and offset corrected, consolidated value. Virtual physical sensor value that comes as close as possible to the technical signal. In case of inability to provide a physical sensor value (e.g. failure, implausibility or other reasons) a substitute value or a default value or a frozen value is provided.
      data TAirComprHiUsConsold1: type=T6  # Consolidated Value for Air temperature upstream high pressure compressor | Air temperature upstream high pressure compressor: Consolidated physical value, either a measured value or a modeled value. | Finally filtered and offset corrected, consolidated value. Virtual physical sensor value that comes as close as possible to the technical signal. In case of inability to provide a physical sensor value (e.g. failure, implausibility or other reasons) a substitute value or a default value or a frozen value is provided.
    TAirComprHiUsEstimd1  # Estimated Value of Air temperature upstream high pressure compressor | Air temperature upstream high pressure compressor: Modeled physical sensor value or standard sensor value. | The estimated value can be used as a replacement for the finally filtered and offset corrected physical sensor value.
      data TAirComprHiUsEstimd1: type=T6  # Estimated Value of Air temperature upstream high pressure compressor | Air temperature upstream high pressure compressor: Modeled physical sensor value or standard sensor value. | The estimated value can be used as a replacement for the finally filtered and offset corrected physical sensor value.
    TAirComprHiUsMeasd1  # Measured Value of Air temperature upstream high pressure compressor | Air temperature upstream high pressure compressor: Final filtered and offset corrected physical sensor value. | Physical sensor value/standard sensor value. The physical sensor value is the linearized and filtered physical raw sensor value including offset. At this step, a significant phase shift could be possible.
      data TAirComprHiUsMeasd1: type=T6  # Measured Value of Air temperature upstream high pressure compressor | Air temperature upstream high pressure compressor: Final filtered and offset corrected physical sensor value. | Physical sensor value/standard sensor value. The physical sensor value is the linearized and filtered physical raw sensor value including offset. At this step, a significant phase shift could be possible.
    TAirComprHiUsRaw1  # Raw Value of Air temperature upstream high pressure compressor | Air temperature upstream high pressure compressor: Physical raw sensor value. | Simple conversion of basic filtered electrical to physical value.
      data TAirComprHiUsRaw1: type=T6  # Raw Value of Air temperature upstream high pressure compressor | Air temperature upstream high pressure compressor: Physical raw sensor value. | Simple conversion of basic filtered electrical to physical value.
    TAirFilDsConsold1  # Consolidated Value for Air temperature downstream air filter | Air temperature downstream air filter: Consolidated physical value, either a measured value or a modeled value. | Finally filtered and offset corrected, consolidated value. Virtual physical sensor value that comes as close as possible to the technical signal. In case of inability to provide a physical sensor value (e.g. failure, implausibility or other reasons) a substitute value or a default value or a frozen value is provided.
      data TAirFilDsConsold1: type=T6  # Consolidated Value for Air temperature downstream air filter | Air temperature downstream air filter: Consolidated physical value, either a measured value or a modeled value. | Finally filtered and offset corrected, consolidated value. Virtual physical sensor value that comes as close as possible to the technical signal. In case of inability to provide a physical sensor value (e.g. failure, implausibility or other reasons) a substitute value or a default value or a frozen value is provided.
    TAirFilDsEstimd1  # Estimated Value of Air temperature downstream air filter | Air temperature downstream air filter: Modeled physical sensor value or standard sensor value. | The estimated value can be used as a replacement for the finally filtered and offset corrected physical sensor value.
      data TAirFilDsEstimd1: type=T6  # Estimated Value of Air temperature downstream air filter | Air temperature downstream air filter: Modeled physical sensor value or standard sensor value. | The estimated value can be used as a replacement for the finally filtered and offset corrected physical sensor value.
    TAirFilDsMeasd1  # Measured Value of Air temperature downstream air filter | Air temperature downstream air filter: Final filtered and offset corrected physical sensor value. | Physical sensor value/standard sensor value. The physical sensor value is the linearized and filtered physical raw sensor value including offset. At this step, a significant phase shift could be possible.
      data TAirFilDsMeasd1: type=T6  # Measured Value of Air temperature downstream air filter | Air temperature downstream air filter: Final filtered and offset corrected physical sensor value. | Physical sensor value/standard sensor value. The physical sensor value is the linearized and filtered physical raw sensor value including offset. At this step, a significant phase shift could be possible.
    TAirFilDsRaw1  # Raw Value of Air temperature downstream air filter | Air temperature downstream air filter: Physical raw sensor value. | Simple conversion of basic filtered electrical to physical value.
      data TAirFilDsRaw1: type=T6  # Raw Value of Air temperature downstream air filter | Air temperature downstream air filter: Physical raw sensor value. | Simple conversion of basic filtered electrical to physical value.
    TCooltStckInConsold1  # Consolidated Value for Coolant temperature at stack inlet | Coolant temperature at stack inlet: Consolidated physical value, either a measured value or a modeled value. | Finally filtered and offset corrected, consolidated value. Virtual physical sensor value that comes as close as possible to the technical signal. In case of inability to provide a physical sensor value (e.g. failure, implausibility or other reasons) a substitute value or a default value or a frozen value is provided.
      data TCooltStckInConsold1: type=T6  # Consolidated Value for Coolant temperature at stack inlet | Coolant temperature at stack inlet: Consolidated physical value, either a measured value or a modeled value. | Finally filtered and offset corrected, consolidated value. Virtual physical sensor value that comes as close as possible to the technical signal. In case of inability to provide a physical sensor value (e.g. failure, implausibility or other reasons) a substitute value or a default value or a frozen value is provided.
    TCooltStckInEstimd1  # Estimated Value of Coolant temperature at stack inlet | Coolant temperature at stack inlet: Modeled physical sensor value or standard sensor value. | The estimated value can be used as a replacement for the finally filtered and offset corrected physical sensor value.
      data TCooltStckInEstimd1: type=T6  # Estimated Value of Coolant temperature at stack inlet | Coolant temperature at stack inlet: Modeled physical sensor value or standard sensor value. | The estimated value can be used as a replacement for the finally filtered and offset corrected physical sensor value.
    TCooltStckInMeasd1  # Measured Value of Coolant temperature at stack inlet | Coolant temperature at stack inlet: Final filtered and offset corrected physical sensor value. | Physical sensor value/standard sensor value. The physical sensor value is the linearized and filtered physical raw sensor value including offset. At this step, a significant phase shift could be possible.
      data TCooltStckInMeasd1: type=T6  # Measured Value of Coolant temperature at stack inlet | Coolant temperature at stack inlet: Final filtered and offset corrected physical sensor value. | Physical sensor value/standard sensor value. The physical sensor value is the linearized and filtered physical raw sensor value including offset. At this step, a significant phase shift could be possible.
    TCooltStckInRaw1  # Raw Value of Coolant temperature at stack inlet | Coolant temperature at stack inlet: Physical raw sensor value. | Simple conversion of basic filtered electrical to physical value.
      data TCooltStckInRaw1: type=T6  # Raw Value of Coolant temperature at stack inlet | Coolant temperature at stack inlet: Physical raw sensor value. | Simple conversion of basic filtered electrical to physical value.
    TCooltStckOutConsold1  # Consolidated Value for Coolant temperature at stack outlet | Coolant temperature at stack outlet: Consolidated physical value, either a measured value or a modeled value. | Finally filtered and offset corrected, consolidated value. Virtual physical sensor value that comes as close as possible to the technical signal. In case of inability to provide a physical sensor value (e.g. failure, implausibility or other reasons) a substitute value or a default value or a frozen value is provided.
      data TCooltStckOutConsold1: type=T6  # Consolidated Value for Coolant temperature at stack outlet | Coolant temperature at stack outlet: Consolidated physical value, either a measured value or a modeled value. | Finally filtered and offset corrected, consolidated value. Virtual physical sensor value that comes as close as possible to the technical signal. In case of inability to provide a physical sensor value (e.g. failure, implausibility or other reasons) a substitute value or a default value or a frozen value is provided.
    TCooltStckOutEstimd1  # Estimated Value of Coolant temperature at stack outlet | Coolant temperature at stack outlet: Modeled physical sensor value or standard sensor value. | The estimated value can be used as a replacement for the finally filtered and offset corrected physical sensor value.
      data TCooltStckOutEstimd1: type=T6  # Estimated Value of Coolant temperature at stack outlet | Coolant temperature at stack outlet: Modeled physical sensor value or standard sensor value. | The estimated value can be used as a replacement for the finally filtered and offset corrected physical sensor value.
    TCooltStckOutMeasd1  # Measured Value of Coolant temperature at stack outlet | Coolant temperature at stack outlet: Final filtered and offset corrected physical sensor value. | Physical sensor value/standard sensor value. The physical sensor value is the linearized and filtered physical raw sensor value including offset. At this step, a significant phase shift could be possible.
      data TCooltStckOutMeasd1: type=T6  # Measured Value of Coolant temperature at stack outlet | Coolant temperature at stack outlet: Final filtered and offset corrected physical sensor value. | Physical sensor value/standard sensor value. The physical sensor value is the linearized and filtered physical raw sensor value including offset. At this step, a significant phase shift could be possible.
    TCooltStckOutRaw1  # Raw Value of Coolant temperature at stack outlet | Coolant temperature at stack outlet: Physical raw sensor value. | Simple conversion of basic filtered electrical to physical value.
      data TCooltStckOutRaw1: type=T6  # Raw Value of Coolant temperature at stack outlet | Coolant temperature at stack outlet: Physical raw sensor value. | Simple conversion of basic filtered electrical to physical value.
    TGasAndeDsConsold1  # Consolidated Value for Gas temperature at downstream of anode | Gas temperature at downstream of anode: Consolidated physical value, either a measured value or a modeled value. | Finally filtered and offset corrected, consolidated value. Virtual physical sensor value that comes as close as possible to the technical signal. In case of inability to provide a physical sensor value (e.g. failure, implausibility or other reasons) a substitute value or a default value or a frozen value is provided.
      data TGasAndeDsConsold1: type=T6  # Consolidated Value for Gas temperature at downstream of anode | Gas temperature at downstream of anode: Consolidated physical value, either a measured value or a modeled value. | Finally filtered and offset corrected, consolidated value. Virtual physical sensor value that comes as close as possible to the technical signal. In case of inability to provide a physical sensor value (e.g. failure, implausibility or other reasons) a substitute value or a default value or a frozen value is provided.
    TGasAndeDsEstimd1  # Estimated Value of Gas temperature at downstream of anode | Gas temperature at downstream of anode: Modeled physical sensor value or standard sensor value. | The estimated value can be used as a replacement for the finally filtered and offset corrected physical sensor value.
      data TGasAndeDsEstimd1: type=T6  # Estimated Value of Gas temperature at downstream of anode | Gas temperature at downstream of anode: Modeled physical sensor value or standard sensor value. | The estimated value can be used as a replacement for the finally filtered and offset corrected physical sensor value.
    TGasAndeDsMeasd1  # Measured Value of Gas temperature at downstream of anode | Gas temperature at downstream of anode: Final filtered and offset corrected physical sensor value. | Physical sensor value/standard sensor value. The physical sensor value is the linearized and filtered physical raw sensor value including offset. At this step, a significant phase shift could be possible.
      data TGasAndeDsMeasd1: type=T6  # Measured Value of Gas temperature at downstream of anode | Gas temperature at downstream of anode: Final filtered and offset corrected physical sensor value. | Physical sensor value/standard sensor value. The physical sensor value is the linearized and filtered physical raw sensor value including offset. At this step, a significant phase shift could be possible.
    TGasAndeDsRaw1  # Raw Value of Gas temperature at downstream of anode | Gas temperature at downstream of anode: Physical raw sensor value. | Simple conversion of basic filtered electrical to physical value.
      data TGasAndeDsRaw1: type=T6  # Raw Value of Gas temperature at downstream of anode | Gas temperature at downstream of anode: Physical raw sensor value. | Simple conversion of basic filtered electrical to physical value.
    TGasAndeUsConsold1  # Consolidated Value for Gas temperature at upstream of anode | Gas temperature at upstream of anode: Consolidated physical value, either a measured value or a modeled value. | Finally filtered and offset corrected, consolidated value. Virtual physical sensor value that comes as close as possible to the technical signal. In case of inability to provide a physical sensor value (e.g. failure, implausibility or other reasons) a substitute value or a default value or a frozen value is provided.
      data TGasAndeUsConsold1: type=T6  # Consolidated Value for Gas temperature at upstream of anode | Gas temperature at upstream of anode: Consolidated physical value, either a measured value or a modeled value. | Finally filtered and offset corrected, consolidated value. Virtual physical sensor value that comes as close as possible to the technical signal. In case of inability to provide a physical sensor value (e.g. failure, implausibility or other reasons) a substitute value or a default value or a frozen value is provided.
    TGasAndeUsEstimd1  # Estimated Value of Gas temperature at upstream of anode | Gas temperature at upstream of anode: Modeled physical sensor value or standard sensor value. | The estimated value can be used as a replacement for the finally filtered and offset corrected physical sensor value.
      data TGasAndeUsEstimd1: type=T6  # Estimated Value of Gas temperature at upstream of anode | Gas temperature at upstream of anode: Modeled physical sensor value or standard sensor value. | The estimated value can be used as a replacement for the finally filtered and offset corrected physical sensor value.
    TGasAndeUsMeasd1  # Measured Value of Gas temperature at upstream of anode | Gas temperature at upstream of anode: Final filtered and offset corrected physical sensor value. | Physical sensor value/standard sensor value. The physical sensor value is the linearized and filtered physical raw sensor value including offset. At this step, a significant phase shift could be possible.
      data TGasAndeUsMeasd1: type=T6  # Measured Value of Gas temperature at upstream of anode | Gas temperature at upstream of anode: Final filtered and offset corrected physical sensor value. | Physical sensor value/standard sensor value. The physical sensor value is the linearized and filtered physical raw sensor value including offset. At this step, a significant phase shift could be possible.
    TGasAndeUsRaw1  # Raw Value of Gas temperature at upstream of anode | Gas temperature at upstream of anode: Physical raw sensor value. | Simple conversion of basic filtered electrical to physical value.
      data TGasAndeUsRaw1: type=T6  # Raw Value of Gas temperature at upstream of anode | Gas temperature at upstream of anode: Physical raw sensor value. | Simple conversion of basic filtered electrical to physical value.
    TGasBypCtdeDsConsold1  # Consolidated Value for Gas temperature downstream cathode bypass | Gas temperature downstream cathode bypass: Consolidated physical value, either a measured value or a modeled value. | Finally filtered and offset corrected, consolidated value. Virtual physical sensor value that comes as close as possible to the technical signal. In case of inability to provide a physical sensor value (e.g. failure, implausibility or other reasons) a substitute value or a default value or a frozen value is provided.
      data TGasBypCtdeDsConsold1: type=T6  # Consolidated Value for Gas temperature downstream cathode bypass | Gas temperature downstream cathode bypass: Consolidated physical value, either a measured value or a modeled value. | Finally filtered and offset corrected, consolidated value. Virtual physical sensor value that comes as close as possible to the technical signal. In case of inability to provide a physical sensor value (e.g. failure, implausibility or other reasons) a substitute value or a default value or a frozen value is provided.
    TGasBypCtdeDsEstimd1  # Estimated Value of Gas temperature downstream cathode bypass | Gas temperature downstream cathode bypass: Modeled physical sensor value or standard sensor value. | The estimated value can be used as a replacement for the finally filtered and offset corrected physical sensor value.
      data TGasBypCtdeDsEstimd1: type=T6  # Estimated Value of Gas temperature downstream cathode bypass | Gas temperature downstream cathode bypass: Modeled physical sensor value or standard sensor value. | The estimated value can be used as a replacement for the finally filtered and offset corrected physical sensor value.
    TGasBypCtdeDsMeasd1  # Measured Value of Gas temperature downstream cathode bypass | Gas temperature downstream cathode bypass: Final filtered and offset corrected physical sensor value. | Physical sensor value/standard sensor value. The physical sensor value is the linearized and filtered physical raw sensor value including offset. At this step, a significant phase shift could be possible.
      data TGasBypCtdeDsMeasd1: type=T6  # Measured Value of Gas temperature downstream cathode bypass | Gas temperature downstream cathode bypass: Final filtered and offset corrected physical sensor value. | Physical sensor value/standard sensor value. The physical sensor value is the linearized and filtered physical raw sensor value including offset. At this step, a significant phase shift could be possible.
    TGasBypCtdeDsRaw1  # Raw Value of Gas temperature downstream cathode bypass | Gas temperature downstream cathode bypass: Physical raw sensor value. | Simple conversion of basic filtered electrical to physical value.
      data TGasBypCtdeDsRaw1: type=T6  # Raw Value of Gas temperature downstream cathode bypass | Gas temperature downstream cathode bypass: Physical raw sensor value. | Simple conversion of basic filtered electrical to physical value.
    TGasBypCtdeUsConsold1  # Consolidated Value for Gas temperature upstream cathode bypass | Gas temperature upstream cathode bypass: Consolidated physical value, either a measured value or a modeled value. | Finally filtered and offset corrected, consolidated value. Virtual physical sensor value that comes as close as possible to the technical signal. In case of inability to provide a physical sensor value (e.g. failure, implausibility or other reasons) a substitute value or a default value or a frozen value is provided.
      data TGasBypCtdeUsConsold1: type=T6  # Consolidated Value for Gas temperature upstream cathode bypass | Gas temperature upstream cathode bypass: Consolidated physical value, either a measured value or a modeled value. | Finally filtered and offset corrected, consolidated value. Virtual physical sensor value that comes as close as possible to the technical signal. In case of inability to provide a physical sensor value (e.g. failure, implausibility or other reasons) a substitute value or a default value or a frozen value is provided.
    TGasBypCtdeUsEstimd1  # Estimated Value of Gas temperature upstream cathode bypass | Gas temperature upstream cathode bypass: Modeled physical sensor value or standard sensor value. | The estimated value can be used as a replacement for the finally filtered and offset corrected physical sensor value.
      data TGasBypCtdeUsEstimd1: type=T6  # Estimated Value of Gas temperature upstream cathode bypass | Gas temperature upstream cathode bypass: Modeled physical sensor value or standard sensor value. | The estimated value can be used as a replacement for the finally filtered and offset corrected physical sensor value.
    TGasBypCtdeUsMeasd1  # Measured Value of Gas temperature upstream cathode bypass | Gas temperature upstream cathode bypass: Final filtered and offset corrected physical sensor value. | Physical sensor value/standard sensor value. The physical sensor value is the linearized and filtered physical raw sensor value including offset. At this step, a significant phase shift could be possible.
      data TGasBypCtdeUsMeasd1: type=T6  # Measured Value of Gas temperature upstream cathode bypass | Gas temperature upstream cathode bypass: Final filtered and offset corrected physical sensor value. | Physical sensor value/standard sensor value. The physical sensor value is the linearized and filtered physical raw sensor value including offset. At this step, a significant phase shift could be possible.
    TGasBypCtdeUsRaw1  # Raw Value of Gas temperature upstream cathode bypass | Gas temperature upstream cathode bypass: Physical raw sensor value. | Simple conversion of basic filtered electrical to physical value.
      data TGasBypCtdeUsRaw1: type=T6  # Raw Value of Gas temperature upstream cathode bypass | Gas temperature upstream cathode bypass: Physical raw sensor value. | Simple conversion of basic filtered electrical to physical value.
    TGasBypHumrCtdeUDsConsold1  # Consolidated Value for Gas temperature downstream cathode humidifier bypass | Gas temperature downstream cathode humidifier bypass: Consolidated physical value, either a measured value or a modeled value. | Finally filtered and offset corrected, consolidated value. Virtual physical sensor value that comes as close as possible to the technical signal. In case of inability to provide a physical sensor value (e.g. failure, implausibility or other reasons) a substitute value or a default value or a frozen value is provided.
      data TGasBypHumrCtdeUDsConsold1: type=T6  # Consolidated Value for Gas temperature downstream cathode humidifier bypass | Gas temperature downstream cathode humidifier bypass: Consolidated physical value, either a measured value or a modeled value. | Finally filtered and offset corrected, consolidated value. Virtual physical sensor value that comes as close as possible to the technical signal. In case of inability to provide a physical sensor value (e.g. failure, implausibility or other reasons) a substitute value or a default value or a frozen value is provided.
    TGasBypHumrCtdeUDsEstimd1  # Estimated Value of Gas temperature downstream cathode humidifier bypass | Gas temperature downstream cathode humidifier bypass: Modeled physical sensor value or standard sensor value. | The estimated value can be used as a replacement for the finally filtered and offset corrected physical sensor value.
      data TGasBypHumrCtdeUDsEstimd1: type=T6  # Estimated Value of Gas temperature downstream cathode humidifier bypass | Gas temperature downstream cathode humidifier bypass: Modeled physical sensor value or standard sensor value. | The estimated value can be used as a replacement for the finally filtered and offset corrected physical sensor value.
    TGasBypHumrCtdeUDsMeasd1  # Measured Value of Gas temperature downstream cathode humidifier bypass | Gas temperature downstream cathode humidifier bypass: Final filtered and offset corrected physical sensor value. | Physical sensor value/standard sensor value. The physical sensor value is the linearized and filtered physical raw sensor value including offset. At this step, a significant phase shift could be possible.
      data TGasBypHumrCtdeUDsMeasd1: type=T6  # Measured Value of Gas temperature downstream cathode humidifier bypass | Gas temperature downstream cathode humidifier bypass: Final filtered and offset corrected physical sensor value. | Physical sensor value/standard sensor value. The physical sensor value is the linearized and filtered physical raw sensor value including offset. At this step, a significant phase shift could be possible.
    TGasBypHumrCtdeUDsRaw1  # Raw Value of Gas temperature downstream cathode humidifier bypass | Gas temperature downstream cathode humidifier bypass: Physical raw sensor value. | Simple conversion of basic filtered electrical to physical value.
      data TGasBypHumrCtdeUDsRaw1: type=T6  # Raw Value of Gas temperature downstream cathode humidifier bypass | Gas temperature downstream cathode humidifier bypass: Physical raw sensor value. | Simple conversion of basic filtered electrical to physical value.
    TGasBypHumrCtdeUsConsold1  # Consolidated Value for Gas temperature upstream cathode humidifier bypass | Gas temperature upstream cathode humidifier bypass: Consolidated physical value, either a measured value or a modeled value. | Finally filtered and offset corrected, consolidated value. Virtual physical sensor value that comes as close as possible to the technical signal. In case of inability to provide a physical sensor value (e.g. failure, implausibility or other reasons) a substitute value or a default value or a frozen value is provided.
      data TGasBypHumrCtdeUsConsold1: type=T6  # Consolidated Value for Gas temperature upstream cathode humidifier bypass | Gas temperature upstream cathode humidifier bypass: Consolidated physical value, either a measured value or a modeled value. | Finally filtered and offset corrected, consolidated value. Virtual physical sensor value that comes as close as possible to the technical signal. In case of inability to provide a physical sensor value (e.g. failure, implausibility or other reasons) a substitute value or a default value or a frozen value is provided.
    TGasBypHumrCtdeUsEstimd1  # Estimated Value of Gas temperature upstream cathode humidifier bypass | Gas temperature upstream cathode humidifier bypass: Modeled physical sensor value or standard sensor value. | The estimated value can be used as a replacement for the finally filtered and offset corrected physical sensor value.
      data TGasBypHumrCtdeUsEstimd1: type=T6  # Estimated Value of Gas temperature upstream cathode humidifier bypass | Gas temperature upstream cathode humidifier bypass: Modeled physical sensor value or standard sensor value. | The estimated value can be used as a replacement for the finally filtered and offset corrected physical sensor value.
    TGasBypHumrCtdeUsMeasd1  # Measured Value of Gas temperature upstream cathode humidifier bypass | Gas temperature upstream cathode humidifier bypass: Final filtered and offset corrected physical sensor value. | Physical sensor value/standard sensor value. The physical sensor value is the linearized and filtered physical raw sensor value including offset. At this step, a significant phase shift could be possible.
      data TGasBypHumrCtdeUsMeasd1: type=T6  # Measured Value of Gas temperature upstream cathode humidifier bypass | Gas temperature upstream cathode humidifier bypass: Final filtered and offset corrected physical sensor value. | Physical sensor value/standard sensor value. The physical sensor value is the linearized and filtered physical raw sensor value including offset. At this step, a significant phase shift could be possible.
    TGasBypHumrCtdeUsRaw1  # Raw Value of Gas temperature upstream cathode humidifier bypass | Gas temperature upstream cathode humidifier bypass: Physical raw sensor value. | Simple conversion of basic filtered electrical to physical value.
      data TGasBypHumrCtdeUsRaw1: type=T6  # Raw Value of Gas temperature upstream cathode humidifier bypass | Gas temperature upstream cathode humidifier bypass: Physical raw sensor value. | Simple conversion of basic filtered electrical to physical value.
    TGasCtdeDsConsold1  # Consolidated Value for Gas temperature downstream cathode | Gas temperature downstream cathode: Consolidated physical value, either a measured value or a modeled value. | Finally filtered and offset corrected, consolidated value. Virtual physical sensor value that comes as close as possible to the technical signal. In case of inability to provide a physical sensor value (e.g. failure, implausibility or other reasons) a substitute value or a default value or a frozen value is provided.
      data TGasCtdeDsConsold1: type=T6  # Consolidated Value for Gas temperature downstream cathode | Gas temperature downstream cathode: Consolidated physical value, either a measured value or a modeled value. | Finally filtered and offset corrected, consolidated value. Virtual physical sensor value that comes as close as possible to the technical signal. In case of inability to provide a physical sensor value (e.g. failure, implausibility or other reasons) a substitute value or a default value or a frozen value is provided.
    TGasCtdeDsEstimd1  # Estimated Value of Gas temperature downstream cathode | Gas temperature downstream cathode: Modeled physical sensor value or standard sensor value. | The estimated value can be used as a replacement for the finally filtered and offset corrected physical sensor value.
      data TGasCtdeDsEstimd1: type=T6  # Estimated Value of Gas temperature downstream cathode | Gas temperature downstream cathode: Modeled physical sensor value or standard sensor value. | The estimated value can be used as a replacement for the finally filtered and offset corrected physical sensor value.
    TGasCtdeDsMeasd1  # Measured Value of Gas temperature downstream cathode | Gas temperature downstream cathode: Final filtered and offset corrected physical sensor value. | Physical sensor value/standard sensor value. The physical sensor value is the linearized and filtered physical raw sensor value including offset. At this step, a significant phase shift could be possible.
      data TGasCtdeDsMeasd1: type=T6  # Measured Value of Gas temperature downstream cathode | Gas temperature downstream cathode: Final filtered and offset corrected physical sensor value. | Physical sensor value/standard sensor value. The physical sensor value is the linearized and filtered physical raw sensor value including offset. At this step, a significant phase shift could be possible.
    TGasCtdeDsRaw1  # Raw Value of Gas temperature downstream cathode | Gas temperature downstream cathode: Physical raw sensor value. | Simple conversion of basic filtered electrical to physical value.
      data TGasCtdeDsRaw1: type=T6  # Raw Value of Gas temperature downstream cathode | Gas temperature downstream cathode: Physical raw sensor value. | Simple conversion of basic filtered electrical to physical value.
    TGasCtdeUsConsold1  # Consolidated Value for Gas temperature upstream cathode | Gas temperature upstream cathode: Consolidated physical value, either a measured value or a modeled value. | Finally filtered and offset corrected, consolidated value. Virtual physical sensor value that comes as close as possible to the technical signal. In case of inability to provide a physical sensor value (e.g. failure, implausibility or other reasons) a substitute value or a default value or a frozen value is provided.
      data TGasCtdeUsConsold1: type=T6  # Consolidated Value for Gas temperature upstream cathode | Gas temperature upstream cathode: Consolidated physical value, either a measured value or a modeled value. | Finally filtered and offset corrected, consolidated value. Virtual physical sensor value that comes as close as possible to the technical signal. In case of inability to provide a physical sensor value (e.g. failure, implausibility or other reasons) a substitute value or a default value or a frozen value is provided.
    TGasCtdeUsEstimd1  # Estimated Value of Gas temperature upstream cathode | Gas temperature upstream cathode: Modeled physical sensor value or standard sensor value. | The estimated value can be used as a replacement for the finally filtered and offset corrected physical sensor value.
      data TGasCtdeUsEstimd1: type=T6  # Estimated Value of Gas temperature upstream cathode | Gas temperature upstream cathode: Modeled physical sensor value or standard sensor value. | The estimated value can be used as a replacement for the finally filtered and offset corrected physical sensor value.
    TGasCtdeUsMeasd1  # Measured Value of Gas temperature upstream cathode | Gas temperature upstream cathode: Final filtered and offset corrected physical sensor value. | Physical sensor value/standard sensor value. The physical sensor value is the linearized and filtered physical raw sensor value including offset. At this step, a significant phase shift could be possible.
      data TGasCtdeUsMeasd1: type=T6  # Measured Value of Gas temperature upstream cathode | Gas temperature upstream cathode: Final filtered and offset corrected physical sensor value. | Physical sensor value/standard sensor value. The physical sensor value is the linearized and filtered physical raw sensor value including offset. At this step, a significant phase shift could be possible.
    TGasCtdeUsRaw1  # Raw Value of Gas temperature upstream cathode | Gas temperature upstream cathode: Physical raw sensor value. | Simple conversion of basic filtered electrical to physical value.
      data TGasCtdeUsRaw1: type=T6  # Raw Value of Gas temperature upstream cathode | Gas temperature upstream cathode: Physical raw sensor value. | Simple conversion of basic filtered electrical to physical value.
    TGasHBlowrDsConsold1  # Consolidated Value for Gas temperature at downstream of hydrogen recirculation blower | Gas temperature at downstream of hydrogen recirculation blower: Consolidated physical value, either a measured value or a modeled value. | Finally filtered and offset corrected, consolidated value. Virtual physical sensor value that comes as close as possible to the technical signal. In case of inability to provide a physical sensor value (e.g. failure, implausibility or other reasons) a substitute value or a default value or a frozen value is provided.
      data TGasHBlowrDsConsold1: type=T6  # Consolidated Value for Gas temperature at downstream of hydrogen recirculation blower | Gas temperature at downstream of hydrogen recirculation blower: Consolidated physical value, either a measured value or a modeled value. | Finally filtered and offset corrected, consolidated value. Virtual physical sensor value that comes as close as possible to the technical signal. In case of inability to provide a physical sensor value (e.g. failure, implausibility or other reasons) a substitute value or a default value or a frozen value is provided.
    TGasHBlowrDsEstimd1  # Estimated Value of Gas temperature at downstream of hydrogen recirculation blower | Gas temperature at downstream of hydrogen recirculation blower: Modeled physical sensor value or standard sensor value. | The estimated value can be used as a replacement for the finally filtered and offset corrected physical sensor value.
      data TGasHBlowrDsEstimd1: type=T6  # Estimated Value of Gas temperature at downstream of hydrogen recirculation blower | Gas temperature at downstream of hydrogen recirculation blower: Modeled physical sensor value or standard sensor value. | The estimated value can be used as a replacement for the finally filtered and offset corrected physical sensor value.
    TGasHBlowrDsMeasd1  # Measured Value of Gas temperature at downstream of hydrogen recirculation blower | Gas temperature at downstream of hydrogen recirculation blower: Final filtered and offset corrected physical sensor value. | Physical sensor value/standard sensor value. The physical sensor value is the linearized and filtered physical raw sensor value including offset. At this step, a significant phase shift could be possible.
      data TGasHBlowrDsMeasd1: type=T6  # Measured Value of Gas temperature at downstream of hydrogen recirculation blower | Gas temperature at downstream of hydrogen recirculation blower: Final filtered and offset corrected physical sensor value. | Physical sensor value/standard sensor value. The physical sensor value is the linearized and filtered physical raw sensor value including offset. At this step, a significant phase shift could be possible.
    TGasHBlowrDsRaw1  # Raw Value of Gas temperature at downstream of hydrogen recirculation blower | Gas temperature at downstream of hydrogen recirculation blower: Physical raw sensor value. | Simple conversion of basic filtered electrical to physical value.
      data TGasHBlowrDsRaw1: type=T6  # Raw Value of Gas temperature at downstream of hydrogen recirculation blower | Gas temperature at downstream of hydrogen recirculation blower: Physical raw sensor value. | Simple conversion of basic filtered electrical to physical value.
    TGasHBlowrUsConsold1  # Consolidated Value for Gas temperature at upstream of hydrogen recirculation blower | Gas temperature at upstream of hydrogen recirculation blower: Consolidated physical value, either a measured value or a modeled value. | Finally filtered and offset corrected, consolidated value. Virtual physical sensor value that comes as close as possible to the technical signal. In case of inability to provide a physical sensor value (e.g. failure, implausibility or other reasons) a substitute value or a default value or a frozen value is provided.
      data TGasHBlowrUsConsold1: type=T6  # Consolidated Value for Gas temperature at upstream of hydrogen recirculation blower | Gas temperature at upstream of hydrogen recirculation blower: Consolidated physical value, either a measured value or a modeled value. | Finally filtered and offset corrected, consolidated value. Virtual physical sensor value that comes as close as possible to the technical signal. In case of inability to provide a physical sensor value (e.g. failure, implausibility or other reasons) a substitute value or a default value or a frozen value is provided.
    TGasHBlowrUsEstimd1  # Estimated Value of Gas temperature at upstream of hydrogen recirculation blower | Gas temperature at upstream of hydrogen recirculation blower: Modeled physical sensor value or standard sensor value. | The estimated value can be used as a replacement for the finally filtered and offset corrected physical sensor value.
      data TGasHBlowrUsEstimd1: type=T6  # Estimated Value of Gas temperature at upstream of hydrogen recirculation blower | Gas temperature at upstream of hydrogen recirculation blower: Modeled physical sensor value or standard sensor value. | The estimated value can be used as a replacement for the finally filtered and offset corrected physical sensor value.
    TGasHBlowrUsMeasd1  # Measured Value of Gas temperature at upstream of hydrogen recirculation blower | Gas temperature at upstream of hydrogen recirculation blower: Final filtered and offset corrected physical sensor value. | Physical sensor value/standard sensor value. The physical sensor value is the linearized and filtered physical raw sensor value including offset. At this step, a significant phase shift could be possible.
      data TGasHBlowrUsMeasd1: type=T6  # Measured Value of Gas temperature at upstream of hydrogen recirculation blower | Gas temperature at upstream of hydrogen recirculation blower: Final filtered and offset corrected physical sensor value. | Physical sensor value/standard sensor value. The physical sensor value is the linearized and filtered physical raw sensor value including offset. At this step, a significant phase shift could be possible.
    TGasHBlowrUsRaw1  # Raw Value of Gas temperature at upstream of hydrogen recirculation blower | Gas temperature at upstream of hydrogen recirculation blower: Physical raw sensor value. | Simple conversion of basic filtered electrical to physical value.
      data TGasHBlowrUsRaw1: type=T6  # Raw Value of Gas temperature at upstream of hydrogen recirculation blower | Gas temperature at upstream of hydrogen recirculation blower: Physical raw sensor value. | Simple conversion of basic filtered electrical to physical value.
    TGasHumrAndeUsConsold1  # Consolidated Value for Gas temperature at humidity sensor at upstream of anode | Gas temperature at humidity sensor at upstream of anode: Consolidated physical value, either a measured value or a modeled value. | Finally filtered and offset corrected, consolidated value. Virtual physical sensor value that comes as close as possible to the technical signal. In case of inability to provide a physical sensor value (e.g. failure, implausibility or other reasons) a substitute value or a default value or a frozen value is provided.
      data TGasHumrAndeUsConsold1: type=T6  # Consolidated Value for Gas temperature at humidity sensor at upstream of anode | Gas temperature at humidity sensor at upstream of anode: Consolidated physical value, either a measured value or a modeled value. | Finally filtered and offset corrected, consolidated value. Virtual physical sensor value that comes as close as possible to the technical signal. In case of inability to provide a physical sensor value (e.g. failure, implausibility or other reasons) a substitute value or a default value or a frozen value is provided.
    TGasHumrAndeUsEstimd1  # Estimated Value of Gas temperature at humidity sensor at upstream of anode | Gas temperature at humidity sensor at upstream of anode: Modeled physical sensor value or standard sensor value. | The estimated value can be used as a replacement for the finally filtered and offset corrected physical sensor value.
      data TGasHumrAndeUsEstimd1: type=T6  # Estimated Value of Gas temperature at humidity sensor at upstream of anode | Gas temperature at humidity sensor at upstream of anode: Modeled physical sensor value or standard sensor value. | The estimated value can be used as a replacement for the finally filtered and offset corrected physical sensor value.
    TGasHumrAndeUsMeasd1  # Measured Value of Gas temperature at humidity sensor at upstream of anode | Gas temperature at humidity sensor at upstream of anode: Final filtered and offset corrected physical sensor value. | Physical sensor value/standard sensor value. The physical sensor value is the linearized and filtered physical raw sensor value including offset. At this step, a significant phase shift could be possible.
      data TGasHumrAndeUsMeasd1: type=T6  # Measured Value of Gas temperature at humidity sensor at upstream of anode | Gas temperature at humidity sensor at upstream of anode: Final filtered and offset corrected physical sensor value. | Physical sensor value/standard sensor value. The physical sensor value is the linearized and filtered physical raw sensor value including offset. At this step, a significant phase shift could be possible.
    TGasHumrAndeUsRaw1  # Raw Value of Gas temperature at humidity sensor at upstream of anode | Gas temperature at humidity sensor at upstream of anode: Physical raw sensor value. | Simple conversion of basic filtered electrical to physical value.
      data TGasHumrAndeUsRaw1: type=T6  # Raw Value of Gas temperature at humidity sensor at upstream of anode | Gas temperature at humidity sensor at upstream of anode: Physical raw sensor value. | Simple conversion of basic filtered electrical to physical value.
    TGasInjrH2UsConsold1  # Consolidated Value for Gas temperature at upstream of hydrogen gas injector | Gas temperature at upstream of hydrogen gas injector: Consolidated physical value, either a measured value or a modeled value. | Finally filtered and offset corrected, consolidated value. Virtual physical sensor value that comes as close as possible to the technical signal. In case of inability to provide a physical sensor value (e.g. failure, implausibility or other reasons) a substitute value or a default value or a frozen value is provided.
      data TGasInjrH2UsConsold1: type=T6  # Consolidated Value for Gas temperature at upstream of hydrogen gas injector | Gas temperature at upstream of hydrogen gas injector: Consolidated physical value, either a measured value or a modeled value. | Finally filtered and offset corrected, consolidated value. Virtual physical sensor value that comes as close as possible to the technical signal. In case of inability to provide a physical sensor value (e.g. failure, implausibility or other reasons) a substitute value or a default value or a frozen value is provided.
    TGasInjrH2UsEstimd1  # Estimated Value of Gas temperature at upstream of hydrogen gas injector | Gas temperature at upstream of hydrogen gas injector: Modeled physical sensor value or standard sensor value. | The estimated value can be used as a replacement for the finally filtered and offset corrected physical sensor value.
      data TGasInjrH2UsEstimd1: type=T6  # Estimated Value of Gas temperature at upstream of hydrogen gas injector | Gas temperature at upstream of hydrogen gas injector: Modeled physical sensor value or standard sensor value. | The estimated value can be used as a replacement for the finally filtered and offset corrected physical sensor value.
    TGasInjrH2UsMeasd1  # Measured Value of Gas temperature at upstream of hydrogen gas injector | Gas temperature at upstream of hydrogen gas injector: Final filtered and offset corrected physical sensor value. | Physical sensor value/standard sensor value. The physical sensor value is the linearized and filtered physical raw sensor value including offset. At this step, a significant phase shift could be possible.
      data TGasInjrH2UsMeasd1: type=T6  # Measured Value of Gas temperature at upstream of hydrogen gas injector | Gas temperature at upstream of hydrogen gas injector: Final filtered and offset corrected physical sensor value. | Physical sensor value/standard sensor value. The physical sensor value is the linearized and filtered physical raw sensor value including offset. At this step, a significant phase shift could be possible.
    TGasInjrH2UsRaw1  # Raw Value of Gas temperature at upstream of hydrogen gas injector | Gas temperature at upstream of hydrogen gas injector: Physical raw sensor value. | Simple conversion of basic filtered electrical to physical value.
      data TGasInjrH2UsRaw1: type=T6  # Raw Value of Gas temperature at upstream of hydrogen gas injector | Gas temperature at upstream of hydrogen gas injector: Physical raw sensor value. | Simple conversion of basic filtered electrical to physical value.
    THumrCtdeDsConsold1  # Consolidated Value for Air temperature downstream cathode humidifier | Air temperature downstream cathode humidifier: Consolidated physical value, either a measured value or a modeled value. | Finally filtered and offset corrected, consolidated value. Virtual physical sensor value that comes as close as possible to the technical signal. In case of inability to provide a physical sensor value (e.g. failure, implausibility or other reasons) a substitute value or a default value or a frozen value is provided.
      data THumrCtdeDsConsold1: type=T6  # Consolidated Value for Air temperature downstream cathode humidifier | Air temperature downstream cathode humidifier: Consolidated physical value, either a measured value or a modeled value. | Finally filtered and offset corrected, consolidated value. Virtual physical sensor value that comes as close as possible to the technical signal. In case of inability to provide a physical sensor value (e.g. failure, implausibility or other reasons) a substitute value or a default value or a frozen value is provided.
    THumrCtdeDsEstimd1  # Estimated Value of Air temperature downstream cathode humidifier | Air temperature downstream cathode humidifier: Modeled physical sensor value or standard sensor value. | The estimated value can be used as a replacement for the finally filtered and offset corrected physical sensor value.
      data THumrCtdeDsEstimd1: type=T6  # Estimated Value of Air temperature downstream cathode humidifier | Air temperature downstream cathode humidifier: Modeled physical sensor value or standard sensor value. | The estimated value can be used as a replacement for the finally filtered and offset corrected physical sensor value.
    THumrCtdeDsMeasd1  # Measured Value of Air temperature downstream cathode humidifier | Air temperature downstream cathode humidifier: Final filtered and offset corrected physical sensor value. | Physical sensor value/standard sensor value. The physical sensor value is the linearized and filtered physical raw sensor value including offset. At this step, a significant phase shift could be possible.
      data THumrCtdeDsMeasd1: type=T6  # Measured Value of Air temperature downstream cathode humidifier | Air temperature downstream cathode humidifier: Final filtered and offset corrected physical sensor value. | Physical sensor value/standard sensor value. The physical sensor value is the linearized and filtered physical raw sensor value including offset. At this step, a significant phase shift could be possible.
    THumrCtdeDsRaw1  # Raw Value of Air temperature downstream cathode humidifier | Air temperature downstream cathode humidifier: Physical raw sensor value. | Simple conversion of basic filtered electrical to physical value.
      data THumrCtdeDsRaw1: type=T6  # Raw Value of Air temperature downstream cathode humidifier | Air temperature downstream cathode humidifier: Physical raw sensor value. | Simple conversion of basic filtered electrical to physical value.
    THumrCtdeUsConsold1  # Consolidated Value for Air temperature upstream cathode humidifier | Air temperature upstream cathode humidifier: Consolidated physical value, either a measured value or a modeled value. | Finally filtered and offset corrected, consolidated value. Virtual physical sensor value that comes as close as possible to the technical signal. In case of inability to provide a physical sensor value (e.g. failure, implausibility or other reasons) a substitute value or a default value or a frozen value is provided.
      data THumrCtdeUsConsold1: type=T6  # Consolidated Value for Air temperature upstream cathode humidifier | Air temperature upstream cathode humidifier: Consolidated physical value, either a measured value or a modeled value. | Finally filtered and offset corrected, consolidated value. Virtual physical sensor value that comes as close as possible to the technical signal. In case of inability to provide a physical sensor value (e.g. failure, implausibility or other reasons) a substitute value or a default value or a frozen value is provided.
    THumrCtdeUsEstimd1  # Estimated Value of Air temperature upstream cathode humidifier | Air temperature upstream cathode humidifier: Modeled physical sensor value or standard sensor value. | The estimated value can be used as a replacement for the finally filtered and offset corrected physical sensor value.
      data THumrCtdeUsEstimd1: type=T6  # Estimated Value of Air temperature upstream cathode humidifier | Air temperature upstream cathode humidifier: Modeled physical sensor value or standard sensor value. | The estimated value can be used as a replacement for the finally filtered and offset corrected physical sensor value.
    THumrCtdeUsMeasd1  # Measured Value of Air temperature upstream cathode humidifier | Air temperature upstream cathode humidifier: Final filtered and offset corrected physical sensor value. | Physical sensor value/standard sensor value. The physical sensor value is the linearized and filtered physical raw sensor value including offset. At this step, a significant phase shift could be possible.
      data THumrCtdeUsMeasd1: type=T6  # Measured Value of Air temperature upstream cathode humidifier | Air temperature upstream cathode humidifier: Final filtered and offset corrected physical sensor value. | Physical sensor value/standard sensor value. The physical sensor value is the linearized and filtered physical raw sensor value including offset. At this step, a significant phase shift could be possible.
    THumrCtdeUsRaw1  # Raw Value of Air temperature upstream cathode humidifier | Air temperature upstream cathode humidifier: Physical raw sensor value. | Simple conversion of basic filtered electrical to physical value.
      data THumrCtdeUsRaw1: type=T6  # Raw Value of Air temperature upstream cathode humidifier | Air temperature upstream cathode humidifier: Physical raw sensor value. | Simple conversion of basic filtered electrical to physical value.
    TelltlDefrstCmd1  # Telltale Defrost Command | Command to the defrost telltale actuator
      data Cmd: type=OnOff1
    TerminalClmpModReq1  # Terminal Clamp Mode Request | request to change modes to power management and powertrain system
      data TerminalClmpModReq: type=TerminalPosnMod1
    TerminalPosnSt1  # Terminal Position Status | Position of mechanical key switch
      data TerminalPosnSt: type=TerminalPosnMod1
    TerminalPosnSts1  # Terminal Position Status | Position of mechanical key switch
      data TerminalPosnSts: type=TerminalPosnMod1
    TiGapDec1  # Time Gap Decrease | Request to decrease time gap for driver assistance system, e.g. Adaptive Cruise Control (ACC) by driver.
      data TiGapDec: type=ReqSt1  # 0: nothing 1: decrease time gap
    TiGapInc1  # Time Gap Increase | Request to increase time gap for driver assistance system, e.g. Adaptive Cruise Control (ACC) by driver.
      data TiGapInc: type=ReqSt1  # 0: nothing 1: increase time gap
    TintgAutReq1  # Automatic Tint Request | User request to set the mirrors tinting automatically
      data Req: type=OnOff1
    TintgAutSt1  # Automatic Tint Status | Status of the automatic tinting.
      data St: type=DevSt4
    TintgAutSts1  # Automatic Tint Status | Status of the automatic tinting.
      data Sts: type=DevSts4
    TintgValReq1  # Tinting Value Request | Delivers the desired value for mirror tinting.
      data St: type=Perc2
    TirePMonAcptOfWhlNewReq1  # Tire Pressure Monitoring Acceptof Wheel New Request | Indication of new wheel set to be accepted and monitored by Tire Pressure Monitoring (e.g. new sensor ID) | For direct measuring systems.
      data TirePMonAcptOfWhlNewReq: type=ReqSt1
    TirePMonIndcnOfWhlNewRcnd1  # Tire Pressure Monitoring New Wheel Recognized Indication 1 | Indication that one or more new wheels with new sensor ID are fitted to the vehicle. | For direct measuring systems.
      data TirePMonIndcnOfWhlNewRcnd: type=DetnSt1
    TirePMonRstAckd1  # Tire Pressure Monitoring Reset Acknowledged 1 | Acknowledge of the Tire Pressure Monitoring that a tire pressure monitoring reset request has been received. | For direct and indirect measuring systems.
      data TirePMonRstAckd: type=AckSt1
    TirePMonRstReq1  # Tire Pressure Monitoring Reset Request 1 | Request of a reset of the tire pressure monitoring by the driver or diagnostic tool | For direct and indirect measuring systems.
      data TirePMonRstReq: type=ReqSt1
    TirePMonSt1  # Tire Pressure Monitoring Status 1 | Status of the tire pressure monitoring system | For direct and indirect measuring systems.
      data TirePMonSt: type=DevSt5
    TirePMonSts1  # Tire Pressure Monitoring Status 1 | Status of the tire pressure monitoring system | For direct and indirect measuring systems.
      data TirePMonSts: type=DevSts5
    TirePMonWarnIndcn1  # Tire Pressure Monitoring Warning Indication | Indication that at least at one tire a significant loss of tire pressure has been recognized. | For direct and indirect measuring systems.
      data TirePMonWarnIndcn: type=TirePMonWarnSt1
    TogReq1  # Toggle Request | User request to lock / unlock e.g. the glove box ("Toggle-Function"). "on" means toggle.
      data Req: type=OnOff1
    TogSt1  # Toggle State | System output to user: The value is used to generate feedback to the user about the system's current state. The value represents one of two states, mutually excluding each other, the system can be in or has changed to.
      data St: type=OnOff1
    TracCtrlIndcn1  # Traction Control Indication | Traction control is active for Human Machine Interface (HMI)
      data TracCtrlIndcn: type=DevSt4
    TracCtrlIntvg1  # Traction Control Intervening 1 | Traction control intervention status. True if intervening at at least one wheel.
      data TracCtrlIntvg: type=CtrlSt1  # 0: Traction control is not intervening 1: At least one wheel has Traction Control intervening
    TrlrHitchSt1  # Trailer Hitch Status | Status of trailer hitch
      data St: type=OnOff1
    TrlrHitchSts1  # Trailer Hitch Status | Status of trailer hitch
      data Sts: type=OnOff1
    TrlrIndcrDisp1  # Trailer Indicator Display | Trailer indicators activation status
      data St: type=IndcrSt1
    TrlrSt1  # Trailer Status 1 | Detection of presence of a trailer by switch type detection. Information: Trailer attached 0 means 'not present' 1 means 'present'
      data TrlrSt: type=DetnSt1  # 0 means 'not present' 1 means 'present'
    TrlrSts1  # Trailer Status 1 | Detection of presence of a trailer by switch type detection. Information: Trailer attached 0 means 'not present' 1 means 'present'
      data TrlrSts: type=DetnSts1  # 0 means 'not present' 1 means 'present'
    TrsmAuthent1  # Transmission Authentication | Authentication process between transmitter and receiver
      data TrsmAuthent: type=Nr8
    TrsmAxleActrSt1  # Transmission Axle Actuator State | State of the Front/Rear Axle Actuator. This could be a Torque Vector Device, an active control differential or a locking differential.
      data TrsmAxleActrSt: type=DevErrSt4
    TrsmCluSt1  # Transmission: Clutch State | The interface informs about the current state of the clutch. | Be aware that this information is not necessarily equal with the drivetrain open information. If a torque converter clutch is open, the drivetrain can still be closed. In contrary the drivetrain is open for Manual Transmission (MT) and Automatic Manual Transmission (AMT), if the clutch is open! Default value after reset is open.
      data TrsmCluSt: type=CluSt1
    TrsmCluStAct1  # Transmission: Actual Clutch State | The interface informs about the current state of the clutch. | There exist 4 principal states: open, intermediate, near closed, hard closed (Note: The definition of intermediate and near closed has to be made for each project separately) Definition of "Clutch": Be aware that this information is not necessarily equal with the drivetrain open information. If a torque converter clutch is open, the drivetrain can still be closed. In contrary the drivetrain is open for Manual Transmission (MT) and Automatic Manual Transmission (AMT), if the clutch is open!Default value after reset is open. for Automatic Transmission (AT), Continuously Variable Transmission (CVT) it is the converter clutch for Manual Transmission (MT), Automatic Manual Transmission (AMT) it is the clutch between the gear box and the engine drivetrain
      data TrsmCluStAct: type=CluSt1
    TrsmCluStConsold1  # Transmission: Consolidated Clutch State | The interface informs about the current state of the clutch. | Be aware that this information is not necessarily equal with the drivetrain open information. If a torque converter clutch is open, the drivetrain can still be closed. In contrary the drivetrain is open for Manual Transmission (MT) and Automatic Manual Transmission (AMT), if the clutch is open!Default value after reset is open.
      data TrsmCluStConsold: type=CluSt1
    TrsmCluStTar1  # Transmission: Target State of the Clutch | The interface informs about the target state of the clutch. | There exist 4 principal states: open, intermediate, near closed, hard closed (Note: The definition of intermediate and near closed has to be made for each project separately) Definition of "Clutch": Be aware that this information is not necessarily equal with the drivetrain open information. If a torque converter clutch is open, the drivetrain can still be closed. In contrary the drivetrain is open for Manual Transmission (MT) and Automatic Manual Transmission (AMT), if the clutch is open!Default value after reset is open. for Automatic Transmission (AT), Continuously Variable Transmission (CVT) it is the converter clutch for Manual Transmission (MT), Automatic Manual Transmission (AMT) it is the clutch between the gear box and the engine drivetrain
      data TrsmCluStTar: type=CluSt1
    TrsmFlgCtrsftActv1  # Transmission: Countershaft Active | Indicates whether the gear is in low range mode, e.g. for sport utility vehicles (SUV) or offroad vehicles with countershaft gearboxes (high range / low range). 0: countershaft inactive (standard condition) 1: countershaft active
      data TrsmFlgCtrsftActv: type=Flg1
    TrsmFlgDtOpen1  # Transmission: Drivetrain Opened | indicates whether the drive train is open due to driver input. Transitional states between fully open and fully closed drivetrain shall be indicated as open in this signal. Automatic Transmission (AT): Lever in N or in P or in neutral state because if internal reasons (e.g. internal failure) Manual Transmission (MT): Estimation based on clutch pedal pressed and optional neutral gear recognition. 0 : Drivetrain fully closed 1 : Drivetrain fully open or between fully open and fully closed)
      data TrsmFlgDtOpen: type=Flg1
    TrsmFlgParkLockEngd1  # Transmission: Park Lock Engaged | Status of gearbox on engaged parking lock (P-drive) of the Automatic Transmission (AT). 0 : not engaged 1 : engaged
      data TrsmFlgParkLockEngd: type=Flg1
    TrsmFlgShiftProgs1  # Transmission: Gear Shift in Progress | Flag indicates that a gear shift is in progress. | A gear shift is in progress while the transmission is changing the gear. This typically includes the preparation of the clutches, i.e. the fast filling phase of the clutch on automatic transmissions. “Gear shift is active” is a synonym for “Gear shift is in progress”.
      data TrsmFlgShiftProgs: type=Flg1  # Transmission: Gear Shift in Progress
    TrsmFlgSptMod1  # Transmission: Sport Mode Request by Driver | Flag signals that the driver activated the sport mode. 0 = deactivated 1 = activated
      data TrsmFlgSptMod: type=Flg1
    TrsmFlgSptModReq1  # Transmission: Sport Mode Request by Driver | Flag signals that the driver activated the sport mode. 0 = deactivated 1 = activated
      data TrsmFlgSptModReq: type=Flg1
    TrsmFlgWntrMod1  # Transmission: Winter Mode Request by Driver | Flag signals that the driver activated the winter mode 0 = deactivated 1 = activated
      data TrsmFlgWntrMod: type=Flg1
    TrsmFlgWntrModReq1  # Transmission: Winter Mode Request by Driver | Flag signals that the driver activated the winter mode 0 = deactivated 1 = activated
      data TrsmFlgWntrModReq: type=Flg1
    TrsmId1  # Transmission Identifier | Information related to the access device (transmission device) used to enter the car.
      data TrsmId: type=Nr8
    TrsmNInp1  # Transmission: Speed at Input | For Transmission with a torque converter this interface represents the turbine speed, which is the output speed of the torque converter. For Dual Clutch Transmission (DCT) this speed represents the speed of the active clutch. | For low speed values the speed might be a virtual speed.
      data TrsmNInp: type=N1
    TrsmNrGearAct1  # Transmission: Actual Gear | Shows the gear being currently engaged in the gear box. | Mapping of physical gear to representation is left open, but according to: (Only for manual transmission: If no information about reverse gears is available then corresponding positive values are used for reverse gears.) 0 is drive train open (no torque at clutch is transmitted between the running engine(s) and the wheels). The use of Continuously Variable Transmission (CVT) has to be handled by separate SW-functionalities. Also for Continuously Variable Transmission (CVT), 0 is defined as open drive train.Default value after reset is zero. Negative values: Reverse gears. Positive values: Forward gears.
      data TrsmNrGearAct: type=Nr4
    TrsmNrGearConsold1  # Transmission: Consolidated Gear | Shows the gear being currently engaged in the gear box. | 0 is drive train open (no torque at clutch is transmitted between the running engine(s) and the wheels). The use of Continuously Variable Transmission (CVT) has to be handled by separate SW-functionalities. Also for Continuously Variable Transmission (CVT), 0 is defined as open drive train.Default value after reset is zero.
      data TrsmNrGearConsold: type=Nr4
    TrsmNrGearReq1  # Transmission: Requested Gear | Shows the gear being currently requested by the ratio strategy. | Mapping of physical gear to representation is left open, but according to: (Only for manual transmission: If no information about reverse gears is available then corresponding positive values are used for reverse gears.) The use of Continuously Variable Transmission (CVT) has to be handled by separate SW-functionalities. Also for Continuously Variable Transmission (CVT), 0 is defined as open drive train.Default value after reset is zero. Negative values: Reverse gears. Positive values: forward gears. 0 is drive train open (no torque at clutch is transmitted between the running engine(s) and the wheels).
      data TrsmNrGearReq: type=Nr4
    TrsmNrGearTar1  # Transmission: Target Gear | Shows the gear which will be engaged in the gear box. | During the shifting process this value informs about the gear which is expected to be engaged in the gear box after the shifting process. Therefore it switches to the expected gear state with the beginning of the shifting process. Mapping of physical gear to representation is left open, but according to: (Only for manual transmission: If no information about reverse gears is available then corresponding positive values are used for reverse gears.) 0 is drive train open (no torque at clutch is transmitted between the running engine(s) and the wheels). The use of Continuously Variable Transmission (CVT) has to be handled by separate SW-functionalities. Also for Continuously Variable Transmission (CVT), 0 is defined as open drive train.Default value after reset is zero. Negative values: Reverse gears. Positive values: forward gears.
      data TrsmNrGearTar: type=Nr4
    TrsmNrTyp1  # Transmission Type | Information on standard transmission. | Initialization possible by "End Of Line (EOL)" or "Key On". This information can come from compiler switch, calibration label, or as learned variant (SW identifies Gearbox type)Signal is sent with initialisation.
      data TrsmNrTyp: type=TrsmTyp1
    TrsmPosn1  # Transmission Position | Information to know if the transmitters of the vehicle are inside or outside the vehicle.
      data TrsmPosn: type=InOut1  # - Inside of the car - Outside of the car
  client server interface TrsmRatGear1  # Transmission: Gear Ratio for a Given Gear | Returns the gear ratio for a given gear | Theoretical transmission ratio i = ntransmission_in / ntransmission_out transmission_in = after converter transmission_out = gearbox out The gear ratio means the theoretical/physical ratio belonging to each gear and not any actual measured value (proposal for Continuously Variable Transmission (CVT): if there is a wide range for gear states, this value could deliver a theoretical value). Negative values: Reverse driving direction. Without considering the: 1.) axle ratio 2.) converter ratio 3.) High/Low-Range ratio'Default value after reset is 1.0'
    operation GetTrsmRatGear  # Returns the Gear Ratio for a Given Gear | Returns the gear ratio for a given gear
      arg Gear: type=Nr4, direction=IN  # Gear for Which the Ratio Should Be Returned | Gear for which the ratio should be returned
      arg Rat: type=Fac1, direction=OUT  # Gear Ratio of Given Gear | Gear ratio of given gear
  81 x sender receiver interface:
    TrsmRatGearAct1  # Transmission: The Actual Gear Ratio Being Currently Engaged in the Gear Box | Actual theoretical transmission ratio i = ntransmission_in / ntransmission_out transmission_in = after converter transmission_out = gearbox out The gear ratio means the theoretical/physical ratio belonging to each gear and not any actual measured value (proposal for Continuously Variable Transmission (CVT): if there is a wide range for gear states, this value could deliver a theoretical value). Negative values: Reverse driving direction. Without considering the: 1.) axle ratio 2.) converter ratio 3.) High/Low-Range ratio | Default value after reset is 1.0.
      data TrsmRatGearAct: type=Fac1
    TrsmRatGearConsold1  # Transmission: The Consolidated Gear Ratio Being Currently Engaged in the Gear Box | Actual theoretical transmission ratio i = ntransmission_in / ntransmission_out transmission_in = after converter transmission_out = gearbox out The gear ratio means the theoretical/physical ratio belonging to each gear and not any actual measured value (proposal for Continuously Variable Transmission (CVT): if there is a wide range for gear states, this value could deliver a theoretical value). Negative values: Reverse driving direction. Without considering the: 1.) axle ratio 2.) converter ratio 3.) High/Low-Range ratio | Default value after reset is 1.0.
      data TrsmRatGearConsold: type=Fac1
    TrsmRatGearReq1  # Transmission: Requested Gear Ratio | The gear ratio which is requested by ration strategy | Theoretical transmission ratio i = ntransmission_in / ntransmission_out transmission_in = after converter transmission_out = gearbox out The gear ratio means the theoretical/physical ratio belonging to each gear and not any actual measured value. Proposal for Continuously Variable Transmission (CVT): if there is a wide range for gear states, this value could deliver a theoretical ratio. Negative values: Reverse driving direction. Without considering the: 1.) Axle ratio 2.) Converter ratio 3.) High/Low-Range ratio'Default value after reset is 1.0.'
      data TrsmRatGearReq: type=Fac1
    TrsmRatGearTar1  # Transmission: The Gear Ratio Which Will Be Engaged in the Gear Box When Target Gear Is Reached | Theoretical transmission ratio i = ntransmission_in / ntransmission_out transmission_in = after converter transmission_out = gearbox out The gear ratio means the theoretical/physical ratio belonging to each gear and not any actual measured value (proposal for Continuously Variable Transmission (CVT): if there is a wide range for gear states, this value could deliver a theoretical value). Negative values: Reverse driving direction. Without considering the: 1.) axle ratio 2.) converter ratio 3.) High/Low-Range ratio | Default value after reset is 1.0.
      data TrsmRatGearTar: type=Fac1
    TrsmRatTqPtAct1  # Transmission: Actual Powertrain Torque Ratio | Torque conversion ratio including everything between engine and wheel, i.e. converter gain (only for hydraulic converter), gear box and axle ratio. | TQwheel = (TQclutch * FACconverter * ntransmission_in / nwheel) - TQlossDT TQ conversion ratio = FACconverter * ntransmission_in / nwheel (remark: TQlossDT is not considered here) FACconverter = converter gain transmission_in = after converter/clutch Inertia is not considered. The torque conversion ratio considers only the total powertrain torque at wheels, not the wheel individual torque distribution. At open drivetrain: To get a valid value during the open drivetrain always the lowest gear should be used except: Driver or strategy selects "N" or "P": Every transmission has an open drivetrain Low vehicle speed: Manual Transmission (MT), Automatic Manual Transmission (AMT) and Dual Clutch Transmission (DCT) have an open drivetrain. For Automatic Transmission (AT) and Continuously Variable Transmission (CVT) the drivetrain is still closed (hydraulic converter) Shifting: Only Manual Transmission (MT) and Automatic Manual Transmission (AMT) have an open drivetrain for Automatic Manual Transmission (AMT), if a gear shift is detected, the torque ratio calculation changes from using the current gear state to the target gear state at some point during the shift. This point of change must be agreed between transmitter and receiver. The torque ratio never indicates neutral during a shift. for Automatic Transmission (AT), Continuously Variable Transmission (CVT) and Dual Clutch Transmission (DCT): While the drivetrain is open the transmission prepares a theoretical gear position to engage immediately after the driver selects "D". This theoretical gear state information should be used.Default value after reset is 1.0.
      data TrsmRatTqPtAct: type=Fac5
    TrsmRatTqPtConsold1  # Transmission: Consolidated Powertrain Torque Ratio | Torque conversion ratio including everything between engine and wheel, i.e. converter gain (only for hydraulic converter), gear box and axle ratio. | TQwheel = (TQclutch * FACconverter * ntransmission_in / nwheel) - TQlossDT TQ conversion ratio = FACconverter * ntransmission_in / nwheel (remark: TQlossDT is not considered here) FACconverter = converter gain transmission_in = after converter/clutch Inertia is not considered. The torque conversion ratio considers only the total powertrain torque at wheels, not the wheel individual torque distribution. At open drivetrain: To get a valid value during the open drivetrain always the lowest gear should be used except: Driver or strategy selects "N" or "P": every transmission has an open drivetrain Low vehicle speed: Manual Transmission (MT), Automatic Manual Transmission (AMT) and Dual Clutch Transmission (DCT) have an open drivetrain. For Automatic Transmission (AT) and Continuously Variable Transmission (CVT) the drivetrain is still closed (hydraulic converter) Shifting: Only Manual Transmission (MT) and Automatic Manual Transmission (AMT) have an open drivetrain for Automatic Manual Transmission (AMT), if a gear shift is detected, the torque ratio calculation changes from using the current gear state to the target gear state at some point during the shift. This point of change must be agreed between transmitter and receiver. The torque ratio never indicates neutral during a shift. for Automatic Transmission (AT), Continuously Variable Transmission (CVT) and Dual Clutch Transmission (DCT): While the drivetrain is open the transmission prepares a theoretical gear position to engage immediately after the driver selects "D". This theoretical gear state information should be used.Default value after reset is 1.0.
      data TrsmRatTqPtConsold: type=Fac5
    TrsmRatTqTrsmOutpByTqClu1  # Transmission: Ratio of Torque at Transmission Output by Torque at Clutch | Ratio of torque at transmission output by torque at clutch. | Current ratio of “Torque at Transmission Output” by “Torque at Clutch”. This ratio covers the ratio of the gearbox, but does not cover the ratio of the transfer case or the ratio of the reduction gearbox, if present. For transmissions without a converter: The slip of the drive-off element is supposed to be zero for the calculation of this signal. For transmissions with a converter: The signal is calculated with the current converter torque ratio. The converter torque ratio is continuously updated. For transmissions with a converter, the signal is the combination of the current torque ratio of the gearbox core and the actual torque ratio of the converter including the converter clutch, if present.
      data TrsmRatTqTrsmOutpByTqClu: type=Fac5  # Transmission: Ratio of Torque at Transmission Output by Torque at Clutch
    TrsmRatTqTrsmOutpByTqCluTar1  # Transmission: Target Ratio of Torque at Transmission Output By Torque at Clutch | Target ratio of torque at transmission output by torque at clutch. | The ratio of "Torque at Transmission Output" by "Torque at Clutch", calculated at the current vehicle speed, is expected to be reached when the target gear is engaged. This ratio covers the ratio of the gearbox, but not the transfer case and the reduction gearbox, if present. For transmissions without a converter: The slip of the drive-off element is supposed to be zero for the calculation of this signal. For transmissions with a converter: The signal is calculated with the current converter torque ratio, because the converter torque ratio in the target gear is unknown. The converter torque ratio is continuously updated. For transmissions with a converter, the signal is the combination of the torque ratio of the gearbox core in target gear and the current torque ratio of the converter including the converter clutch, if present. The signal changes synchronously with the change of the "Transmission: Transmission Gear State". References to other signals: TrsmGearSt
      data TrsmRatTqTrsmOutpByTqCluTar: type=Fac5  # Transmission: Target Ratio of Torque at Transmission Output By Torque at Clutch
    TrsmRatTqWhlByTqClu1  # Transmission: Ratio of Torque at Wheel by Torque at Clutch | Ratio of torque at wheel by torque at clutch. | Current ratio of "Torque at Wheel" by "Torque at Clutch". This ratio covers the ratio of the gearbox, the transfer case and the reduction gearbox, if present. For transmissions without a converter: The slip of the drive-off element is supposed to be zero for the calculation of this signal. For transmissions with a converter: The signal is calculated with the current converter torque ratio. The converter torque ratio is continuously updated. For transmissions with a converter, the signal is the combination of the current torque ratio of the gearbox core and the current torque ratio of the converter including the converter clutch, if present.
      data TrsmRatTqWhlByTqClu: type=Fac5  # Transmission: Ratio of Torque at Wheel by Torque at Clutch
    TrsmRatTqWhlByTqCluTar1  # Transmission: Target Ratio of Torque at Wheel by Torque at Clutch | Target ratio of torque at wheel by torque at clutch. | The ratio of "Torque at Wheel" by "Torque at Clutch", calculated at the current vehicle speed, is expected to be reached when the target gear is engaged. This ratio covers the ratio of the gearbox, the transfer case and the reduction gearbox, if present. For transmissions without a converter: The slip of the drive-off element is supposed to be zero for the calculation of this signal. For transmissions with a converter: The signal is calculated with the current converter torque ratio, because the converter torque ratio in the target gear is unknown. The converter torque ratio is continuously updated. For transmissions with a converter, the signal is the combination of the torque ratio of the gearbox core in target gear and the current torque ratio of the converter including the converter clutch, if present. The signal changes synchronously with the change of the "Transmission: Transmission Gear State". References to other signals: TrsmGearSt
      data TrsmRatTqWhlByTqCluTar: type=Fac5  # Transmission: Target Ratio of Torque at Wheel by Torque at Clutch
    TrsmRxnOfPasePanicReq1  # Transmission Reception of Pase Panic Request | Request given by Passive Entry (PASE) to command a panic alert.
      data TrsmRxnOfPasePanicReq: type=ReqSt1
    TrsmStGearLvr1  # Transmission: Gear Lever Position | The signal is based on the lever position. Only defined for automatic transmissions.
      data TrsmStGearLvr: type=TrsmPosnGearLvr1
    TrsmStTrfCaseDftl1  # Transmission: Status of the Transfer Case Differential | Status of the Transfer Case Differential
      data TrsmStTrfCaseDftl: type=DevErrSt4
    TrsmTOil1  # Transmission: Transmission Oil Temperature | Transmission oil temperature. | No further explanation needed.
      data TrsmTOil: type=T4  # Transmission: Transmission Oil Temperature
    TrsmTiCluNReqTar1  # Transmission: Target Time to Reach Clutch Speed Requested by Transmission | Target time to reach clutch speed requested by transmission. | The speed at clutch requested by "Transmission: Clutch Speed Requested by Transmission" must be reached in the transmitted target time. As long as there is no speed request, the recommendation is to send the initialization value. References to other signals: TrsmCluNReq
      data TrsmTiCluNReqTar: type=Ti3  # Transmission: Target Time to Reach Clutch Speed Requested by Transmission
    TrsmTqCluGbxCnsNIdleCtrlr1  # Transmission: Gearbox Torque Consumption at Clutch for Idle Speed Controller | Gearbox torque at clutch consumption based on transmission oil pump torque losses and drive-off element torque. | The torque consumed by the gearbox must be provided to the engine to ensure stable idle speed operation. Together with other torque losses, it significantly contributes to the idle speed controller setpoint, especially if there is no driver torque request. Consequently it is used for precontrol in the idle speed controller and defines an essential part of the minimum limit for the driver torque request. The gearbox torque consumption is a) the sum of the drive-off element torque and the absolute value of the transmission oil pump torque losses, if the propulsion unit is in idle speed, the vehicle is at a standstill and there is no driver torque request. Especially the drive-off element torque depends on the targeted state of power transmission of the gearbox, which is determined primarily by the gear lever position. b) the absolute value of the transmission oil pump torque losses, if the drive-off element is closed. c) a combination of a) and b) depending on the propulsion unit speed, vehicle speed and gearbox control strategy in all other situations. In this case, this signal might even be greater than the torque value of a) because the propulsion unit speed is greater than the idle speed. But the combination is limited by a powertrain torque limit. If the torque at clutch is greater than this limit, then this signal is less than the real/physical torque at clutch. A typical behavior is that the summated torque a) at vehicle standstill is ramped to the transmission oil pump torque b). The ramp depends on the vehicle speed and reaches b) at low vehicle speeds, e.g., 7km/h. The transition from idle speed to driving usually is completed at this velocity.
      data TrsmTqCluGbxCnsNIdleCtrlr: type=Tq5  # Transmission: Gearbox Torque Consumption at Clutch for Idle Speed Controller
    TrsmTqCluGrdtUpprLimReq1  # Transmission: Clutch Torque Gradient Upper Limit Requested by Transmission | Transmission request to limit the clutch torque gradient if changes in the real and virtual driver requests could cause the clutch torque gradient to be greater than the specified limit. | Transmission request to limit the clutch torque gradient if changes in the real and virtual driver requests could cause the clutch torque gradient to be greater than the specified limit. Other requests such as engine internal stall protection and idle speed control or other external interventions, are not permitted to be limited. This signal offers the following benefit in comparison to the transmission torque requests: The effect of the signal must be visible on signals "Powertrain: Torque at Clutch", "Powertrain: Torque at Clutch without Transmission Intervention", "Powertrain: Requested Torque at Clutch without Transmission Intervention", “Powertrain: Predicted Driver Request of Torque at Clutch in Target Speed”. As a default value, or if there is no request from the transmission, the passive value (FEh) is sent. The target is to implement this gradient limitation as fast as possible by fast and slow request. For “Mild Hybrids” and “Full Hybrids” (Parallel Hybrids), the transmission transmits the “gradient of the summarized torque request of combustion engine and electric machine”. For “Full Hybrids” (Parallel Hybrids), the torque transmitted by the engine clutch must be considered. References to other signals: PtTqClu PtTqCluWoTrsmIntv PtTqCluReqWoTrsmIntv PtDrvrReqTqCluPredEngN homogenous transition without torque jumps, preventive protection without unintended effects on driving behavior, improvement of dynamics in comparison to limitation by the transmission torque requests.
      data TrsmTqCluGrdtUpprLimReq: type=TqGrdt1  # Transmission: Clutch Torque Gradient Upper Limit Requested by Transmission
    TrsmTqCluLoss1  # Transmission: Transmission Torque Losses at Clutch | Transmission torque losses at clutch. | The transmission torque losses include the torque of the gearbox oil pump and gearbox internal losses, e.g., bearing friction and drag torque losses of clutches. Torque losses occurring at a shaft with a speed different from the clutch speed must be converted to clutch speed considering the relevant transmission ratio. Typically, the values are from test bench measurements. These losses are usually considered when converting engine to wheel torque and vice versa. In projects in which the differential and transfer case and/or reduction gearbox are integrated in the transmission housing, the signal also considers the losses of these components. The value sent on the network is the absolute value of the transmission torque losses. The value on the application level must consider the sign. The Application Data Type must cover negative values.
      data TrsmTqCluLoss: type=Tq6  # Transmission: Transmission Torque Losses at Clutch
    TrsmTqCluMaxFastReqForShiftIntv1  # Transmission: Request for Maximum Torque at Clutch for Shift Intervention on Fast Path | Maximum torque at clutch requested by transmission for shift intervention on fast path. | Usually used for shift intervention, but permitted for all purposes. As long as there is no torque request from the transmission, a constant substitute value (“no request”) or the maximum value is transmitted on the signal. In parallel hybrid projects, the transmission transmits the summarized torque request of the combustion engine and the electric machine. This signal is defined for an absolute intervention. The interface for relative interventions to the reference "Powertrain: Torque at Clutch without Transmission Intervention" must be defined separately. References to other signals: PtTqCluWoTrsmIntv
      data TrsmTqCluMaxFastReqForShiftIntv: type=Tq5  # Transmission: Request for Maximum Torque at Clutch for Shift Intervention on Fast Path
    TrsmTqCluMaxProtnReq1  # Transmission: Maximum Torque at Clutch Requested by Transmission for Gearbox Protection | Maximum torque limitation for gearbox protection. | A torque decrease in the engine is performed via fast path and slow path. The engine limits the value of the torque at clutch as defined in the signal "Powertrain: Torque at Clutch", so the effects of dynamic torque are not considered. The lower limit to be considered by the engine depends on the torque necessary for the engine internal stall protection. The global target is to prevent damage to gearbox and drivetrain, e.g. caused by mechanical and thermal overload. The indicated torque must be calculated based on this signal, without consideration of the torque influence of inertia. Although this signal is a transmission intervention, the effect must also be visible on all signals with the suffix "...without Intervention". The calculation of this signal by the provider is not permitted to consider the inertia, which has an effect on the torque at clutch. This means that the signal must be calculated as if the inertia is 0 kg*(m^2). References to other signals: PtTqClu
      data TrsmTqCluMaxProtnReq: type=Tq5  # Transmission: Maximum Torque at Clutch Requested by Transmission for Gearbox Protection
    TrsmTqCluMaxSlowReqForShiftIntv1  # Transmission: Request for Maximum Torque at Clutch for Shift Intervention on Slow Path | Maximum torque at clutch requested by transmission for shift intervention on slow path. | Usually used for shift intervention, but permitted for all purposes. As long as there is no torque request from the transmission, a constant substitute value (“no request”) or the maximum value is transmitted on the signal. In parallel hybrid projects, the transmission transmits the summarized torque request of the combustion engine and the electric machine. This signal is defined for an absolute intervention. The interface for relative interventions to the reference "Powertrain: Torque at Clutch without Transmission Intervention" must be defined separately. References to other signals: PtTqCluWoTrsmIntv
      data TrsmTqCluMaxSlowReqForShiftIntv: type=Tq5  # Transmission: Request for Maximum Torque at Clutch for Shift Intervention on Slow Path
    TrsmTqCluMinFastReqForShiftIntv1  # Transmission: Request for Minimum Torque at Clutch for Shift Intervention on Fast Path | Minimum torque at clutch requested by transmission for shift intervention on fast path. | Usually used for shift intervention, but permitted for all purposes. As long as there is no torque request from the transmission, a constant substitute value (“no request”) or the minimum value is transmitted on the signal. In parallel hybrid projects, the transmission transmits the summarized torque request of the combustion engine and the electric machine. This signal is defined for an absolute intervention. The interface for relative interventions to the reference "Powertrain: Torque at Clutch without Transmission Intervention" must be defined separately. References to other signals: PtTqCluWoTrsmIntv
      data TrsmTqCluMinFastReqForShiftIntv: type=Tq5  # Transmission: Request for Minimum Torque at Clutch for Shift Intervention on Fast Path
    TrsmTqCluMinProtnReq1  # Transmission: Minimum Torque at Clutch Requested by Transmission for Gearbox Protection | Minimum torque limitation for gearbox protection. | The global target is to prevent damage to gearbox and drivetrain, e.g. caused by mechanical and thermal overload. The signal ensures that the gearbox is not loaded with very low negative torque at clutch. Signal is relevant for projects with an electric machine. The implementation of the gearbox request is limited by the driving motors: For efficiency and safety reasons, the minimum torque for gearbox protection is not permitted to lead to a positive indicated or inner torque on any of the driving motors. The limitation must be implemented only by affecting the negative torque of the electric machine. The effects of dynamic torque are not considered. Although this signal is a transmission intervention, the effect must also be visible on all signals with the suffix "...without Transmission Intervention".
      data TrsmTqCluMinProtnReq: type=Tq5  # Transmission: Minimum Torque at Clutch Requested by Transmission for Gearbox Protection
    TrsmTqCluMinSlowReqForShiftIntv1  # Transmission: Request for Minimum Torque at Clutch for Shift Intervention on Slow Path | Minimum torque at clutch requested by transmission for shift intervention on slow path. | Usually used for shift intervention, but permitted for all purposes. As long as there is no torque request from the transmission, a constant substitute value (“no request”) or the minimum value is transmitted on the signal. In parallel hybrid projects, the transmission transmits the summarized torque request of the combustion engine and the electric machine. This signal is defined for an absolute intervention. The interface for relative interventions to the reference "Powertrain: Torque at Clutch without Transmission Intervention" must be defined separately. References to other signals: PtTqCluWoTrsmIntv
      data TrsmTqCluMinSlowReqForShiftIntv: type=Tq5  # Transmission: Request for Minimum Torque at Clutch for Shift Intervention on Slow Path
    TrsmTqCluReqForShiftIntv1  # Transmission: Request for Torque at Clutch for Shift Intervention | Torque at clutch requested by transmission for shift intervention. | This signal is closely related to the signals for "implementation type" and “intervention mode” of request: “Transmission: Implementation Type of Request for Torque at Clutch for Shift Intervention”, “Transmission: Intervention Mode Request for Torque at Clutch for Shift Intervention”. Usually used for shift interventions, but permitted for all purposes. As long as there is no torque request, the signal "Transmission: Implementation Type of Request for Torque at Clutch for Shift Intervention", is “0h = no request” and signal “Transmission: Request for Torque at Clutch for Shift Intervention” is “FFEh = Init”. In parallel hybrid projects, the transmission transmits the summarized torque request of the combustion engine and the electric machine. References to other signals: TrsmNrTypOfTqCluReqForShiftIntv TrsmIntvModReqForTqCluReqForShiftIntv
      data TrsmTqCluReqForShiftIntv: type=Tq5  # Transmission: Request for Torque at Clutch for Shift Intervention
    TrsmTqCluResvReq1  # Transmission: Request for Torque Reserve at Clutch | Request to increase torque on slow path without affecting torque at clutch. Reference for increase is defined by the corresponding status signal. | This signal is closely related to "Transmission: Implementation Type of Request for Torque Reserve at Clutch". The engine must compensate for the increased air mass by ignition retard and/or injection cutoff. The engine is not permitted to increase the air mass more than can be compensated for. This prevents unintended acceleration of the car. This torque reserve prepares the engine to implement torque increase requests as quickly as it is required. References to other signals: TrsmNrTypOfTqCluResvReq
      data TrsmTqCluResvReq: type=Tq5  # Transmission: Request for Torque Reserve at Clutch
    TrsmTqCluStandStillPred1  # Transmission: Predicted Transmission Torque at Clutch in Standstill | Predicted transmission torque at clutch in vehicle motion state “Standstill”. | Predicted value of torque at clutch consumed by the transmission in standstill. It includes the torque losses caused by the transmission oil pump and the slipping drive-off element such as converter and drive-off clutch. It is calculated continuously, depending on the gear lever position and the targeted state of power transmission. The transmission calculates this signal by using the engine speed setpoint. The signal is to be used as a prediction in the idle speed controller at vehicle standstill.
      data TrsmTqCluStandStillPred: type=Tq5  # Transmission: Predicted Transmission Torque at Clutch in Standstill
    TrsmTqDftlAxleFrntAct1  # Transmission: Actual Differential Torque at Front Axle | Actual theoretical maximum transfer torque at the differential on the front axle as realised by the actuator. | Sign convention: Positive to the right or front.
      data TrsmTqDftlAxleFrntAct: type=Tq13  # Actual theoretical maximum transfer torque at the differential on the front axle as realised by the actuator
    TrsmTqDftlAxleFrntConsold1  # Transmission: Consolidated Differential Torque at Front Axle | Actual theoretical maximum transfer torque at the differential on the front axle as realised by the actuator. | Sign convention: Positive to the right or front.
      data TrsmTqDftlAxleFrntConsold: type=Tq13  # Actual theoretical maximum transfer torque at the differential on the front axle as realised by the actuator
    TrsmTqDftlAxleFrntMax1  # Transmission: Maximum Differential Torque at Front Axle | Absolute value of the maximum torque at the differential on the front axle.
      data TrsmTqDftlAxleFrntMax: type=Tq14  # Absolute value of the maximum torque at the differential on the front axle
    TrsmTqDftlAxleReAct1  # Transmission: Actual Differential Torque at Rear Axle | Actual theoretical maximum transfer torque at the differential on the rear axle as realised by the actuator. | Sign convention: Positive to the right or front.
      data TrsmTqDftlAxleReAct: type=Tq13  # Actual theoretical maximum transfer torque at the differential at the rear axle as realised by the actuator
    TrsmTqDftlAxleReConsold1  # Transmission: Consolidated Differential Torque at Rear Axle | Actual theoretical maximum transfer torque at the differential on the rear axle as realised by the actuator. | Sign convention: Positive to the right or front.
      data TrsmTqDftlAxleReConsold: type=Tq13  # Actual theoretical maximum transfer torque at the differential at the rear axle as realised by the actuator
    TrsmTqDftlAxleReMax1  # Transmission: Maximum Differential Torque at Rear Axle | Absolute value of the maximum torque at the differential at the rear axle
      data TrsmTqDftlAxleReMax: type=Tq14  # Absolute value of the maximum torque at the differential at the rear axle
    TrsmTqDftlTrfAct1  # Transmission: Actual Differential Transfer Torque | Actual theoretical maximum transfer torque at the differential as realised by the actuator. | Sign convention: Positive to the right or front.
      data TrsmTqDftlTrfAct: type=Tq13  # Actual theoretical maximum transfer Torque Transfer Case Differential as realised by the actuator
    TrsmTqDftlTrfConsold1  # Transmission: Consolidated Differential Transfer Torque | Actual theoretical maximum transfer torque at the differential as realised by the actuator. | Sign convention: Positive to the right or front.
      data TrsmTqDftlTrfConsold: type=Tq13  # Actual theoretical maximum transfer Torque Transfer Case Differential as realised by the actuator
    TrsmTqDftlTrfMax1  # Transmission: Maximum Differential Transfer Torque | Absolute value of the maximum torque at the Transfer Case Differential
      data TrsmTqDftlTrfMax: type=Tq14  # Absolute value of the maximum torque at the Transfer Case Differential
    TrsmTqOilPmp1  # Transmission: Transmission Oil Pump Load | Transmission oil pump load at clutch level. | The torque consumption of the transmission oil pump especially depends on the gearbox temperature, rotational speed and system pressure of the transmission hydraulic system. Typically, the values are from test bench measurements. Used to distinguish between gearbox core losses and gearbox oil pump torque losses, which can only be measured together. The signal can be used by the propulsion unit to calculate Torque at Clutch with higher precision, especially for transmissions with a permanently connected transmission oil pump. If the pump is an electric oil pump, then the value should be zero Nm, because the load is included in the alternator load. The value of this signal is converted to clutch torque by the provider. The value sent on the network is the absolute value of the transmission torque losses. The value on the application level must consider the sign. The Application Data Type must cover negative values.
      data TrsmTqOilPmp: type=Tq6  # Transmission: Transmission Oil Pump Load
    TrsmTqWhlIndDistbn1  # Individual Torque at Wheel Distribution as Realized by Transmission System | Individual torque at wheel distribution as realized by Transmission System. Vector of 4 signals. | The DTD (drivetrain torque distribution) component in the transmission system realizes the torque distribution request and powertrain coordinator sends the coordinated actual wheel torques as feedback to the chassis. This interface only considers the torque which can be distributed from one or more central torque producers to the wheels by the transmission system. It does not consider additional torque producers located e.g. at the individual wheels. Where no torque is distributed to the wheels by the transmission system (e.g. one axle not driven or directly driven by an electric machine), the respective values are zero. In case of actor/sensor failures or if there is no possibility to determine the correct distribution a rough estimation is done. Additionally a qualifier has to be set, to inform about invalid or backup values.
      4 x data, all with type=Tq7:
        TrsmTqWhlIndDistbnFrntLe  # Front left wheel
        TrsmTqWhlIndDistbnFrntRi  # Front right wheel
        TrsmTqWhlIndDistbnReLe  # Rear left wheel
        TrsmTqWhlIndDistbnReRi  # Rear right wheel
    UpReqForRoofCnvtb1  # Up Request for Roof Convertible | Request related to Roof folded in the trunk. This request assists the customer to open the trunk with the roof folded in for a luggage access.
      data Req: type=OnOff1  # On: Request to assist the customer to open the trunk with the roof folded in Off: No request to assist the customer to open the trunk with the roof folded in
    VehBrkTqApplyReq1  # Vehicle Brake Torque Apply Request 1 | Indicates whether the Vehicle Longitudinal Control wants Electronic Stability Control to apply a desired vehicle global brake torque or not.
      data VehBrkTqReqSt: type=ReqSt1
    VehBrkTqGrdtReq1  # Vehicle Brake Torque Gradient Request 1 | Time Derivative of the requested total vehicle brake torque. Based on nominal brake parameters (e.g. constant pads friction) and (estimated or measured) brake clamp forces.
      data VehBrkTqGrdtReq: type=TqGrdt1
    VehBrkTqIntd1  # Vehicle Brake Torque Intended 1 | Sum of 4 wheel intended brake torques. Result of arbitration between driver and other chassis functions.
      data VehBrkTqIntd: type=Tq4
    VehBrkTqReq1  # Vehicle Brake Torque Request 1 | Generic interface for requested longitudinal vehicle brake torque based on nominal brake parameters and (estimated) brake pressures (clamp forces).
      data VehBrkTqReq: type=Tq4
    VehCourseCrvtCorrd1  # Corrected Vehicle Course Curvature | Curvature of predicted vehicle course which is calculated from vehicle information and environmental information.
      data VehCourseCrvtCorrd: type=Crvt1
    VehCourseCrvtPred1  # Predicted Vehicle Course Curvature | Curvature of predicted vehicle course which is calculated with vehicle speed and yaw rate.
      data VehCourseCrvtPred: type=Crvt1
    VehDetdByFolwCtrl1  # Follow Control Vehicle Detected | Target vehicle for follow control in Adaptive Cruise Control is detected. This information is used as input to Adaptive Cruise Control state machine.
      data St: type=DetnSt1  # 0: not detected 1: detected
    VehHldSt1  # Vehicle Hold Status 1 | Status that indicates whether a vehicle is held or not
      data VehHldSt: type=VehHldSt1
    VehHldSts1  # Vehicle Hold Status 1 | Status that indicates whether a vehicle is held or not
      data VehHldSts: type=VehHldSt1
    VehM1  # Vehicle Mass | Vehicle mass provided
      data VehM: type=M1
    VehMEstimd1  # Vehicle Mass Estimated | Estimation of the vehicle mass provided
      data VehMEstimd: type=M1
    VehMod1  # Vehicle Mode | This information is needed to know if the vehicle is in factory mode, show room mode, customer mode
      data VehMod: type=VehMod1
    VehMtnSt1  # Vehicle Motion State 1 | Vehicle motion state whether vehicle is moving forward or backward or if it is in stand still.
      data VehMtnSt: type=VehMtnSt1
    VehPitchovrMod1  # Vehicle Pitchover Mode | This interface shows the state of pitchover
      data VehPitchovrMod: type=PitchovrMod1
    VehRollovrMod1  # Vehicle Rollover Mode | This interface shows the state of rollover
      data VehRollovrMod: type=RollovrMod1
    VehSpd1  # Vehicle Speed 1 | Generic interface for vehicle speed
      data VehSpd: type=Spd3
    VehSpdDispd1  # Displayed Vehicle Speed | Vehicle speed shown on speedometer.
      data VehSpdDispd: type=Spd4
    VehSpdLgt1  # Vehicle Speed Longitudinal 1 | Vehicle longitudinal speed based on individual wheel speeds, possibly extended by acceleration sensor. Coordinate system according to ISO 8855. The vehicle speed refers to Center Of Gravity (COG). | During brake intervention the accuracy of vehicle speed may be reduced, e.g. For the measured value only 2 wheel speed sensors are used as the other ones are locked.
      data VehSpdLgt: type=Spd1
    VehTqWhlMaxSftyLimn1  # Safety Torque Limit Calculated from the Vehicle's Maximum Speed | Torque limit calculated from the vehicle's maximum speed limit. This speed limit is not the "comfort" speed limit; it is the safety or vehicle protection limit, normally not selectable by the driver.
      data VehTqWhlMaxSftyLimn: type=Tq7
    WhlBrkOvrheatd1  # Wheel Brake Overheated 1 | Wheel brake overheating Indication that at least one wheel brake (caliper, disc, pad) temperature is high
      data WhlBrkOvrheatd: type=TSt1  # 0: normal brake temperature 1: brake overheated
    WhlLoadDif1  # Wheel Load Difference 1 | Generic interface for wheel load difference on an axle defined as the total axle load applied to the left wheel (100%: Total axle load on left wheel, 0%: Total axle load on right wheel)
      data WhlLoadDif: type=Perc2
    WhlSpdWarnIndcn1  # Wheel Speed Warning Indication 1 | Warning indication, that the maximum speed allowed for the configured tires and/or actual pressure has been exceeded.
      data WhlSpdWarnIndcn: type=TirePMonWarnSt3
    WinHeatrSt1  # Window Heater Status | Activation status of window heater
      data WinHeatrSt: type=DevSt4
    WinHeatrSts1  # Window Heater Status | Activation status of window heater
      data WinHeatrSts: type=DevSts4
    WinWipgCmd1  # Window Wiping Command | Provides information to activate the front wiper. As long as the information is provided the actuator should be on.
      data Cmd: type=Wipg1
    WipgReq1  # Wiping Request | User request for wiping to switch on one strike, interval, low speed or high speed wiping. As long as a wipe sequence is requested, the corresponding value in the table below should be set.
      data Req: type=UsrReqForWipg1
    WipgSpdIntlReq1  # Wiping Speed Interval Request | Requests the interval speed. As long as a interval wipe sequence is requested the provided value of interval speed has to be used.
      data Req: type=WipgSpdIntl1
    WiprPosnCmd1  # Wiper Position Command | Provides information to run in a predefined position. As long as the information is provided the actuator should run/ stay in this position. If there is a valid Window Wiper Command, this supersedes commands given via this interface.
      data PosnReqd: type=WiprPosnReqd1
    WiprSt1  # Wiper Status | Wiper status information
      4 x data:
        Actv: type=OnOff1  # Provides information whether the wiper is currently running. (This is different to the status data element, as the status may report an active interval wiping. Consequently, the status data element does not allow to determine, if the wiper is currently running.) As long as the status is valid the corresponding value should be provided.
        Failr: type=DevErrSt2  # Used as feedback from an actuator component to indicate that the wiper is broken. | Note that no details of the fault are transmitted, but just an operational / defective fault indication.This data element shall not be used for detailed diagnostics.
        Posn: type=WiprPosnMeasd1  # Provides information in which position the wiper is in. As long as the status is valid the corresponding value should be provided.
        St: type=Wipg1  # Provides information about the current mode of the wiping system. As long as the status is valid the corresponding value should be provided.
    WiprSts1  # Wiper Status | Wiper status information
      4 x data:
        Actv: type=OnOff1  # Provides information whether the wiper is currently running. (This is different to the status data element, as the status may report an active interval wiping. Consequently, the status data element does not allow to determine, if the wiper is currently running.) As long as the status is valid the corresponding value should be provided.
        Failr: type=DevErrSts2  # Used as feedback from an actuator component to indicate that the wiper is broken. | Note that no details of the fault are transmitted, but just an operational / defective fault indication.This data element shall not be used for detailed diagnostics.
        Posn: type=WiprPosnMeasd1  # Provides information in which position the wiper is in. As long as the status is valid the corresponding value should be provided.
        Sts: type=Wipg1  # Provides information about the current mode of the wiping system. As long as the status is valid the corresponding value should be provided.
    WiprWshrDiReq1  # Wiper Washer Disable Request | Request to the wiper washer manager, to suppress wash or wipe actions.
      data Req: type=OnOff1
    WshngCmd1  # Washing Command | Actual command to activate the window washing (front, rear or headlamps). As long as the information is provided the actuator should be on.
      data Cmd: type=OnOff1
    WshngReq1  # Washing Request | Actual command to activate the washing, carries a user request to activate the washing of windows (front, rear or headlamps). As long as the information is provided the actuator should be on.
      data Req: type=OnOff1
    WshrFldSt1  # Washer Fluid Status | Provides information if the low limit of washer fluid is reached (enough=above threshold; low level=below threshold). As long as the water level is under the low limit the status is "on".
      data Elm: type=WshrFldLvlLo1
    WshrFldSts1  # Washer Fluid Status | Provides information if the low limit of washer fluid is reached (enough=above threshold; low level=below threshold). As long as the water level is under the low limit the status is "on".
      data Elm: type=WshrFldLvlLo1
    WshrSt1  # Washer Status | Provides the status and failure state information typically sent by a washer.
      data Failr: type=DevErrSt2  # Used as feedback from an actuator component to indicate that the washer is broken. | Note that no details of the fault are transmitted, but just an operational / defective fault indication.
      data St: type=OnOff1  # Provides information whether the washer is on or off. As long as the status is valid the corresponding value should be provided.
    WshrSts1  # Washer Status | Provides the status and failure state information typically sent by a washer.
      data Failr: type=DevErrSts2  # Used as feedback from an actuator component to indicate that the washer is broken. | Note that no details of the fault are transmitted, but just an operational / defective fault indication.
      data Sts: type=OnOff1  # Provides information whether the washer is on or off. As long as the status is valid the corresponding value should be provided.
    YawRate1  # Yaw Rate 1 | Generic interface for yaw rate measured along vehicle z- axis (i.e. compensated for orientation). Coordinate system according to ISO 8855
      data YawRate: type=AgSpd3
    YawRateGrdt1  # Yaw Rate Gradient 1 | Time-derivative of Yaw Rate
      data YawRateGrdt: type=AgA2
    YawStabyCtrlIntvg1  # Yaw Stability Control Intervening 1 | Yaw stability control intervention status.
      data YawStabyCtrlIntvg: type=CtrlSt1  # 0: Yaw stability control not intervening 1: Yaw stability control intervening
    YawStabyInfo1  # Yaw Stability Information 1 | Yaw stability information: Negative shows understeer. Positive shows oversteer. 0 is designed vehicle stable state. +/-100 is start of Yaw Control intervention.
      data YawStabyInfo: type=Perc6
    YawTq1  # Yaw Torque 1 | Generic interface for yaw torque
      data YawTq: type=Tq2
