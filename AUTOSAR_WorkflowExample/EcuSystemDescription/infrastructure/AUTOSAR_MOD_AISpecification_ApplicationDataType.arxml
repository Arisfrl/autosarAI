AUTOSAR XML (schema 00054)
package /AUTOSAR_AISpecification/ApplicationDataTypes
  283 x app type, all with sw-calibration-access=READ-ONLY:
    A1: category=VALUE, compu-method=A1, data-constr=A1, sw-intended-resolution=0.0078125, unit=MtrPerSecSqd  # Acceleration 1 | Generic data type for acceleration
    A10: category=VALUE, compu-method=A10, data-constr=A10, sw-intended-resolution=0.010004885, unit=MtrPerSecSqd  # Acceleration 10 | Generic data type for acceleration
    A11: category=VALUE, compu-method=A11, data-constr=A11, sw-intended-resolution=0.00391, unit=MtrPerSecSqd  # Acceleration 11 | Generic data type for acceleration
    A12: category=VALUE, compu-method=A12, data-constr=A12, sw-intended-resolution=0.03125, unit=MtrPerSecSqd  # Acceleration 12 | Generic data type for acceleration
    A13: category=VALUE, compu-method=A13, data-constr=A13, sw-intended-resolution=0.0625, unit=MtrPerSecSqd  # Acceleration 13 | Generic data type for acceleration
    A14: category=VALUE, compu-method=A14, data-constr=A14, sw-intended-resolution=0.25, unit=MtrPerSecSqd  # Acceleration 14 | Generic data type for acceleration
    A2: category=VALUE, compu-method=A2, data-constr=A2, sw-intended-resolution=0.00390625, unit=MtrPerSecSqd  # Acceleration 2 | Generic data type for acceleration
    A3: category=VALUE, compu-method=A3, data-constr=A3, sw-intended-resolution=0.0009765625, unit=MtrPerSecSqd  # Acceleration 3 | Generic data type for acceleration
    A4: category=VALUE, compu-method=A4, data-constr=A4, sw-intended-resolution=0.0009765625, unit=MtrPerSecSqd  # Acceleration 4 | Generic data type for acceleration
    A5: category=VALUE, compu-method=A5, data-constr=A5, sw-intended-resolution=0.00390625, unit=MtrPerSecSqd  # Acceleration 5 | Generic data type for acceleration
    A7: category=VALUE, compu-method=A7, data-constr=A7, sw-intended-resolution=0.01, unit=MtrPerSecSqd  # Acceleration 7 | Generic data type for acceleration
    A8: category=VALUE, compu-method=A8, data-constr=A8, sw-intended-resolution=0.036, unit=MtrPerSecSqd  # Acceleration 8 | Generic data type for acceleration
    A9: category=VALUE, compu-method=A9, data-constr=A9, sw-intended-resolution=0.143753, unit=MtrPerSecSqd  # Acceleration 9 | Generic data type for acceleration
    Ag1: category=VALUE, compu-method=Ag1, data-constr=Ag1, sw-intended-resolution=0.0009765625, unit=Rad  # Angle 1 | Generic data type for angle
    Ag2: category=VALUE, compu-method=Ag2, data-constr=Ag2, sw-intended-resolution=0.0009765625, unit=Rad  # Angle 2 | Generic data type for angle
    Ag3: category=VALUE, compu-method=Ag3, data-constr=Ag3, sw-intended-resolution=0.0001220703125, unit=Rad  # Angle 3 | Generic data type for angle
    Ag4: category=VALUE, compu-method=Ag4, data-constr=Ag4, sw-intended-resolution=0.0009765625, unit=Rad  # Angle 4 | Generic data type for angle
    Ag5: category=VALUE, compu-method=Ag5, data-constr=Ag5, sw-intended-resolution=0.0009765625, unit=Rad  # Angle 5 | Generic data type for angle
    Ag6: category=VALUE, compu-method=Ag6, data-constr=Ag6, sw-intended-resolution=0.012368475, unit=Rad  # Angle 6 | Generic data type for angle
    AgA1: category=VALUE, compu-method=AgA1, data-constr=AgA1, sw-intended-resolution=0.125, unit=RadPerSecSqd  # Angle Acceleration 1 | Generic data type for angle acceleration
    AgA2: category=VALUE, compu-method=AgA2, data-constr=AgA2, sw-intended-resolution=0.00390625, unit=RadPerSecSqd  # Angle Acceleration 2 | Generic data type for angle acceleration
    AgSpd1: category=VALUE, compu-method=AgSpd1, data-constr=AgSpd1, sw-intended-resolution=0.0078125, unit=RadPerSec  # Angle Speed 1 | Generic data type for angle speed
    AgSpd2: category=VALUE, compu-method=AgSpd2, data-constr=AgSpd2, sw-intended-resolution=0.0009765625, unit=RadPerSec  # Angle Speed 2 | Generic data type for angle speed
    AgSpd3: category=VALUE, compu-method=AgSpd3, data-constr=AgSpd3, sw-intended-resolution=0.000244140625, unit=RadPerSec  # Angle Speed 3 | Generic data type for angle speed
    AgSpd4: category=VALUE, compu-method=AgSpd4, data-constr=AgSpd4, sw-intended-resolution=0.0009765625, unit=RadPerSec  # Angle Speed 4 | Generic data type for angle speed
    AgSpd5: category=VALUE, compu-method=AgSpd5, data-constr=AgSpd5, sw-intended-resolution=0.0009765625, unit=RadPerSec  # Angle Speed 5 | Generic data type for angle speed
    AgSpd6: category=VALUE, compu-method=AgSpd6, data-constr=AgSpd6, sw-intended-resolution=0.015625, unit=RadPerSec  # Angle Speed 6 | Generic data type for angle speed
    AgSpd7: category=VALUE, compu-method=AgSpd7, data-constr=AgSpd7, sw-intended-resolution=0.001, unit=RadPerSec  # Angle Speed 7 | Generic data type for angle speed
    AgSpd8: category=VALUE, compu-method=AgSpd8, data-constr=AgSpd8, sw-intended-resolution=0.000244140625, unit=RadPerSec  # Angle Speed 8 | Generic data type for angle speed
    Crvt1: category=VALUE, compu-method=Crvt1, data-constr=Crvt1, sw-intended-resolution=3.05185094759971E-06, unit=PerMtr  # Curvature 1 | Generic data type for curvature
    DamprCoeff1: category=VALUE, compu-method=DamprCoeff1, data-constr=DamprCoeff1, sw-intended-resolution=1, unit=NwtSecPerMtr  # Damper Coefficient 1 | Generic data type for damper coefficient
    Day1: category=VALUE, compu-method=Day1, data-constr=Day1, sw-intended-resolution=1, unit=NoUnit  # Day 1 | It represents the value of a day in a month
    F{1..3}: category=VALUE, compu-method=F{1..3}, data-constr=F{1..3}, sw-intended-resolution=1, unit=Nwt  # Force {1..3} | Generic data type for force
    Fac1: category=VALUE, compu-method=Fac1, data-constr=Fac1, sw-intended-resolution=0.0009765625, unit=NoUnit  # Factor 1 | Generic data type for factor
    Fac3: category=VALUE, compu-method=Fac3, data-constr=Fac3, sw-intended-resolution=0.00048828125, unit=NoUnit  # Factor 3 | Generic data type for factor
    Fac4: category=VALUE, compu-method=Fac4, data-constr=Fac4, sw-intended-resolution=0.00048828125, unit=NoUnit  # Factor 4 | Generic data type for factor
    Fac5: category=VALUE, compu-method=Fac5, data-constr=Fac5, sw-intended-resolution=0.0078125, unit=NoUnit  # Factor 5 | Generic data type for factor
    Fac7: category=VALUE, compu-method=Fac7, data-constr=Fac7, sw-intended-resolution=3.92156862745098E-03, unit=NoUnit  # Factor 7 | Generic data type for factor
    FricCoeff1: category=VALUE, compu-method=FricCoeff1, data-constr=FricCoeff1, sw-intended-resolution=0.01, unit=NoUnit  # Friction Coefficient 1 | Generic data type for friction coefficient
    Frq1: category=VALUE, compu-method=Frq1, data-constr=Frq1, sw-intended-resolution=0.0625, unit=Hz  # Frequency 1 | Generic data type for frequency
    Frq2: category=VALUE, compu-method=Frq2, data-constr=Frq2, sw-intended-resolution=0.1, unit=KiloHz  # Frequency 2 | Generic data type for acoustic frequency
    Hr1: category=VALUE, compu-method=Hr1, data-constr=Hr1, sw-intended-resolution=1, unit=NoUnit  # Hour 1 | It represents the value of an hour in a day (24h format)
    Jerk1: category=VALUE, compu-method=Jerk1, data-constr=Jerk1, sw-intended-resolution=0.00390625, unit=MtrPerSecCubd  # Jerk 1 | Generic data type for acceleration change rate
    Len1: category=VALUE, compu-method=Len1, data-constr=Len1, sw-intended-resolution=0.00098, unit=Mtr  # Length 1 | Generic data type for length
    Len10: category=VALUE, compu-method=Len10, data-constr=Len10, sw-intended-resolution=0.015625477, unit=Mtr  # Length 10 | Generic data type for length
    Len11: category=VALUE, compu-method=Len11, data-constr=Len11, sw-intended-resolution=0.010004885, unit=Mtr  # Length 11 | Generic data type for length
    Len14: category=VALUE, compu-method=Len14, data-constr=Len14, sw-intended-resolution=0.1, unit=Mtr  # Length 14 | Generic data type for length
    Len3: category=VALUE, compu-method=Len3, data-constr=Len3, sw-intended-resolution=0.000244140625, unit=Mtr  # Length 3 | Generic data type for length
    Len4: category=VALUE, compu-method=Len4, data-constr=Len4, sw-intended-resolution=0.0009765625, unit=Mtr  # Length 4 | Generic data type for length
    Len5: category=VALUE, compu-method=Len5, data-constr=Len5, sw-intended-resolution=0.00390625, unit=Mtr  # Length 5 | Generic data type for length
    Len6: category=VALUE, compu-method=Len6, data-constr=Len6, sw-intended-resolution=0.5, unit=KiloMtr  # Length 6 | Generic data type for length
    Len7: category=VALUE, compu-method=Len7, data-constr=Len7, sw-intended-resolution=0.015625, unit=Mtr  # Length 7 | Generic data type for length
    M1: category=VALUE, compu-method=M1, data-constr=M1, sw-intended-resolution=1, unit=KiloGr  # Mass 1 | Generic data type for mass
    M2: category=VALUE, compu-method=M2, data-constr=M2, sw-intended-resolution=1, unit=KiloGr  # Mass 2 | Generic data type for mass
    Mins1: category=VALUE, compu-method=Mins1, data-constr=Mins1, sw-intended-resolution=1, unit=NoUnit  # Minute 1 | It represents the value of a minute in one hour
    Mth1: category=VALUE, compu-method=Mth1, data-constr=Mth1, sw-intended-resolution=1, unit=NoUnit  # Month 1 | It represents the value of a month in a calendar year
    N1: category=VALUE, compu-method=N1, data-constr=N1, sw-intended-resolution=0.5, unit=Rpm  # Rotational Speed 1 | Generic data type for rotational speed
    NGrdt1: category=VALUE, compu-method=NGrdt1, data-constr=NGrdt1, sw-intended-resolution=1, unit=RpmPerSec  # Engine Speed Gradient | Generic data type for rotational speed gradient
    Nr1: category=VALUE, compu-method=Nr1, data-constr=Nr1, sw-intended-resolution=1, unit=NoUnit  # Number 1 | Generic data type for number
    Nr10: category=VALUE, compu-method=Nr10, data-constr=Nr10, sw-intended-resolution=1, unit=NoUnit  # Number 10 | Generic data type for number
    Nr{2..9}: category=VALUE, compu-method=Nr{2..9}, data-constr=Nr{2..9}, sw-intended-resolution=1, unit=NoUnit  # Number {2..9} | Generic data type for number
    P1: category=VALUE, compu-method=P1, data-constr=P1, sw-intended-resolution=0.0078125, unit=Bar  # Pressure 1 | Generic data type for pressure
    P4: category=VALUE, compu-method=P4, data-constr=P4, sw-intended-resolution=5, unit=HectoPa  # Pressure 4 | Generic data type for pressure
    P5: category=VALUE, compu-method=P5, data-constr=P5, sw-intended-resolution=16384, unit=Pa  # Pressure 5 | Generic data type for high pressure | Examples for usage: fuel pressure
    P6: category=VALUE, compu-method=P6, data-constr=P6, sw-intended-resolution=32, unit=Pa  # Pressure 6 | Generic data type for low pressure | Examples for usage: ambient air pressure, particulate filter differential pressure
    P7: category=VALUE, compu-method=PaIdentcl, data-constr=RngUnlimd, sw-intended-resolution=0.0000001, unit=Pa  # Pressure 7 | Generic data type for pressure | Examples for usage: ambient air pressure, particulate filter differential pressure, fuel pressure Remark: use for floating point implementation
    Perc1: category=VALUE, compu-method=Perc1, data-constr=Perc1, sw-intended-resolution=0.00390625, unit=Perc  # Percent 1 | Generic data type for percent
    Perc10: category=VALUE, compu-method=Perc10, data-constr=Perc10, sw-intended-resolution=0.01, unit=Perc  # Percent 10 | Generic data type for percent | Examples for usage: common solenoid actuator (EGR), Pedal
    Perc11: category=VALUE, compu-method=PercIdentcl, data-constr=RngUnlimd, sw-intended-resolution=0.0000001, unit=Perc  # Percent 11 | Generic data type for percent | Examples for usage: common solenoid actuator (EGR), Pedal Remark: use for floating point implementation
    Perc2: category=VALUE, compu-method=Perc2, data-constr=Perc2, sw-intended-resolution=0.5, unit=Perc  # Percent 2 | Generic data type for percent
    Perc6: category=VALUE, compu-method=Perc6, data-constr=Perc6, sw-intended-resolution=1, unit=Perc  # Percent 6 | Generic data type for percent
    Perc7: category=VALUE, compu-method=Perc7, data-constr=Perc7, sw-intended-resolution=0.1, unit=Perc  # Percent 7 | Generic data type for percent
    Perc8: category=VALUE, compu-method=Perc8, data-constr=Perc8, sw-intended-resolution=0.00031, unit=Perc  # Percent 8 | Generic data type for percent
    Perc9: category=VALUE, compu-method=Perc9, data-constr=Perc9, sw-intended-resolution=0.1, unit=Perc  # Percent 9 | Generic data type for percent
    PercGrdt1: category=VALUE, compu-method=PercGrdt1, data-constr=PercGrdt1, sw-intended-resolution=0.0625, unit=PercPerSec  # Percent Gradient 1 | Generic data type for percent gradient
    Sec1: category=VALUE, compu-method=Sec1, data-constr=Sec1, sw-intended-resolution=1, unit=NoUnit  # Second 1 | It represents the value of a second in one minute
    Spd1: category=VALUE, compu-method=Spd1, data-constr=Spd1, sw-intended-resolution=0.00390625, unit=MtrPerSec  # Speed 1 | Generic data type for speed
    Spd2: category=VALUE, compu-method=Spd2, data-constr=Spd2, sw-intended-resolution=0.00390625, unit=MtrPerSec  # Speed 2 | Generic data type for speed
    Spd3: category=VALUE, compu-method=Spd3, data-constr=Spd3, sw-intended-resolution=0.25, unit=MtrPerSec  # Speed 3 | Generic data type for speed
    Spd4: category=VALUE, compu-method=Spd4, data-constr=Spd4, sw-intended-resolution=0.03125, unit=MtrPerSec  # Speed 4 | Generic data type for speed
    Spd5: category=VALUE, compu-method=Spd5, data-constr=Spd5, sw-intended-resolution=0.003906369, unit=MtrPerSec  # Speed 5 | Generic data type for speed
    Spd6: category=VALUE, compu-method=Spd6, data-constr=Spd6, sw-intended-resolution=0.003906369, unit=MtrPerSec  # Speed 6 | Generic data type for speed
    SprgCoeff1: category=VALUE, compu-method=SprgCoeff1, data-constr=SprgCoeff1, sw-intended-resolution=1, unit=NwtPerMtr  # Spring Coefficient 1 | Generic data type for spring coefficient
    T1: category=VALUE, compu-method=T1, data-constr=T1, sw-intended-resolution=0.5, unit=DegCgrd  # Temperature 1 | Generic data type for temperature
    T3: category=VALUE, compu-method=T3, data-constr=T3, sw-intended-resolution=1, unit=DegCgrd  # Temperature 3 | Generic data type for temperature
    T4: category=VALUE, compu-method=T4, data-constr=T4, sw-intended-resolution=1, unit=DegCgrd  # Temperature 4 | Generic data type for temperature
    T5: category=VALUE, compu-method=T5, data-constr=T5, sw-intended-resolution=0.1, unit=KelvinAbslt  # Temperature 5 | Generic data type for temperature | Examples for usage: glow plugs temperature, oil temperature, environment temperature, temperature differences
    T6: category=VALUE, compu-method=KelvinIdentcl, data-constr=RngUnlimd, sw-intended-resolution=0.0000001, unit=KelvinAbslt  # Temperature 6 | Generic data type for temperature | Examples for usage: glow plugs temperature, oil temperature, environment temperature, temperature differences Remark: use for floating point implementation
    Ti2: category=VALUE, compu-method=Ti2, data-constr=Ti2, sw-intended-resolution=0.1, unit=Sec  # Time 2 | Generic data type for time
    Ti3: category=VALUE, compu-method=Ti3, data-constr=Ti3, sw-intended-resolution=0.001, unit=Sec  # Time 3 | Generic data type for time
    Ti4: category=VALUE, compu-method=Ti4, data-constr=Ti4, sw-intended-resolution=0.00000025, unit=Sec  # Time 4 | Generic data type for time
    Tq1: category=VALUE, compu-method=Tq1, data-constr=Tq1, sw-intended-resolution=0.00390625, unit=NwtMtr  # Torque 1 | Generic data type for torque
    Tq10: category=VALUE, compu-method=Tq10, data-constr=Tq10, sw-intended-resolution=1, unit=NwtMtr  # Torque 10 | Generic data type for torque
    Tq12: category=VALUE, compu-method=Tq12, data-constr=Tq12, sw-intended-resolution=1, unit=NwtMtr  # Torque 12 | Generic data type for torque
    Tq13: category=VALUE, compu-method=Tq13, data-constr=Tq13, sw-intended-resolution=1, unit=NwtMtr  # Torque 13 | Generic data type for torque | Examples for usage: Differential Torques
    Tq14: category=VALUE, compu-method=Tq14, data-constr=Tq14, sw-intended-resolution=1, unit=NwtMtr  # Torque 14 | Generic data type for torque
    Tq15: category=VALUE, compu-method=Tq15, data-constr=Tq15, sw-intended-resolution=0.00391, unit=NwtMtr  # Torque 15 | Generic data type for torque
    Tq16: category=VALUE, compu-method=Tq16, data-constr=Tq16, sw-intended-resolution=1, unit=NwtMtr  # Torque 16 | Generic torque application data type for the physical torque signal values of the network representation. | Base Type: Uint12 Special values FFEh and FFFh are reserved for future definition of signal quality.
    Tq2: category=VALUE, compu-method=Tq2, data-constr=Tq2, sw-intended-resolution=1, unit=NwtMtr  # Torque 2 | Generic data type for torque
    Tq3: category=VALUE, compu-method=Tq3, data-constr=Tq3, sw-intended-resolution=4, unit=NwtMtr  # Torque 3 | Generic data type for torque
    Tq4: category=VALUE, compu-method=Tq4, data-constr=Tq4, sw-intended-resolution=4, unit=NwtMtr  # Torque 4 | Generic data type for torque
    Tq5: category=VALUE, compu-method=Tq5, data-constr=Tq5, sw-intended-resolution=0.0625, unit=NwtMtr  # Torque 5 | Generic data type for torque | Examples for usage: torque at clutch and torque at crankshaft signals
    Tq6: category=VALUE, compu-method=Tq6, data-constr=Tq6, sw-intended-resolution=0.0625, unit=NwtMtr  # Torque 6 | Generic data type for torque
    Tq7: category=VALUE, compu-method=Tq7, data-constr=Tq7, sw-intended-resolution=0.0625, unit=NwtMtr  # Torque 7 | Generic data type for torque | Examples for usage: torque at wheels signals
    TqGrdt1: category=VALUE, compu-method=TqGrdt1, data-constr=TqGrdt1, sw-intended-resolution=16, unit=NwtMtrPerSec  # Torque Gradient 1 | Generic data type for torque gradient
    U1: category=VALUE, compu-method=U1, data-constr=U1, sw-intended-resolution=0.1, unit=Volt  # Voltage 1 | Generic data type for voltage
    Yr1: category=VALUE, compu-method=Yr1, data-constr=Yr1, sw-intended-resolution=1, unit=NoUnit  # Year 1 | It represents the value of a year in a century
    AckSt1: category=VALUE, compu-method=AckSt1, data-constr=AckSt1, unit=NoUnit  # Acknowledge Status 1 | Generic acknowledge status 1
    AckSts1: category=VALUE, compu-method=AckSts1, data-constr=AckSts1, unit=NoUnit  # Acknowledge Status 1 | Generic acknowledge status 1
    AlrmSt1: category=VALUE, compu-method=AlrmSt1, data-constr=AlrmSt1, unit=NoUnit  # Alarm Status | information about alarm status provided for the usage of the other components
    AlrmSts1: category=VALUE, compu-method=AlrmSts1, data-constr=AlrmSts1, unit=NoUnit  # Alarm Status | information about alarm status provided for the usage of the other components
    ArmingTyp2: category=VALUE, compu-method=ArmingTyp2, data-constr=ArmingTyp2, unit=NoUnit  # Arming Type | To describe if the alarm is armed or not, along with the precision whether the arming process is finished or not
    ArmingTyp3: category=BOOLEAN, compu-method=ArmingTyp3, data-constr=ArmingTyp3, unit=NoUnit  # Arming Type | To describe if the alarm is armed or not
    AvlSt1: category=VALUE, compu-method=AvlSt1, data-constr=AvlSt1, unit=NoUnit  # Available Status 1 | Generic available status 1
    AvlSts1: category=VALUE, compu-method=AvlSts1, data-constr=AvlSts1, unit=NoUnit  # Available Status 1 | Generic available status 1
    AxisTyp1: category=VALUE, compu-method=AxisTyp1, data-constr=AxisTyp1, unit=NoUnit  # Axis Type | It indicates the axis to use.
    BltLockSt1: category=VALUE, compu-method=BltLockSt1, data-constr=BltLockSt1, unit=NoUnit  # Belt Lock State | Belt lock state
    BltLockSt2: category=VALUE, compu-method=BltLockSt2, data-constr=BltLockSt2, unit=NoUnit  # Belt Lock State | Belt lock state with additional seat availability information
    BodyLvlCtrl1: category=VALUE, compu-method=BodyLvlCtrl1, data-constr=BodyLvlCtrl1, unit=NoUnit  # Body Level Control | Activity of the body level control. Direction of the body movement
    BodyLvlMod1: category=VALUE, compu-method=BodyLvlMod1, data-constr=BodyLvlMod1, unit=NoUnit  # Body Level Mode 1 | Body Level Mode1
    Boolean: category=BOOLEAN, compu-method=Boolean, unit=NoUnit  # Generic data type for boolean
    BrkActrMod1: category=VALUE, compu-method=BrkActrMod1, data-constr=BrkActrMod1, unit=NoUnit  # Brake Actuator Mode 1 | Indicates the action executed by the brake actuator or its state
    BrkActrSatn1: category=VALUE, compu-method=BrkActrSatn1, data-constr=BrkActrSatn1, unit=NoUnit  # Brake Actuator Saturation 1 | Indicates that a brake actuator is in saturation mode
    BrkMod1: category=VALUE, compu-method=BrkMod1, data-constr=BrkMod1, unit=NoUnit  # Brake Mode | Brake mode
    BrkReqTyp1: category=VALUE, compu-method=BrkReqTyp1, data-constr=BrkReqTyp1, unit=NoUnit  # Brake Request Type 1 | Indicates whether a vehicle deceleration force request is set to Electric Parking Brake
    BrkReqTyp2: category=VALUE, compu-method=BrkReqTyp2, data-constr=BrkReqTyp2, unit=NoUnit  # Brake Request Type 2 | Indicates whether a vehicle deceleration force request is set to Electronic Stability Control
    BucdSt1: category=VALUE, compu-method=BucdSt1, data-constr=BucdSt1, unit=NoUnit  # Buckled State | State of occupants concerning buckling
    CalSt1: category=VALUE, compu-method=CalSt1, data-constr=CalSt1, unit=NoUnit  # Calibration Status 1 | Calibration status 1
    CalSts1: category=VALUE, compu-method=CalSts1, data-constr=CalSts1, unit=NoUnit  # Calibration Status 1 | Calibration status 1
    ChdProtnCmd1: category=VALUE, compu-method=ChdProtnCmd1, data-constr=ChdProtnCmd1, unit=NoUnit  # Child Protection Command | Datatype to activate and deactivate the child protection for the rear seat passengers.
    ChgInfo1: category=VALUE, compu-method=ChgInfo1, data-constr=ChgInfo1, unit=NoUnit  # Change | Indicates, whether an information about a change is present or not
    CluSt1: category=VALUE, compu-method=CluSt1, data-constr=CluSt1, unit=NoUnit  # Clutch State | Information about the state of the clutch. | There exist 4 principal states: open, intermediate, near closed, hard closed.The definition of intermediate and near closed has to be made for each project separately. Definition of "Clutch": Be aware that this information is not necessarily equal with the drivetrain open information. If a torque converter clutch is open, the drivetrain can still be closed. In contrary the drivetrain is open for Manual Transmission (MT) and Automatic Manual Transmission (AMT), if the clutch is open! for Automatic Transmission (AT), Continuously Variable Transmission (CVT) it is the converter clutch for Manual Transmission (MT), Automatic Manual Transmission (AMT) it is the clutch between the gear box and the engine drivetrain
    CornrMkr1: category=VALUE, compu-method=CornrMkr1, data-constr=CornrMkr1, unit=NoUnit  # Corner Marker | Corner Marker Request
    CptInfo1: category=VALUE, compu-method=CptInfo1, data-constr=CptInfo1, unit=NoUnit  # Component Information | Information about components for key learning/authorization
    CrashSt1: category=VALUE, compu-method=CrashSt1, data-constr=CrashSt1, unit=NoUnit  # Crash Status | Simplistic crash information
    CrashSts1: category=VALUE, compu-method=CrashSts1, data-constr=CrashSts1, unit=NoUnit  # Crash Status | Simplistic crash information
    CrsCtrlAndAccSwtSt1: category=VALUE, compu-method=CrsCtrlAndAccSwtSt1, data-constr=CrsCtrlAndAccSwtSt1, unit=NoUnit  # Cruise Control and ACC Switch Status 1 | Status of the switch to engage, disengage, or resume Adaptive Cruise Control or Cruise Control.
    CrsCtrlAndAccSwtSts1: category=VALUE, compu-method=CrsCtrlAndAccSwtSts1, data-constr=CrsCtrlAndAccSwtSts1, unit=NoUnit  # Cruise Control and ACC Switch Status 1 | Status of the switch to engage, disengage, or resume Adaptive Cruise Control or Cruise Control.
    CtrlSt1: category=VALUE, compu-method=CtrlSt1, data-constr=CtrlSt1, unit=NoUnit  # Control Status | Generic control status
    CtrlSts1: category=VALUE, compu-method=CtrlSts1, data-constr=CtrlSts1, unit=NoUnit  # Control Status | Generic control status
    DetnSt1: category=VALUE, compu-method=DetnSt1, data-constr=DetnSt1, unit=NoUnit  # Detection Status 1 | Generic detection status 1
    DetnSts1: category=VALUE, compu-method=DetnSts1, data-constr=DetnSts1, unit=NoUnit  # Detection Status 1 | Generic detection status 1
    DevErrSt1: category=VALUE, compu-method=DevErrSt1, data-constr=DevErrSt1, unit=NoUnit  # Device Error Status 1 | Generic device error status 1
    DevErrSt2: category=VALUE, compu-method=DevErrSt2, data-constr=DevErrSt2, unit=NoUnit  # Device Error Status | Generic device error status 2
    DevErrSt3: category=VALUE, compu-method=DevErrSt3, data-constr=DevErrSt3, unit=NoUnit  # Device Error Status 3 | Generic device error status 3
    DevErrSt4: category=VALUE, compu-method=DevErrSt4, data-constr=DevErrSt4, unit=NoUnit  # Device Error Status 4 | Generic device error status 4
    DevErrSts1: category=VALUE, compu-method=DevErrSts1, data-constr=DevErrSts1, unit=NoUnit  # Device Error Status 1 | Generic device error status 1
    DevErrSts2: category=VALUE, compu-method=DevErrSts2, data-constr=DevErrSts2, unit=NoUnit  # Device Error Status | Generic device error status 2
    DevErrSts3: category=VALUE, compu-method=DevErrSts3, data-constr=DevErrSts3, unit=NoUnit  # Device Error Status 3 | Generic device error status 3
    DevErrSts4: category=VALUE, compu-method=DevErrSts4, data-constr=DevErrSts4, unit=NoUnit  # Device Error Status 4 | Generic device error status 4
    DevSt4: category=VALUE, compu-method=DevSt4, data-constr=DevSt4, unit=NoUnit  # Device Status 4 | Generic device status 4
    DevSt5: category=VALUE, compu-method=DevSt5, data-constr=DevSt5, unit=NoUnit  # Device Status 5 | Generic device status 5
    DevSt6: category=VALUE, compu-method=DevSt6, data-constr=DevSt6, unit=NoUnit  # Device Status | Generic device status 6
    DevSt7: category=VALUE, compu-method=DevSt7, data-constr=DevSt7, unit=NoUnit  # Device Status 7 | Information on activation / deactivation of a device
    DevSts4: category=VALUE, compu-method=DevSts4, data-constr=DevSts4, unit=NoUnit  # Device Status 4 | Generic device status 4
    DevSts5: category=VALUE, compu-method=DevSts5, data-constr=DevSts5, unit=NoUnit  # Device Status 5 | Generic device status 5
    DevSts6: category=VALUE, compu-method=DevSts6, data-constr=DevSts6, unit=NoUnit  # Device Status | Generic device status 6
    DevSts7: category=VALUE, compu-method=DevSts7, data-constr=DevSts7, unit=NoUnit  # Device Status 7 | Information on activation / deactivation of a device
    DoorHndlSt1: category=VALUE, compu-method=DoorHndlSt1, data-constr=DoorHndlSt1, unit=NoUnit  # Door Handle Status | Information given by pull detector implemented on the door handle
    DoorHndlSts1: category=VALUE, compu-method=DoorHndlSts1, data-constr=DoorHndlSts1, unit=NoUnit  # Door Handle Status | Information given by pull detector implemented on the door handle
    DoorSt1: category=VALUE, compu-method=DoorSt1, data-constr=DoorSt1, unit=NoUnit  # Door Status | Status of the door.
    DoorSts1: category=VALUE, compu-method=DoorSts1, data-constr=DoorSts1, unit=NoUnit  # Door Status | Status of the door.
    DynPpty1: category=VALUE, compu-method=DynPpty1, data-constr=DynPpty1, unit=NoUnit  # Dynamic Property 1 | Status which indicates the dynamic property of the object (e.g. stationary, moving, etc). The definition is made according to the earth-fixed axis system as defined in ISO 8855.
    EgyMngtSt1: category=VALUE, compu-method=EgyMngtSt1, data-constr=EgyMngtSt1, unit=NoUnit  # Energy Management Status | This datatype is to reflect the load dump stages in case of improper battery/generator balance. The handling of over- or undervoltage is not covered within this datatype.
    EgyMngtSts1: category=VALUE, compu-method=EgyMngtSts1, data-constr=EgyMngtSts1, unit=NoUnit  # Energy Management Status | This datatype is to reflect the load dump stages in case of improper battery/generator balance. The handling of over- or undervoltage is not covered within this datatype.
    EngRunngDir1: category=VALUE, compu-method=EngRunngDir1, data-constr=EngRunngDir1, unit=NoUnit  # Engine Running Direction
    EngStrtRemReq1: category=BOOLEAN, compu-method=EngStrtRemReq1, data-constr=EngStrtRemReq1, unit=NoUnit  # Engine Start Remote Request | Request of engine start by remote control
    EntryEasy1: category=VALUE, compu-method=EntryEasy1, data-constr=EntryEasy1, unit=NoUnit  # Entry Easy | Indicates the easy entry status of the front/rear seats
    EpbBtnCtrlSt1: category=VALUE, compu-method=EpbBtnCtrlSt1, data-constr=EpbBtnCtrlSt1, unit=NoUnit  # Button Control Status 1 | status of Electric Parking Brake (EPB) control button.
    EpbBtnCtrlSts1: category=VALUE, compu-method=EpbBtnCtrlSts1, data-constr=EpbBtnCtrlSts1, unit=NoUnit  # Button Control Status 1 | status of Electric Parking Brake (EPB) control button.
    Fixa1: category=VALUE, compu-method=Fixa1, data-constr=Fixa1, unit=NoUnit  # Fixation | Fixation, e.g. of a seat
    Flg1: category=BOOLEAN, compu-method=Flg1, data-constr=Flg1, unit=NoUnit  # Flag | Gives the status of a flag to represent a boolean status (true or false)
    GearShiftPrevn1: category=VALUE, compu-method=GearShiftPrevn1, data-constr=GearShiftPrevn1, unit=NoUnit  # Gear Shift Prevention 1 | Gear shift prevention.
    HldOnDmdSt1: category=VALUE, compu-method=HldOnDmdSt1, data-constr=HldOnDmdSt1, unit=NoUnit  # Hold on Demand State 1 | Indicates the failure state of the Hold On Demand (HOD) function
    HomeCmngAndHomeLvngReq1: category=VALUE, compu-method=HomeCmngAndHomeLvngReq1, data-constr=HomeCmngAndHomeLvngReq1, unit=NoUnit  # Home Coming and Home Leaving Request | Indicates the coming home and leaving home requests.
    ImobSt1: category=VALUE, compu-method=ImobSt1, data-constr=ImobSt1, unit=NoUnit  # Immobilizer Status | Status of the Immobilizer operation
    ImobSts1: category=VALUE, compu-method=ImobSts1, data-constr=ImobSts1, unit=NoUnit  # Immobilizer Status | Status of the Immobilizer operation
    ImobnWirelsReq1: category=VALUE, compu-method=ImobnWirelsReq1, data-constr=ImobnWirelsReq1, unit=NoUnit  # Wireless Immobilizer Request | Signal to immobilize vehicle from phone signal
    ImpctSt1: category=VALUE, compu-method=ImpctSt1, data-constr=ImpctSt1, unit=NoUnit  # Impact Status | Information about status of impact
    ImpctSts1: category=VALUE, compu-method=ImpctSts1, data-constr=ImpctSts1, unit=NoUnit  # Impact Status | Information about status of impact
    InOut1: category=BOOLEAN, compu-method=InOut1, data-constr=InOut1, unit=NoUnit  # In Out | Information to know if something is outside or inside the vehicle
    IndcrForStop1: category=VALUE, compu-method=IndcrForStop1, data-constr=IndcrForStop1, unit=NoUnit  # Indicator For Stop | Data Type used for the indicator of the vehicle to precisely indicate the cycle of stop
    IndcrSt1: category=VALUE, compu-method=IndcrSt1, data-constr=IndcrSt1, unit=NoUnit  # Indicator Status | Turn indicators status
    IndcrSts1: category=VALUE, compu-method=IndcrSts1, data-constr=IndcrSts1, unit=NoUnit  # Indicator Status | Turn indicators status
    IndcrTypExt1: category=VALUE, compu-method=IndcrTypExt1, data-constr=IndcrTypExt1, unit=NoUnit  # Indicator Type External | indicator request types
    IntrLiReq1: category=VALUE, compu-method=IntrLiReq1, data-constr=IntrLiReq1, unit=NoUnit  # Interior Light Request | Indicates a generic request for an Interior Light source.
    InvldVld1: category=BOOLEAN, compu-method=InvldVld1, data-constr=InvldVld1, unit=NoUnit  # Invalid Valid | Information to precisely indicate if something is Valid or Invalid
    InvldVld2: category=VALUE, compu-method=InvldVld2, data-constr=InvldVld2, unit=NoUnit  # Invalid Valid | Information to precisely indicate if something is Valid or Invalid
    KeyCmd1: category=VALUE, compu-method=KeyCmd1, data-constr=KeyCmd1, unit=NoUnit  # Key Command | Command for key learning or authorization
    KeyInsertSt1: category=BOOLEAN, compu-method=KeyInsertSt1, data-constr=KeyInsertSt1, unit=NoUnit  # Key Insert Status | Key Insert status
    KeyInsertSts1: category=BOOLEAN, compu-method=KeyInsertSts1, data-constr=KeyInsertSts1, unit=NoUnit  # Key Insert Status | Key Insert status
    KeySt1: category=VALUE, compu-method=KeySt1, data-constr=KeySt1, unit=NoUnit  # Key Status | Status of the key learning or authorization process
    KeySts1: category=VALUE, compu-method=KeySts1, data-constr=KeySts1, unit=NoUnit  # Key Status | Status of the key learning or authorization process
    LeRi1: category=BOOLEAN, compu-method=LeRi1, data-constr=LeRi1, unit=NoUnit  # Left Right 1 | Left Right Data type in reference to the driving direction
    LiOnWarn1: category=VALUE, compu-method=LiOnWarn1, data-constr=LiOnWarn1, unit=NoUnit  # Light On Warning | Lights on warning types
    LockActvn1: category=VALUE, compu-method=LockActvn1, data-constr=LockActvn1, unit=NoUnit  # Lock Activation | Generic states of a lock 1
    LockSt1: category=VALUE, compu-method=LockSt1, data-constr=LockSt1, unit=NoUnit  # Lock Status | Status of the lock. In some countries the state safed is not supported.
    LockSt2: category=VALUE, compu-method=LockSt2, data-constr=LockSt2, unit=NoUnit  # Lock Status | Generic status of a lock
    LockStOfSteerCol1: category=VALUE, compu-method=LockStOfSteerCol1, data-constr=LockStOfSteerCol1, unit=NoUnit  # Steering Column Lock Status | Status of the Steering Column Lock
    LockSts1: category=VALUE, compu-method=LockSts1, data-constr=LockSts1, unit=NoUnit  # Lock Status | Status of the lock. In some countries the state safed is not supported.
    LockSts2: category=VALUE, compu-method=LockSts2, data-constr=LockSts2, unit=NoUnit  # Lock Status | Generic status of a lock
    LockStsOfSteerCol1: category=VALUE, compu-method=LockStsOfSteerCol1, data-constr=LockStsOfSteerCol1, unit=NoUnit  # Steering Column Lock Status | Status of the Steering Column Lock
    LockTrigSrc1: category=VALUE, compu-method=LockTrigSrc1, data-constr=LockTrigSrc1, unit=NoUnit  # Lock Trigger Source | Lock operations triggering source.
    LockUnlckReq1: category=VALUE, compu-method=LockUnlckReq1, data-constr=LockUnlckReq1, unit=NoUnit  # Lock Unlock Request | Locking / unlocking Request
    LockgCenReq1: category=VALUE, compu-method=LockgCenReq1, data-constr=LockgCenReq1, unit=NoUnit  # Locking Central Request | Indicates the type of the generic request for the central locking system without specifying the actuator and the source of the request
    LockgCenReqSrc1: category=VALUE, compu-method=LockgCenReqSrc1, data-constr=LockgCenReqSrc1, unit=NoUnit  # Locking Central Request Source | Information which source sends a central locking request
    MemBtn1: category=VALUE, compu-method=MemBtn1, data-constr=MemBtn1, unit=NoUnit  # Memory Button | Indicates the selected memory button
    MirrTyp1: category=VALUE, compu-method=MirrTyp1, data-constr=MirrTyp1, unit=NoUnit  # Mirror Type | It indicates the selected mirror
    MoveSt1: category=VALUE, compu-method=MoveSt1, data-constr=MoveSt1, unit=NoUnit  # Move Status | Movement status
    MoveSts1: category=VALUE, compu-method=MoveSts1, data-constr=MoveSts1, unit=NoUnit  # Move Status | Movement status
    MovmtTyp1: category=VALUE, compu-method=MovmtTyp1, data-constr=MovmtTyp1, unit=NoUnit  # Movement Type | It indicates the sense of the movement of the selected axis.
    ObjClassn1: category=VALUE, compu-method=ObjClassn1, data-constr=ObjClassn1, unit=NoUnit  # Object Classification 1 | Class which indicates vehicle types (e.g. truck, passenger car, etc.)
    ObstclDstInPrkgSegSt1: category=VALUE, compu-method=ObstclDstInPrkgSegSt1, data-constr=ObstclDstInPrkgSegSt1, unit=NoUnit  # Obstacle Distance Park Status | Status of Distance to obstacle detected and measured by ultrasonic sensors. Triangulation is considered (fused signal).
    ObstclDstInPrkgSegSts1: category=VALUE, compu-method=ObstclDstInPrkgSegSts1, data-constr=ObstclDstInPrkgSegSts1, unit=NoUnit  # Obstacle Distance Park Status | Status of Distance to obstacle detected and measured by ultrasonic sensors. Triangulation is considered (fused signal).
    OccptClass1: category=VALUE, compu-method=OccptClass1, data-constr=OccptClass1, unit=NoUnit  # Occupant Class | Classification of occupant at seating position.
    OccptOutOfPos1: category=VALUE, compu-method=OccptOutOfPos1, data-constr=OccptOutOfPos1, unit=NoUnit  # Occupant out of Position | Classification of out of position of occupant
    OccptPresSt1: category=VALUE, compu-method=OccptPresSt1, data-constr=OccptPresSt1, unit=NoUnit  # Occupant Presence State | State of presence of occupant on dedicated seat position
    OnOff1: category=BOOLEAN, compu-method=OnOff1, data-constr=OnOff1, unit=NoUnit  # On Off 1 | Generic On/Off Information
    OnOff2: category=BOOLEAN, compu-method=OnOff2, data-constr=OnOff2, unit=NoUnit  # On Off 2 | Generic Off/On Information
    OpendClsd1: category=BOOLEAN, compu-method=OpendClsd1, data-constr=OpendClsd1, unit=NoUnit  # Opened Closed | Indicates open / closed status
    Oper1: category=VALUE, compu-method=Oper1, data-constr=Oper1, unit=NoUnit  # Operation | It indicates the type of an operation related to the position storing or restoring.
    OperModSt1: category=VALUE, compu-method=OperModSt1, data-constr=OperModSt1, unit=NoUnit  # Operation Mode Status | State are grouped into super-states according to the following hierarchy: Super-state: Idle - State: PrepIdle - State: Idle Super-state: identification - State: PrepIdn - State: IdAprvd - State: AcsyPost Super-state: Acsy - State: Acsy - State: IgOnPost Super-state: ignition - State: IgOn - State: EngRunng Super-state: crank - State: CrkPre - State: Crk | Special modes (PrepIdn, CrkPre, IgOnPost, AcsyPost, PrepIdle, ...):
    OperModSts1: category=VALUE, compu-method=OperModSts1, data-constr=OperModSts1, unit=NoUnit  # Operation Mode Status | State are grouped into super-states according to the following hierarchy: Super-state: Idle - State: PrepIdle - State: Idle Super-state: identification - State: PrepIdn - State: IdAprvd - State: AcsyPost Super-state: Acsy - State: Acsy - State: IgOnPost Super-state: ignition - State: IgOn - State: EngRunng Super-state: crank - State: CrkPre - State: Crk | Base modes (Idle, IdAprvd, Acsy, IgOn, Crk, EngRunng): Special modes (PrepIdn, CrkPre, IgOnPost, AcsyPost, PrepIdle, ...): Elements are fixed, no additional elements are possible. It must be implemented. Additional elements are possible. The implementation is voluntary.
    OutdBriSt1: category=VALUE, compu-method=OutdBriSt1, data-constr=OutdBriSt1, unit=NoUnit  # Outside Brightness Status | Indicates outside brightness status | The values need to be calibrated against light levels for each car.
    OutdBriSts1: category=VALUE, compu-method=OutdBriSts1, data-constr=OutdBriSts1, unit=NoUnit  # Outside Brightness Status | Indicates outside brightness status | The values need to be calibrated against light levels for each car.
    OvrdnSt1: category=VALUE, compu-method=OvrdnSt1, data-constr=OvrdnSt1, unit=NoUnit  # Overridden Status | Status of overriding
    OvrdnSts1: category=VALUE, compu-method=OvrdnSts1, data-constr=OvrdnSts1, unit=NoUnit  # Overridden Status | Status of overriding
    PitchovrMod1: category=VALUE, compu-method=PitchovrMod1, data-constr=PitchovrMod1, unit=NoUnit  # Vehicle Pitchover Mode | Information about pitchover status and direction
    PrkgLiIndcn1: category=VALUE, compu-method=PrkgLiIndcn1, data-constr=PrkgLiIndcn1, unit=NoUnit  # Parking Light Indication | data type for parking light
    ProfPenSt1: category=VALUE, compu-method=ProfPenSt1, data-constr=ProfPenSt1, unit=NoUnit  # Driver Profile | Determines different profiles of vehicle users. The profile is in many cases associated with a key.
    ProfPenSts1: category=VALUE, compu-method=ProfPenSts1, data-constr=ProfPenSts1, unit=NoUnit  # Driver Profile | Determines different profiles of vehicle users. The profile is in many cases associated with a key.
    PsdNotPsd1: category=VALUE, compu-method=PsdNotPsd1, data-constr=PsdNotPsd1, unit=NoUnit  # Pressed Not Pressed | Providing value of button if pressed or not pressed.
    PullAidCmd1: category=VALUE, compu-method=PullAidCmd1, data-constr=PullAidCmd1, unit=NoUnit  # Pull Aid Command | Indicates the pull aid command | Pull aid is considered to be a system that closes the door or rear lid (e.g. moves it from "ajar" to "closed") rather than a complete door/ rear lid moving system.
    RainSenSnvty1: category=VALUE, compu-method=RainSenSnvty1, data-constr=RainSenSnvty1, unit=NoUnit  # Rain Sensing Sensitivity | This type represents different sensitivity levels for rain-sensing.
    Ramp1: category=VALUE, compu-method=Ramp1, data-constr=Ramp1, unit=NoUnit  # Selection of ramps, e.g. custom definition for fade in/fade out times of Interior Lights
    ReqSt1: category=VALUE, compu-method=ReqSt1, data-constr=ReqSt1, unit=NoUnit  # Request Status 1 | Generic request status 1
    ReqSt2: category=VALUE, compu-method=ReqSt2, data-constr=ReqSt2, unit=NoUnit  # Request Status 2 | Generic request status 2
    ReqSts1: category=VALUE, compu-method=ReqSts1, data-constr=ReqSts1, unit=NoUnit  # Request Status 1 | Generic request status 1
    ReqSts2: category=VALUE, compu-method=ReqSts2, data-constr=ReqSts2, unit=NoUnit  # Request Status 2 | Generic request status 2
    RoadSt1: category=VALUE, compu-method=RoadSt1, data-constr=RoadSt1, unit=NoUnit  # Road Status | Road status
    RoadSts1: category=VALUE, compu-method=RoadSts1, data-constr=RoadSts1, unit=NoUnit  # Road Status | Road status
    RollovrMod1: category=VALUE, compu-method=RollovrMod1, data-constr=RollovrMod1, unit=NoUnit  # Vehicle Rollover Mode | Information about rollover status and direction
    SeatBltRmnWarnSt1: category=VALUE, compu-method=SeatBltRmnWarnSt1, data-constr=SeatBltRmnWarnSt1, unit=NoUnit  # Seat Belt Reminder Warning State | Warning state of seat belt reminder control in case further enumerations are required (e.g. country specific) this enumeration is to overload
    StOfObjMeasd1: category=VALUE, compu-method=StOfObjMeasd1, data-constr=StOfObjMeasd1, unit=NoUnit  # Status of Object Measured 1 | Status which indicates whether the object was measured in current cycle, or tracked only.
    StabrSt1: category=VALUE, compu-method=StabrSt1, data-constr=StabrSt1, unit=NoUnit  # Stabilizer Status | Status provided by the active or switchable stabilizer on one axle.
    StabrSts1: category=VALUE, compu-method=StabrSts1, data-constr=StabrSts1, unit=NoUnit  # Stabilizer Status | Status provided by the active or switchable stabilizer on one axle.
    SteerMod1: category=VALUE, compu-method=SteerMod1, data-constr=SteerMod1, unit=NoUnit  # Steering Mode 1 | Generic data type for steering controller tuning mode
    SteerVehStabyCtrlMod1: category=VALUE, compu-method=SteerVehStabyCtrlMod1, data-constr=SteerVehStabyCtrlMod1, unit=NoUnit  # Steering Vehicle Stability Control Mode 1 | Generic data type for steering vehicle stability system tuning mode
    StgOfSeatClima1: category=VALUE, compu-method=StgOfSeatClima1, data-constr=StgOfSeatClima1, unit=NoUnit  # Seat Clima Stage | seat climatisation stages with different levels of the seat climatization (colder or warmer temperatures)
    StsOfObjMeasd1: category=VALUE, compu-method=StsOfObjMeasd1, data-constr=StsOfObjMeasd1, unit=NoUnit  # Status of Object Measured 1 | Status which indicates whether the object was measured in current cycle, or tracked only.
    SuspMod1: category=VALUE, compu-method=SuspMod1, data-constr=SuspMod1, unit=NoUnit  # Suspension Mode 1 | Generic mode description for suspension.
    TSt1: category=VALUE, compu-method=TSt1, data-constr=TSt1, unit=NoUnit  # Temperature Status | Generic temperature status
    TSts1: category=VALUE, compu-method=TSts1, data-constr=TSts1, unit=NoUnit  # Temperature Status | Generic temperature status
    TerminalPosnMod1: category=VALUE, compu-method=TerminalPosnMod1, data-constr=TerminalPosnMod1, unit=NoUnit  # Terminal Position Mode | Status/request of key position and power supply
    TirePMonWarnSt{1..3}: category=VALUE, compu-method=TirePMonWarnSt{1..3}, data-constr=TirePMonWarnSt{1..3}, unit=NoUnit  # TPMS Warning Status {1..3} | Tire pressure monitoring warning status {1..3}
    TirePMonWarnSts{1..3}: category=VALUE, compu-method=TirePMonWarnSts{1..3}, data-constr=TirePMonWarnSts{1..3}, unit=NoUnit  # TPMS Warning Status {1..3} | Tire pressure monitoring warning status {1..3}
    TrsmPosnGearLvr1: category=VALUE, compu-method=TrsmPosnGearLvr1, data-constr=TrsmPosnGearLvr1, unit=NoUnit  # Transmission Position Gear Lever | Only defined for automatic transmissions. The signal is based on the lever position.
    TrsmTqReqTyp1: category=VALUE, compu-method=TrsmTqReqTyp1, data-constr=TrsmTqReqTyp1, unit=NoUnit  # Transmission Torque Requested Type 1 | Generic Transmission Torque Requested Type
    TrsmTyp1: category=VALUE, compu-method=TrsmTyp1, data-constr=TrsmTyp1, unit=NoUnit  # Transmission Type | Information on standard transmission. Other transmission types on value 5 - 15
    UsrReqForWipg1: category=VALUE, compu-method=UsrReqForWipg1, data-constr=UsrReqForWipg1, unit=NoUnit  # User Request for Wiping | It represents the selection of the interval time or the speed of the wiper requested by the user. The exact timings and wipe speeds are not standardized and need therefore to be parameterized.
    VehHldSt1: category=VALUE, compu-method=VehHldSt1, data-constr=VehHldSt1, unit=NoUnit  # Vehicle Hold State 1 | State of indication whether a vehicle is held or not.
    VehMod1: category=VALUE, compu-method=VehMod1, data-constr=VehMod1, unit=NoUnit  # Vehicle Mode | The vehicle is in Factory/Plant mode, Sale mode (show room mode), or customer mode
    VehMtnSt1: category=VALUE, compu-method=VehMtnSt1, data-constr=VehMtnSt1, unit=NoUnit  # Vehicle Motion State 1 | Information if vehicle is moving forward or backward or if it is in stand-still.
    WhlRotlDirMeasd1: category=VALUE, compu-method=WhlRotlDirMeasd1, data-constr=WhlRotlDirMeasd1, unit=NoUnit  # Wheel Rotational Direction Measured 1 | scalar assigned to one wheel which indicates if the wheel is moving ahead/standstill or in reverse
    WhlRotlDirStd1: category=VALUE, compu-method=WhlRotlDirStd1, data-constr=WhlRotlDirStd1, unit=NoUnit  # Wheel Rotational Direction Standard 1 | scalar assigned to one wheel which indicates if the wheel is moving ahead/standstill or in reverse
    Wipg1: category=VALUE, compu-method=Wipg1, data-constr=Wipg1, unit=NoUnit  # Wiping | It represents the selection of the interval time or the speed of the wiper. The exact timings and wipe speeds are not standardized and need therefore to be parameterized.
    WipgSpdIntl1: category=VALUE, compu-method=WipgSpdIntl1, data-constr=WipgSpdIntl1, unit=NoUnit  # Wiping Speed Interval | Represents the interval speeds of a window wiper
    WiprPosnMeasd1: category=VALUE, compu-method=WiprPosnMeasd1, data-constr=WiprPosnMeasd1, unit=NoUnit  # Wiper Position Measured | Defines specific wiper-positions on a window which can be measured
    WiprPosnReqd1: category=VALUE, compu-method=WiprPosnReqd1, data-constr=WiprPosnReqd1, unit=NoUnit  # Wiper Position Requested | Defines specific wiper-positions on a window which can be requested.
    WshrFldLvlLo1: category=VALUE, compu-method=WshrFldLvlLo1, data-constr=WshrFldLvlLo1, unit=NoUnit  # Washer Fluid Level Low | Provides information if the low limit of washer fluid is reached.
