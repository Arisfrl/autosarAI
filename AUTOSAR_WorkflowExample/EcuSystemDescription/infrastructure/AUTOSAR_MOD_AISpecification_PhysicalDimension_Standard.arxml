AUTOSAR XML (schema 00054)
package /AUTOSAR_AISpecification/PhysicalDimensions
  28 x physical dimension:
    Amnt1: molar-amount-exp=1  # Quantity of substance
    I1: current-exp=1  # Electric current
    Illmn1: luminous-intensity-exp=1  # Luminous intensity
    Len1: length-exp=1  # Length
    Len1M1TiNeg2: length-exp=1, mass-exp=1, time-exp=-2  # Force
    Len1TiNeg1: length-exp=1, time-exp=-1  # Velocity
    Len1TiNeg2: length-exp=1, time-exp=-2  # Acceleration
    Len1TiNeg3: length-exp=1, time-exp=-3  # Acceleration Time Gradient
    Len2M1TiNeg2: length-exp=2, mass-exp=1, time-exp=-2  # Torque
    Len2M1TiNeg3: length-exp=2, mass-exp=1, time-exp=-3  # Torque Time Gradient
    Len2M1TiNeg3INeg1: length-exp=2, mass-exp=1, time-exp=-3, current-exp=-1  # Voltage
    LenNeg1: length-exp=-1  # Inverse Length
    LenNeg1M1TiNeg2: length-exp=-1, mass-exp=1, time-exp=-2  # Pressure
    LenNeg3Amnt1: length-exp=-3, mass-exp=0, time-exp=0, current-exp=0, temperature-exp=0, molar-amount-exp=1, luminous-intensity-exp=0  # Concentration
    M1: mass-exp=1  # Mass
    M1TiNeg1: mass-exp=1, time-exp=-1  # Translational Dumping
    M1TiNeg2: mass-exp=1, time-exp=-2  # Surface Tension
    NoDimension  # Dimensionless
    NoDimension_1  # Ratio
    NoDimension_2  # Angle
    T1: temperature-exp=1  # Absolute Temperature
    T1_1: temperature-exp=1  # Relative Temperature
    T1_2: temperature-exp=1  # Absolute Temperature
    Ti1: time-exp=1  # Time
    TiNeg1: time-exp=-1  # Frequency
    TiNeg1_1: time-exp=-1  # Ratio Gradient
    TiNeg1_2: time-exp=-1  # Angular Speed
    TiNeg2: time-exp=-2  # Angular Acceleration
