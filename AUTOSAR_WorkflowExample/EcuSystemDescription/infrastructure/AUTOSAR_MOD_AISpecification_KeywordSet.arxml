AUTOSAR XML (schema 00054)
package /AUTOSAR_AISpecification/KeywordSets
  keyword set KeywordList  # AUTOSAR Keywords and Keywords Abbreviations
    1783 x keyword:
      Abnorm: abbr-name=Abnorm, classifications=Condition-Qualifier  # Abnormal
      Acrt: abbr-name=Acrt, classifications=Condition-Qualifier  # Accurate
      Adpd: abbr-name=Adpd, classifications=Condition-Qualifier  # Adapted
      Afim: abbr-name=Afim, classifications=Mean-Environment-Device  # Air-Fuel Imbalance Monitor (AFIM) | The air to fuel imbalance monitor is designed to detect differences in the air to fuel ratio between cylinders per engine bank.
      Aged: abbr-name=Aged, classifications=Condition-Qualifier
      Alwys: abbr-name=Alwys, classifications=Condition-Qualifier  # Always | At all times
      Any: abbr-name=Any, classifications=Condition-Qualifier
      Appch: abbr-name=Appch, classifications=Action-PhysicalType  # Approach
      Approx: abbr-name=Approx, classifications=Condition-Qualifier  # Approximate
      Approxn: abbr-name=Approxn, classifications=Action-PhysicalType  # Approximation | A number, amount, etc. that is not exact, but almost correct.
      Ata: abbr-name=Ata, classifications=Condition-Qualifier  # American Trucking Associations Diagnostics Bus
      Avs: abbr-name=Avs, classifications=Condition-Qualifier  # AVS | Adjustment Value Service
      Bcu: abbr-name=Bcu, classifications=Mean-Environment-Device  # BCU | (High Voltage) Battery Control Unit
      Bel: abbr-name=Bel, classifications=Condition-Qualifier  # bel (decibel)
      Bif: abbr-name=Bif, classifications=Mean-Environment-Device  # Bi-fuel
      Bkt: abbr-name=Bkt, classifications=Mean-Environment-Device  # Bucket | E.g. for excavator or wheel loader applications
      Bkup: abbr-name=Bkup, classifications=Condition-Qualifier  # Backup
      Blb: abbr-name=Blb, classifications=Mean-Environment-Device  # Bulb
      Bol: abbr-name=Bol, classifications=Condition-Qualifier  # Begin of live | Beginning of Life - e.g. in the context of battery: System state of a battery shortly after manufacturing
      Brg: abbr-name=Brg, classifications=Mean-Environment-Device  # Bearing | e.g. in compressor bearing, engine bearing
      Calrc: abbr-name=Calrc, classifications=Condition-Qualifier  # Caloric
      Canng: abbr-name=Canng, classifications=Mean-Environment-Device  # Canning | e.g: Catalyst Canning
      Cap: abbr-name=Cap, classifications=Mean-Environment-Device  # Capacitor | Capacitor used to store energy in an electric field (AUTOSAR BSW)
      Cbk: abbr-name=Cbk, classifications=Action-PhysicalType  # Callback | Callback + Callback functions
      Cbl: abbr-name=Cbl, classifications=Mean-Environment-Device  # Cable | An assembly of electrical conductors insulated from each other but laid up together (as by being twisted around a central core), for example in electrical cable
      Cco: abbr-name=Cco, classifications=Mean-Environment-Device  # Cylinder cut-off | Deactivation of single cylinders
      Chemcl: abbr-name=Chem, classifications=Condition-Qualifier  # Chemical | Chemical in "chemical catalyst heating"
      Cilc: abbr-name=Cilc, classifications=Mean-Environment-Device  # Cylinder-Individual Lambda Control
      Clnt: abbr-name=Clnt, classifications=Condition-Qualifier  # Client | A computer in a network that uses the services (such as access to files or shared peripherals) provided by a server
      Clog: abbr-name=Clog, classifications=Condition-Qualifier  # Similar to dirty, e.g. clog filter.
      Co2: abbr-name=Co2, classifications=Mean-Environment-Device  # CO2 | Carbon dioxide, Chemical molecule CO2
      Coach: abbr-name=Coach, classifications=Mean-Environment-Device  # motor coach, often simply called a bus
      Cok: abbr-name=Cok, classifications=Condition-Qualifier  # Coke | Coke, Coking Deposits on devices, which are very often in contact with the burning remainders of carbon based fuels, caused e.g. by incompletely burned fuel. There are special strategies to recognise or to prevent the building of these deposits.
      Contmn: abbr-name=Contmn, classifications=Condition-Qualifier  # Contamination | soiled, stained, corrupted, or infected
      Cs: abbr-name=Cs, classifications=Mean-Environment-Device  # Chip-select | Chip select or slave select is the name of a control line in digital electronics used to select one (or a set) of integrated circuits (commonly called "chips") out of several connected to the same computer bus
      Cum: abbr-name=Cum, classifications=Condition-Qualifier  # Cumulative | increasing by successive additions
      Cv: abbr-name=Cv, classifications=Mean-Environment-Device  # Commercial Vehicle | A commercial vehicle is any type of motor vehicle used for transporting goods or paying passengers.
      Dcdc: abbr-name=Dcdc, classifications=Mean-Environment-Device  # Converter (DCDC) | A DC-to-DC converter is an electronic circuit or electromechanical device that converts a source of direct current (DC) from one voltage level to another. A power inverter, inverter or invertor is a power electronic device or circuitry that changes direct current (DC) to alternating current (AC).
      Dcyc: abbr-name=Dcyc, classifications=Condition-Qualifier  # Driving Cycle | A driving cycle is a series of data points representing the speed of a vehicle versus time.
      Den: abbr-name=Den, classifications=Condition-Qualifier  # Deny | Deny, Denied, Not Accepted
      Denox: abbr-name=Denox, classifications=Action-PhysicalType  # DENOX | System Reduction of Nox Emission
      Desat: abbr-name=Desat, classifications=Condition-Qualifier  # Desaturation | The effect of desaturation which, e.g. can occur in electric / electronic /magnetic components.
      Desc: abbr-name=Desc, classifications=Condition-Qualifier  # Descending | to proceed in a sequence or gradation from higher to lower
      Det: abbr-name=Det, classifications=Action-PhysicalType  # Detect
      Df: abbr-name=Df, classifications=Condition-Qualifier  # Dual-fuel | Engines that can operate using a mixture of two different fuels are called dual fuel engines.
      Disad: abbr-name=Disad, classifications=Action-PhysicalType  # Disabled
      Dom: abbr-name=Dom, classifications=Mean-Environment-Device  # Domain
      Dpd: abbr-name=Dpd, classifications=Condition-Qualifier  # Dependency | dependency, dependence, dependent
      Drvblty: abbr-name=Drvblty, classifications=Condition-Qualifier  # Drivability | The term driveability describes the driver's complex subjective perception of the interactions between himself and the vehicle, e.g. associated to longitudinal acceleration aspects, like, e.g. jerk-free acceleration or deceleration.
      Ds: abbr-name=Ds, classifications=Condition-Qualifier  # Down-stream | down-stream or down stream or downstream
      Dstcn: abbr-name=Dstcn, classifications=Condition-Qualifier  # Distinction | Perceiving someone or something as being not the same or treating sb./st.as separate or different.
      Dwell: abbr-name=Dwell, classifications=Condition-Qualifier  # Dwell, Dwelling
      Dwnld: abbr-name=Dwnld, classifications=Condition-Qualifier  # Download
      Enf: abbr-name=Enf, classifications=Condition-Qualifier  # Enforced
      Exch: abbr-name=Exch, classifications=Action-PhysicalType  # Exchange
      Excvr: abbr-name=Excvr, classifications=Mean-Environment-Device  # Excavator | Power-operated shovel
      Exe: abbr-name=Exe, classifications=Condition-Qualifier  # Execute | To carry out fully or put completely into effect
      Exh: abbr-name=Exh, classifications=Condition-Qualifier  # Exhaust | The escape of used gas or vapor from an engine, or the escaped gas.
      Expi: abbr-name=Expi, classifications=Condition-Qualifier  # Expire | To exceed its period of validity
      Expl: abbr-name=Expl, classifications=Condition-Qualifier  # Explicit | Fully revealed or expressed without vagueness, implication, or ambiguity; leaving no question as to meaning or intent
      Far: abbr-name=Far, classifications=Condition-Qualifier  # To be found a long distance away, opposite to near
      Feat: abbr-name=Feat, classifications=Mean-Environment-Device  # Feature | A prominent part or characteristic
      Flx: abbr-name=Flx, classifications=Action-PhysicalType  # Flux | Flux like e.g. in physical quantity "magnetic flux"
      H2: abbr-name=H2, classifications=Mean-Environment-Device  # Chemical element Hydrogen diatomic (H2)
      HC: abbr-name=HC, classifications=Preposition  # Hydrocarbon
      HEV: abbr-name=HEV, classifications=Mean-Environment-Device  # Hev | Hybrid Electric Vehicle
      Inacrt: abbr-name=Inacrt, classifications=Condition-Qualifier  # Inaccurate
      Indt: abbr-name=Indt, classifications=Condition-Qualifier  # Induction | The process by which an electrical conductor becomes electrified when near a charged body, by which a magnetizable body becomes magnetized when in a magnetic field or in the magnetic flux set up by a magnetomotive force, or by which an electromotive force is produced in a circuit by varying the magnetic field linked with the circuit.
      Lft: abbr-name=Lft, classifications=Condition-Qualifier  # Lift | Movement from a lower to a higher position, or the distance of the movement.
      O2: abbr-name=O2, classifications=Mean-Environment-Device  # Oxygen molecule
      Plow: abbr-name=Plow, classifications=Mean-Environment-Device  # for example for snow plow, etc.
      Pm: abbr-name=Pm, classifications=Condition-Qualifier  # Particulate matter | Microscopic particles of solid or liquid matter suspended in the air.
      Pr: abbr-name=Pr, classifications=Action-PhysicalType  # Prandtl number
      Progsn: abbr-name=Progsn, classifications=Condition-Qualifier  # Progression
      Red: abbr-name=Red, classifications=Condition-Qualifier  # Reduce
      Sail: abbr-name=Sail, classifications=Condition-Qualifier  # Sailing | Situation of vehicle, where the clutch is kept open and the vehicle is moving by its own inertia, e.g. rolling downhill (coast driving state of a vehicle is a typical transmission / clutch function). The engine might be shut of.
      Sht: abbr-name=Sht, classifications=Action-PhysicalType  # Shut | e.g. to shut down; do not introduce a special keyword for the noun "Shutdown" but the content can be expressed using the combination of "Sht" and "Dwn"
      Snow: abbr-name=Snow, classifications=Condition-Qualifier  # for example for snow mode or snow plow, etc.
      Spol: abbr-name=Spol, classifications=Mean-Environment-Device  # Spoiler | A device to modify air flow in order to increase fuel efficiency or improve handling in automobiles.
      Stck: abbr-name=Stck, classifications=Mean-Environment-Device  # Stack | An orderly pile or heap
      Stn: abbr-name=Stn, classifications=Mean-Environment-Device  # Station | Equipment or place used usually for performing a particular job, e.g. charging station, railway station
      Surf: abbr-name=Surf, classifications=Mean-Environment-Device  # Surface | The exterior or upper boundary of an object, fluid or body.
      Tow: abbr-name=Tow, classifications=Action-PhysicalType
      Under: abbr-name=Under, classifications=Condition-Qualifier
      Unlimd: abbr-name=Unlim, classifications=Condition-Qualifier  # Unlimited
      Urg: abbr-name=Urg, classifications=Condition-Qualifier  # Urgent | e.g. like in urgent or urgency signal
      Idx0: abbr-name=0, classifications=Index  # 0 | Index 0. This keyword is used to express the number zero in form of an index
      Idx1: abbr-name=1, classifications=Index  # 1 | Index 1. This keyword is used to express the number one in form of an index
      Idx2: abbr-name=2, classifications=Index  # 2 | Index 2. This keyword is used to express the number two in form of an index
      Idx3: abbr-name=3, classifications=Index  # 3 | Index 3. This keyword is used to express the number three in form of an index
      Idx4: abbr-name=4, classifications=Index  # 4 | Index 4. This keyword is used to express the number four in form of an index
      Idx5: abbr-name=5, classifications=Index  # 5 | Index 5. This keyword is used to express the number five in form of an index
      Idx6: abbr-name=6, classifications=Index  # 6 | Index 6. This keyword is used to express the number six in form of an index
      Idx7: abbr-name=7, classifications=Index  # 7 | Index 7. This keyword is used to express the number seven in form of an index
      Idx8: abbr-name=8, classifications=Index  # 8 | Index 8. This keyword is used to express the number eight in form of an index
      Idx9: abbr-name=9, classifications=Index  # 9 | Index 9. This keyword is used to express the number nine in form of an index
      Idx0th: abbr-name=0th, classifications=Index  # 0th | This keyword is used to express the order in form of an index.
      Idx1st: abbr-name=1st, classifications=Index  # 1st | This keyword is used to express the order in form of an index.
      Idx2nd: abbr-name=2nd, classifications=Index  # 2nd | Second. This keyword is used to express the order in form of an index.
      Idx3rd: abbr-name=3rd, classifications=Index  # 3rd | This keyword is used to express the order in form of an index.
      Idx{4..9}th: abbr-name={4..9}th, classifications=Index  # {4..9}th | This keyword is used to express the order in form of an index.
      Idx1d: abbr-name=1d, classifications=Index  # 1d | index 1D. used for location of oxygen sensors (4 banks and 2 sensors) - Parameter Identification 1D according with ISO15031-5. 2 banks and 4 sensors are identified by the index 13
      Abort: abbr-name=Abort, classifications=Action-PhysicalType
      Abv: abbr-name=Abv, classifications=Preposition  # Above
      Abs: abbr-name=Abs, classifications=Mean-Environment-Device  # ABS | Antilock Braking System
      Absnt: abbr-name=Absnt, classifications=Condition-Qualifier  # Absent
      Abslt: abbr-name=Abslt, classifications=Condition-Qualifier  # Absolute | Absolute value
      Ac: abbr-name=Ac, classifications=Condition-Qualifier  # AC | Alternating Current / Voltage
      Acc: abbr-name=Acc, classifications=Mean-Environment-Device  # ACC | Adaptive Cruise Control
      A: abbr-name=A, classifications=Action-PhysicalType  # Acceleration | This keyword is used to give the physical value of acceleration. It is the value of gaining speed.
      Accr: abbr-name=Accr, classifications=Mean-Environment-Device  # Accelerator
      Acpt: abbr-name=Acpt, classifications=Action-PhysicalType  # Accept
      Acptd: abbr-name=Acptd, classifications=Condition-Qualifier  # Accepted
      Acs: abbr-name=Acs, classifications=Action-PhysicalType  # Access
      Acsy: abbr-name=Acsy, classifications=Mean-Environment-Device  # Accessory
      Acco: abbr-name=Acco, classifications=Condition-Qualifier  # Accommodation
      Ack: abbr-name=Ack, classifications=Action-PhysicalType  # Acknowledge
      Ackd: abbr-name=Ackd, classifications=Condition-Qualifier  # Acknowledged
      Acoust: abbr-name=Acoust, classifications=Condition-Qualifier  # Acoustic
      Acq: abbr-name=Acq, classifications=Action-PhysicalType  # Acquire
      Acqd: abbr-name=Acqd, classifications=Condition-Qualifier  # Acquired
      Acqn: abbr-name=Acqn, classifications=Condition-Qualifier  # Acquisition | e.g. signal acquisition
      Actn: abbr-name=Actn, classifications=Condition-Qualifier  # Action
      Actvt: abbr-name=Actvt, classifications=Action-PhysicalType  # Activate
      Actvd: abbr-name=Actvd, classifications=Condition-Qualifier  # Activated
      Actvn: abbr-name=Actvn, classifications=Action-PhysicalType  # Activation
      Actv: abbr-name=Actv, classifications=Condition-Qualifier  # Active
      Act: abbr-name=Act, classifications=Condition-Qualifier  # Actual
      Acttn: abbr-name=Acttn, classifications=Action-PhysicalType  # Actuation
      Actr: abbr-name=Actr, classifications=Mean-Environment-Device  # Actuator
      Adpn: abbr-name=Adpn, classifications=Condition-Qualifier  # Adaptation
      Adpr: abbr-name=Adpr, classifications=Mean-Environment-Device  # Adapter
      Adpv: abbr-name=Adpv, classifications=Condition-Qualifier  # Adaptive
      Adc: abbr-name=Adc, classifications=Mean-Environment-Device  # ADC | Analog Digital Converter
      Addl: abbr-name=Addl, classifications=Condition-Qualifier  # Additional
      Add: abbr-name=Add, classifications=Condition-Qualifier  # Additive
      Adr: abbr-name=Adr, classifications=Condition-Qualifier  # Address
      Adh: abbr-name=Adh, classifications=Action-PhysicalType  # Adhesion
      Adbtc: abbr-name=Adbtc, classifications=Condition-Qualifier  # Adiabatic
      Adj: abbr-name=Adj, classifications=Action-PhysicalType  # Adjust
      Adjmt: abbr-name=Adjmt, classifications=Action-PhysicalType  # Adjustment
      Admin: abbr-name=Admin, classifications=Condition-Qualifier  # Administration | administration, administrator
      Adsorb: abbr-name=Adsorb, classifications=Action-PhysicalType
      Adsorpn: abbr-name=Adsorpn, classifications=Condition-Qualifier  # Adsorption
      Adv: abbr-name=Adv, classifications=Condition-Qualifier  # Advance
      Aft: abbr-name=Aft, classifications=Preposition  # After
      Age: abbr-name=Age, classifications=Condition-Qualifier
      Aggrvd: abbr-name=Aggrvd, classifications=Condition-Qualifier  # Aggravated
      Agi: abbr-name=Agi, classifications=Condition-Qualifier  # Aging
      Ahd: abbr-name=Ahd, classifications=Condition-Qualifier  # Ahead
      Aid: abbr-name=Aid, classifications=Action-PhysicalType
      Air: abbr-name=Air, classifications=Mean-Environment-Device  # Also used as definition of "fresh gas"
      Airb: abbr-name=Airb, classifications=Mean-Environment-Device  # Airbag | airbag
      Ajar: abbr-name=Ajar, classifications=Condition-Qualifier
      Alrm: abbr-name=Alrm, classifications=Condition-Qualifier  # Alarm
      Alrmd: abbr-name=Alrmd, classifications=Condition-Qualifier  # Alarmed
      Alg: abbr-name=Alg, classifications=Condition-Qualifier  # Algorithm
      Algn: abbr-name=Algn, classifications=Action-PhysicalType  # Align
      Algnd: abbr-name=Algnd, classifications=Condition-Qualifier  # Aligned
      Alv: abbr-name=Alv, classifications=Condition-Qualifier  # Alive
      All: abbr-name=All, classifications=Condition-Qualifier
      Allw: abbr-name=Allw, classifications=Action-PhysicalType  # Allow
      Allwbl: abbr-name=Allwbl, classifications=Condition-Qualifier  # Allowable
      Allwd: abbr-name=Allwd, classifications=Condition-Qualifier  # Allowed
      Alpha: abbr-name=Alpha, classifications=Condition-Qualifier
      Altv: abbr-name=Altv, classifications=Mean-Environment-Device  # Alternative
      Alt: abbr-name=Alt, classifications=Mean-Environment-Device  # Alternator | alternator
      Alti: abbr-name=Alti, classifications=Action-PhysicalType  # Altitude
      Amb: abbr-name=Amb, classifications=Mean-Environment-Device  # Ambient
      Amnt: abbr-name=Amnt, classifications=Action-PhysicalType  # Amount | a total number or quantity, e.g. amount of substance.
      Ampr: abbr-name=Ampr, classifications=Mean-Environment-Device  # Ampere
      Amplfr: abbr-name=Amplfr, classifications=Mean-Environment-Device  # Amplifier
      Amp: abbr-name=Amp, classifications=Condition-Qualifier  # Amplitude
      Amt: abbr-name=Amt, classifications=Mean-Environment-Device  # AMT | Automated Manual Transmission
      An: abbr-name=An, classifications=Condition-Qualifier  # Analog
      Anchrfitg: abbr-name=Anchrfitg, classifications=Mean-Environment-Device  # Anchorfitting
      And: abbr-name=And, classifications=Preposition  # Preposition
      Ag: abbr-name=Ag, classifications=Action-PhysicalType  # Angle
      Agr: abbr-name=Agr, classifications=Condition-Qualifier  # Angular
      Anti: abbr-name=Anti, classifications=Condition-Qualifier
      Antcpt: abbr-name=Antcpt, classifications=Action-PhysicalType  # Anticipate
      Antcptd: abbr-name=Antcptd, classifications=Condition-Qualifier  # Anticipated
      Antcptn: abbr-name=Antcptn, classifications=Condition-Qualifier  # Anticipation
      Antisub: abbr-name=Antisub, classifications=Mean-Environment-Device  # Antisubmarine | Term used in restraint systems for automotive applications related to an Airbag that upon deployment prevents a front row passenger from diving below the dashboard by lifting the person's lower body. Thus, the person is brougth into a better position relative to the main Front Airbag.
      Antithft: abbr-name=Antithft, classifications=Mean-Environment-Device  # Antitheft
      Apil: abbr-name=Apil, classifications=Mean-Environment-Device  # A-Pillar of a car
      Appl: abbr-name=Appl, classifications=Mean-Environment-Device  # Application
      Appld: abbr-name=Appld, classifications=Condition-Qualifier  # Applied
      Apply: abbr-name=Apply, classifications=Action-PhysicalType
      Aprvd: abbr-name=Aprvd, classifications=Condition-Qualifier  # Approved
      Arbd: abbr-name=Arbd, classifications=Condition-Qualifier  # Arbitrated
      Arbn: abbr-name=Arbn, classifications=Action-PhysicalType  # Arbitration
      Ar: abbr-name=Ar, classifications=Action-PhysicalType  # Area
      Area: abbr-name=Area, classifications=Action-PhysicalType
      Arg: abbr-name=Arg, classifications=Condition-Qualifier  # Argument
      Arthm: abbr-name=Arthm, classifications=Condition-Qualifier  # Arithmetic
      Arm: abbr-name=Arm, classifications=Action-PhysicalType  # Intended as the action of arming some device
      Armtr: abbr-name=Armtr, classifications=Mean-Environment-Device  # Armature | This keyword described the constructional element of an armature. It should be used e.g. for calculations of the armature movement of a coil actuator.
      Armed: abbr-name=Armed, classifications=Condition-Qualifier
      Arming: abbr-name=Arming, classifications=Action-PhysicalType  # Intended as the action of arming some device
      Ary: abbr-name=Ary, classifications=Condition-Qualifier  # Array
      Asc: abbr-name=Asc, classifications=Mean-Environment-Device  # ASC | Acceleration Slip Control
      Ash: abbr-name=Ash, classifications=Mean-Environment-Device  # e.g. in Ash Soot Factor
      Ashtray: abbr-name=Ashtray, classifications=Mean-Environment-Device
      Asr: abbr-name=Asr, classifications=Mean-Environment-Device  # ASR | Anti Slip Regulation
      Asgn: abbr-name=Asgn, classifications=Action-PhysicalType  # Assign
      Assi: abbr-name=Assi, classifications=Action-PhysicalType  # Assist
      Assc: abbr-name=Assc, classifications=Mean-Environment-Device  # Assistance | assistance. this keyword expresses the availability of an electronic assistance for a component or system
      Asst: abbr-name=Asst, classifications=Mean-Environment-Device  # Assistant | assistant. For example: the electronic brake assistant.
      Assid: abbr-name=Assid, classifications=Condition-Qualifier  # Assisted
      Asw: abbr-name=Asw, classifications=Mean-Environment-Device  # ASW | Application Software
      Asymc: abbr-name=Asymc, classifications=Condition-Qualifier  # Asymmetrical
      Asymtry: abbr-name=Asymtry, classifications=Condition-Qualifier  # Asymmetry
      Async: abbr-name=Async, classifications=Condition-Qualifier  # Asynchronous
      At: abbr-name=At, classifications=Preposition  # Preposition for location, time, presence
      At1: abbr-name=At, classifications=Mean-Environment-Device  # AT | Automatic Transmission
      Atm: abbr-name=Atm, classifications=Mean-Environment-Device  # Atmosphere
      Atch: abbr-name=Atch, classifications=Action-PhysicalType  # Attach
      Atmpt: abbr-name=Atmpt, classifications=Condition-Qualifier  # Attempt
      Attn: abbr-name=Attn, classifications=Condition-Qualifier  # Attenuator | The attenuator switch is a part of the power stage which drives the piezo injectors.
      Audio: abbr-name=Audio, classifications=Action-PhysicalType
      Australia: abbr-name=Australia, classifications=Condition-Qualifier
      Autrk: abbr-name=Autrk, classifications=Condition-Qualifier  # Autarkic | self-sustaining
      Authent: abbr-name=Authent, classifications=Condition-Qualifier  # Authentication
      Authn: abbr-name=Authn, classifications=Action-PhysicalType  # Authorization
      Auth: abbr-name=Auth, classifications=Action-PhysicalType  # Authorize
      Aut: abbr-name=Aut, classifications=Condition-Qualifier  # Automatic
      Ar1: abbr-name=Ar, classifications=Mean-Environment-Device  # AUTOSAR
      Aux: abbr-name=Aux, classifications=Condition-Qualifier  # Auxiliary
      Avl: abbr-name=Avl, classifications=Condition-Qualifier  # Available
      Avrg: abbr-name=Avrg, classifications=Condition-Qualifier  # Average
      Avd: abbr-name=Avd, classifications=Action-PhysicalType  # Avoid
      Avdbl: abbr-name=Avdbl, classifications=Condition-Qualifier  # Avoidable
      Awd: abbr-name=Awd, classifications=Mean-Environment-Device  # AWD | All Wheel Drive
      Axis: abbr-name=Axis, classifications=Mean-Environment-Device  # E. g. might be used in Axis1st, Axis2nd, Axis3rd
      Axle: abbr-name=Axle, classifications=Mean-Environment-Device
      Axles: abbr-name=Axles, classifications=Mean-Environment-Device  # Front and rear axle
      Back: abbr-name=Back, classifications=Mean-Environment-Device  # anatomic human back
      Backed: abbr-name=Backed, classifications=Condition-Qualifier
      Backlt: abbr-name=Backlt, classifications=Condition-Qualifier  # Backlit
      Backlite: abbr-name=Backlite, classifications=Mean-Environment-Device
      Backw: abbr-name=Backw, classifications=Condition-Qualifier  # Backward
      Bal: abbr-name=Bal, classifications=Action-PhysicalType  # Balance
      Ballstc: abbr-name=Ballstc, classifications=Condition-Qualifier  # Ballistic
      Band: abbr-name=Band, classifications=Condition-Qualifier
      Bp: abbr-name=Bp, classifications=Condition-Qualifier  # Bandpass
      Bw: abbr-name=Bw, classifications=Condition-Qualifier  # Bandwidth
      Bnk: abbr-name=Bnk, classifications=Mean-Environment-Device  # Bank
      Bar: abbr-name=Bar, classifications=Mean-Environment-Device  # As unit of measure
      Baro: abbr-name=Baro, classifications=Condition-Qualifier  # Barometric
      Bas: abbr-name=Bas, classifications=Condition-Qualifier  # Base | Pre-processed sensor data, model free, abstraction of the sensor hardware.
      Basc: abbr-name=Basc, classifications=Condition-Qualifier  # Basic
      Batt: abbr-name=Batt, classifications=Mean-Environment-Device  # Battery
      Bdc: abbr-name=Bdc, classifications=Condition-Qualifier  # BDC | Bottom Dead Center
      Beam: abbr-name=Beam, classifications=Action-PhysicalType
      Bfr: abbr-name=Bfr, classifications=Preposition  # Before
      Bgn: abbr-name=Bgn, classifications=Action-PhysicalType  # Begin
      Bhv: abbr-name=Bhv, classifications=Action-PhysicalType  # Behave
      Bhvr: abbr-name=Bhvr, classifications=Condition-Qualifier  # Behaviour
      Belgium: abbr-name=Belgium, classifications=Condition-Qualifier
      Blt: abbr-name=Blt, classifications=Mean-Environment-Device  # Belt | seat belt. this keyword is used to express the seat belt, which is a kind of security rope to keep the passenger in the seat in case of an accident.
      Bench: abbr-name=Bench, classifications=Mean-Environment-Device  # bench mode. During OBD I / OBD II diagnoses and error management validation and tuning, the bench mode has to be used so as to force some failures.
      Bicycle: abbr-name=Bicycle, classifications=Mean-Environment-Device
      Bilnr: abbr-name=Bilnr, classifications=Condition-Qualifier  # Bilinear | e.g. in bilinear interpolation
      Bio: abbr-name=Bio, classifications=Condition-Qualifier  # Biological
      Blnk: abbr-name=Blnk, classifications=Condition-Qualifier  # Blank | e.g. blank out engine fuel injection, for specifying a gap
      Bli: abbr-name=Bli, classifications=Condition-Qualifier  # Blind
      Blink: abbr-name=Blink, classifications=Action-PhysicalType
      Blk: abbr-name=Blk, classifications=Condition-Qualifier  # Block
      Blkd: abbr-name=Blkd, classifications=Condition-Qualifier  # Blocked
      Blow: abbr-name=Blow, classifications=Action-PhysicalType
      Blowr: abbr-name=Blowr, classifications=Mean-Environment-Device  # Blower
      Bls: abbr-name=Bls, classifications=Mean-Environment-Device  # BLS | Brake Light Switch
      Blueprint: abbr-name=Blueprint, classifications=Condition-Qualifier
      Bms: abbr-name=Bms, classifications=Mean-Environment-Device  # BMS | Battery Management System
      Bd: abbr-name=Bd, classifications=Mean-Environment-Device  # Board
      Body: abbr-name=Body, classifications=Mean-Environment-Device
      Blstr: abbr-name=Blstr, classifications=Mean-Environment-Device  # Bolster
      Bolt: abbr-name=Bolt, classifications=Mean-Environment-Device  # e. g. as in Lock Bolt
      Boost: abbr-name=Boost, classifications=Action-PhysicalType  # A general expression to increase performance for a short period of time or to give a higher output. e.g. to give high voltage output or to support the combustion engine with additional torque (e.g. with a Integrated Starter Generator) for acceleration
      Boot: abbr-name=Boot, classifications=Condition-Qualifier
      Botm: abbr-name=Botm, classifications=Mean-Environment-Device  # Bottom
      Bnce: abbr-name=Bnce, classifications=Mean-Environment-Device  # Bounce
      Bncg: abbr-name=Bncg, classifications=Condition-Qualifier  # Bouncing
      Bnd: abbr-name=Bnd, classifications=Condition-Qualifier  # Bound
      Bndls: abbr-name=Bndls, classifications=Condition-Qualifier  # Boundless
      Box: abbr-name=Box, classifications=Mean-Environment-Device
      Bpil: abbr-name=Bpil, classifications=Mean-Environment-Device  # B-Pillar of a car
      Brkt: abbr-name=Brkt, classifications=Mean-Environment-Device  # Bracket
      Brk: abbr-name=Brk, classifications=Mean-Environment-Device  # Brake
      Brkg: abbr-name=Brkg, classifications=Action-PhysicalType  # Braking
      Brazil: abbr-name=Brazil, classifications=Condition-Qualifier
      Break: abbr-name=Break, classifications=Action-PhysicalType
      Brdg: abbr-name=Brdg, classifications=Condition-Qualifier  # Bridge | bridge contact
      Bri: abbr-name=Bri, classifications=Action-PhysicalType  # Brightness
      Brkn: abbr-name=Brkn, classifications=Condition-Qualifier  # Broken
      Bsw: abbr-name=Bsw, classifications=Mean-Environment-Device  # BSW | Basic Software
      Buc: abbr-name=Buc, classifications=Mean-Environment-Device  # Buckle | Part of supplement restraint system to protect occupant in case of crash
      Bucd: abbr-name=Bucd, classifications=Condition-Qualifier  # Buckled | Buckling of occupant
      Buf: abbr-name=Buf, classifications=Condition-Qualifier  # Buffer
      Bmp: abbr-name=Bmp, classifications=Mean-Environment-Device  # Bumper
      Brn: abbr-name=Brn, classifications=Action-PhysicalType  # Burn
      Brnr: abbr-name=Brnr, classifications=Mean-Environment-Device  # Burner
      Brng: abbr-name=Brng, classifications=Action-PhysicalType  # Burning
      Burst: abbr-name=Burst, classifications=Condition-Qualifier  # To emerge or spring suddenly or Describes, that a signal is considered as a sequence of events. Burst is an established term in signal processing
      Bus: abbr-name=Bus, classifications=Mean-Environment-Device  # used for the vehicle and not as a data bus
      Busy: abbr-name=Busy, classifications=Condition-Qualifier
      Btn: abbr-name=Btn, classifications=Mean-Environment-Device  # Button
      Buz: abbr-name=Buz, classifications=Condition-Qualifier  # Buzzer
      By: abbr-name=By, classifications=Preposition  # Preposition
      Byp: abbr-name=Byp, classifications=Action-PhysicalType  # Bypass
      Cbn: abbr-name=Cbn, classifications=Mean-Environment-Device  # Cabin
      Calc: abbr-name=Calc, classifications=Action-PhysicalType  # Calculate
      Calcd: abbr-name=Calcd, classifications=Condition-Qualifier  # Calculated
      Calcn: abbr-name=Calcn, classifications=Action-PhysicalType  # Calculation
      Cal: abbr-name=Cal, classifications=Condition-Qualifier  # Calibration
      Call: abbr-name=Call, classifications=Condition-Qualifier
      Camsft: abbr-name=Camsft, classifications=Mean-Environment-Device  # Camshaft
      Can: abbr-name=Can, classifications=Mean-Environment-Device  # CAN | Controller Area Network
      Canada: abbr-name=Canada, classifications=Condition-Qualifier
      Cncl: abbr-name=Cncl, classifications=Action-PhysicalType  # Cancel
      Cncld: abbr-name=Cncld, classifications=Condition-Qualifier  # Cancelled
      Cd: abbr-name=Cd, classifications=Mean-Environment-Device  # Candela | Unit of measure of luminous intensity
      Cstr: abbr-name=Cstr, classifications=Mean-Environment-Device  # Canister
      Cpby: abbr-name=Cpby, classifications=Condition-Qualifier  # Capability
      Cp: abbr-name=Cp, classifications=Action-PhysicalType  # Capacity | this keyword is used to express the Physical Meaning of a capacity (e.g. thermal capacity of oil)
      Car: abbr-name=Car, classifications=Mean-Environment-Device
      Carb: abbr-name=Carb, classifications=Condition-Qualifier  # CARB | Californian Air Resource Board
      Carbon: abbr-name=Carbon, classifications=Mean-Environment-Device
      Case: abbr-name=Case, classifications=Mean-Environment-Device
      Cat: abbr-name=Cat, classifications=Mean-Environment-Device  # Catalyst
      Cavtn: abbr-name=Cavtn, classifications=Mean-Environment-Device  # Cavitation
      Ccp: abbr-name=Ccp, classifications=Mean-Environment-Device  # CCP | CAN Calibration Protocol
      Cell: abbr-name=Cell, classifications=Mean-Environment-Device
      Centr: abbr-name=Centr, classifications=Condition-Qualifier  # Center
      Centi: abbr-name=Centi, classifications=Mean-Environment-Device
      Cgrd: abbr-name=Cgrd, classifications=Mean-Environment-Device  # Centigrade
      Cen: abbr-name=Cen, classifications=Condition-Qualifier  # Central
      Centrfgl: abbr-name=Centrfgl, classifications=Condition-Qualifier  # Centrifugal
      Ceramic: abbr-name=Ceramic, classifications=Mean-Environment-Device
      Chain: abbr-name=Chain, classifications=Mean-Environment-Device
      Chmb: abbr-name=Chmb, classifications=Mean-Environment-Device  # Chamber
      Chg: abbr-name=Chg, classifications=Action-PhysicalType  # Change
      Ch: abbr-name=Ch, classifications=Condition-Qualifier  # Channel | This keyword is used to express a channel. A channel is a defined port (of a bundle of ports) of a data line.
      Chartc: abbr-name=Chartc, classifications=Condition-Qualifier  # Characteristic
      Chrg: abbr-name=Chrg, classifications=Condition-Qualifier  # Charge
      Chrgr: abbr-name=Chrgr, classifications=Mean-Environment-Device  # Charger
      Chrgn: abbr-name=Chrgn, classifications=Action-PhysicalType  # Charging
      Chassis: abbr-name=Chassis, classifications=Mean-Environment-Device
      Chk: abbr-name=Chk, classifications=Condition-Qualifier  # Check
      Chks: abbr-name=Chks, classifications=Condition-Qualifier  # Checksum
      Chd: abbr-name=Chd, classifications=Mean-Environment-Device  # Child
      Chill: abbr-name=Chill, classifications=Condition-Qualifier
      Chillr: abbr-name=Chillr, classifications=Mean-Environment-Device  # Chiller
      Chimer: abbr-name=Chimer, classifications=Mean-Environment-Device
      China: abbr-name=China, classifications=Condition-Qualifier
      Chirp: abbr-name=Chirp, classifications=Action-PhysicalType
      Choke: abbr-name=Choke, classifications=Mean-Environment-Device  # Choking, choke line. this keyword is used to describe the appearance of choking effects in an (air-)stream, e.g. at the choke line of a turbocharger (which is a characteristic parameter)
      Cigarette: abbr-name=Cigarette, classifications=Mean-Environment-Device
      Circ: abbr-name=Circ, classifications=Mean-Environment-Device  # Circuit
      Circum: abbr-name=Circum, classifications=Mean-Environment-Device  # Circumference | Used in the meaning of the wheel circumference
      Circuml: abbr-name=Circuml, classifications=Condition-Qualifier  # Circumferential
      City: abbr-name=City, classifications=Condition-Qualifier
      Clmp: abbr-name=Clmp, classifications=Action-PhysicalType  # Clamp
      Clmpd: abbr-name=Clmpd, classifications=Condition-Qualifier  # Clamped
      Class: abbr-name=Class, classifications=Condition-Qualifier
      Classn: abbr-name=Classn, classifications=Action-PhysicalType  # Classification
      Claw: abbr-name=Claw, classifications=Mean-Environment-Device  # e.g. claw couplings are used within automated transmission instead of clutches
      Cln: abbr-name=Cln, classifications=Condition-Qualifier  # Clean
      Clnr: abbr-name=Clnr, classifications=Mean-Environment-Device  # Cleaner
      Clng: abbr-name=Clng, classifications=Condition-Qualifier  # Cleaning
      Clr: abbr-name=Clr, classifications=Action-PhysicalType  # Clear
      Clrd: abbr-name=Clrd, classifications=Condition-Qualifier  # Cleared
      Clima: abbr-name=Clima, classifications=Action-PhysicalType  # Climatisation
      Climb: abbr-name=Climb, classifications=Condition-Qualifier  # e.g. climb mode
      Clk: abbr-name=Clk, classifications=Condition-Qualifier  # Clock
      Cls: abbr-name=Cls, classifications=Action-PhysicalType  # Close
      Clsd: abbr-name=Clsd, classifications=Condition-Qualifier  # Closed
      Clstr: abbr-name=Clstr, classifications=Mean-Environment-Device  # Cluster
      Clu: abbr-name=Clu, classifications=Mean-Environment-Device  # Clutch
      Cng: abbr-name=Cng, classifications=Mean-Environment-Device  # CNG | Compressed Natural Gas
      Co: abbr-name=Co, classifications=Mean-Environment-Device  # CO | Carbon Monoxide
      Coast: abbr-name=Coast, classifications=Action-PhysicalType  # Coasting | situation of vehicle, where the clutch is kept open and the vehicle is moving by its own inertia, e.g. rolling downhill (coast driving state of a vehicle is a typical transmission / clutch function).
      Cot: abbr-name=Cot, classifications=Condition-Qualifier  # Coated
      Cod: abbr-name=Cod, classifications=Condition-Qualifier  # Code
      Coeff: abbr-name=Coeff, classifications=Condition-Qualifier  # Coefficient
      Cog: abbr-name=Cog, classifications=Mean-Environment-Device  # COG | Center of Gravity
      Cohrncy: abbr-name=Cohrncy, classifications=Action-PhysicalType  # Coherency
      Cohrnt: abbr-name=Cohrnt, classifications=Condition-Qualifier  # Coherent
      Coil: abbr-name=Coil, classifications=Mean-Environment-Device
      Cold: abbr-name=Cold, classifications=Condition-Qualifier
      Collct: abbr-name=Collct, classifications=Action-PhysicalType  # Collect
      Collctd: abbr-name=Collctd, classifications=Condition-Qualifier  # Collected
      Collctn: abbr-name=Collctn, classifications=Condition-Qualifier  # Collection
      Coll: abbr-name=Coll, classifications=Mean-Environment-Device  # Collector
      Cllsn: abbr-name=Cllsn, classifications=Action-PhysicalType  # Collision
      Col: abbr-name=Col, classifications=Condition-Qualifier  # Column
      Cmb: abbr-name=Cmb, classifications=Mean-Environment-Device  # Combustion
      Cmft: abbr-name=Cmft, classifications=Condition-Qualifier  # Comfort | comfort. this keyword is used to express something as comfortable or convenient
      Cmng: abbr-name=Cmng, classifications=Action-PhysicalType  # Coming
      Cmd: abbr-name=Cmd, classifications=Condition-Qualifier  # Command
      Cmn: abbr-name=Cmn, classifications=Condition-Qualifier  # Common | common. for common environmental data (stored with all failures of one project).
      Com: abbr-name=Com, classifications=Condition-Qualifier  # Communication
      Cmu: abbr-name=Cmu, classifications=Condition-Qualifier  # Commutation
      Comp: abbr-name=Comp, classifications=Condition-Qualifier  # Comparison
      Cmptmt: abbr-name=Cmptmt, classifications=Mean-Environment-Device  # Compartment
      Cmpblty: abbr-name=Cmpblty, classifications=Condition-Qualifier  # Compatibility
      Cmpbl: abbr-name=Cmpbl, classifications=Condition-Qualifier  # Compatible
      Cmp: abbr-name=Cmp, classifications=Action-PhysicalType  # Compensation
      Cpl: abbr-name=Cpl, classifications=Condition-Qualifier  # Complement
      Cmpl: abbr-name=Cmpl, classifications=Condition-Qualifier  # Complete
      Cmplx: abbr-name=Cmplx, classifications=Condition-Qualifier  # Complex
      Cpt: abbr-name=Cpt, classifications=Condition-Qualifier  # Component
      Cmpn: abbr-name=Cmpn, classifications=Condition-Qualifier  # Compression
      Cmpr: abbr-name=Cmpr, classifications=Mean-Environment-Device  # Compressor | This keyword is used to express a component producing a compressed (= with raised pressure) working medium, e.g. air, refrigerant.
      Compu: abbr-name=Compu, classifications=Condition-Qualifier  # Computation
      Conc: abbr-name=Conc, classifications=Action-PhysicalType  # Concentration
      Conds: abbr-name=Conds, classifications=Action-PhysicalType  # Condense
      Cdn: abbr-name=Cdn, classifications=Condition-Qualifier  # Condition
      Cdnr: abbr-name=Cdnr, classifications=Mean-Environment-Device  # Conditioner
      Cdng: abbr-name=Cdng, classifications=Action-PhysicalType  # Conditioning
      Cndctvty: abbr-name=Cndctvty, classifications=Action-PhysicalType  # Conductivity
      Cfg: abbr-name=Cfg, classifications=Condition-Qualifier  # Configuration
      Cfgd: abbr-name=Cfgd, classifications=Condition-Qualifier  # Configured
      Cfm: abbr-name=Cfm, classifications=Condition-Qualifier  # Confirmation
      Cfmd: abbr-name=Cfmd, classifications=Condition-Qualifier  # Confirmed
      Cnct: abbr-name=Cnct, classifications=Action-PhysicalType  # Connect
      Cnctn: abbr-name=Cnctn, classifications=Condition-Qualifier  # Connection
      Cnctr: abbr-name=Cnctr, classifications=Mean-Environment-Device  # Connector
      Consctv: abbr-name=Consctv, classifications=Condition-Qualifier  # Consecutive
      Consist: abbr-name=Consist, classifications=Action-PhysicalType
      Consistnc: abbr-name=Consistnc, classifications=Condition-Qualifier  # Consistence
      Con: abbr-name=Con, classifications=Condition-Qualifier  # Constant
      Constr: abbr-name=Constr, classifications=Condition-Qualifier  # Constraint
      Cnse: abbr-name=Cnse, classifications=Action-PhysicalType  # Consume
      Cnsr: abbr-name=Cnsr, classifications=Mean-Environment-Device  # Consumer
      Cns: abbr-name=Cns, classifications=Condition-Qualifier  # Consumption
      Cntct: abbr-name=Cntct, classifications=Mean-Environment-Device  # Contact | used in the sense of contact or contactor e.g. in "close contact", "contactor open", "contact defect" or "high-voltage contactors"
      Cntnr: abbr-name=Cntnr, classifications=Mean-Environment-Device  # Container
      Cntxt: abbr-name=Cntxt, classifications=Condition-Qualifier  # Context | e.g. CAN frame context
      Contns: abbr-name=Contns, classifications=Condition-Qualifier  # Continuous
      Contrb: abbr-name=Contrb, classifications=Action-PhysicalType  # Contribute
      Contrbn: abbr-name=Contrbn, classifications=Condition-Qualifier  # Contribution
      Ctrl: abbr-name=Ctrl, classifications=Condition-Qualifier  # Control
      Ctrld: abbr-name=Ctrld, classifications=Condition-Qualifier  # Controlled
      Ctrlr: abbr-name=Ctrlr, classifications=Mean-Environment-Device  # Controller
      Cnvc: abbr-name=Cnvc, classifications=Condition-Qualifier  # Convection
      Cnvtn: abbr-name=Cnvtn, classifications=Condition-Qualifier  # Convention
      Cnvn: abbr-name=Cnvn, classifications=Action-PhysicalType  # Conversion
      Cnv: abbr-name=Cnv, classifications=Action-PhysicalType  # Convert
      Cnvr: abbr-name=Cnvr, classifications=Condition-Qualifier  # Converter
      Cnvtb: abbr-name=Cnvtb, classifications=Condition-Qualifier  # Convertible
      Cool: abbr-name=Cool, classifications=Mean-Environment-Device
      Coolt: abbr-name=Coolt, classifications=Mean-Environment-Device  # Coolant
      Coolr: abbr-name=Coolr, classifications=Mean-Environment-Device  # Cooler
      Coolg: abbr-name=Coolg, classifications=Action-PhysicalType  # Cooling | This keyword is used to describe the cooling system e.g. of the engine. A cooling request can be fulfilled by air, coolant, or other cooling systems or refrigerants.
      Coor: abbr-name=Coor, classifications=Condition-Qualifier  # Coordinate
      Coord: abbr-name=Coord, classifications=Condition-Qualifier  # Coordinated
      Coorn: abbr-name=Coorn, classifications=Condition-Qualifier  # Coordination
      Coorr: abbr-name=Coorr, classifications=Condition-Qualifier  # Coordinator
      Copy: abbr-name=Copy, classifications=Condition-Qualifier
      Core: abbr-name=Core, classifications=Condition-Qualifier
      Cornr: abbr-name=Cornr, classifications=Mean-Environment-Device  # Corner
      Cornrg: abbr-name=Cornrg, classifications=Action-PhysicalType  # Cornering
      Corr: abbr-name=Corr, classifications=Condition-Qualifier  # Correct
      Corrd: abbr-name=Corrd, classifications=Condition-Qualifier  # Corrected
      Corrn: abbr-name=Corrn, classifications=Condition-Qualifier  # Correction
      Corrl: abbr-name=Corrl, classifications=Action-PhysicalType  # Correlate
      Corrln: abbr-name=Corrln, classifications=Condition-Qualifier  # Correlation
      Coulomb: abbr-name=Coulomb, classifications=Mean-Environment-Device  # Unit of measure for Electric charge
      Cnt: abbr-name=Cnt, classifications=Action-PhysicalType  # Count
      Cntr: abbr-name=Cntr, classifications=Condition-Qualifier  # Counter | Also applicable to running indexes.
      Ctrsft: abbr-name=Ctrsft, classifications=Mean-Environment-Device  # Countershaft
      Ctry: abbr-name=Ctry, classifications=Mean-Environment-Device  # Country
      Coupld: abbr-name=Coupld, classifications=Condition-Qualifier  # Coupled
      Couplr: abbr-name=Couplr, classifications=Mean-Environment-Device  # Coupler
      Coupl: abbr-name=Coupl, classifications=Condition-Qualifier  # Coupling | It is the keyword for any linkage of software modules or functionalities or to express a kind of strict connection between two otherwise not linked parts.
      Course: abbr-name=Course, classifications=Mean-Environment-Device
      Cover: abbr-name=Cover, classifications=Mean-Environment-Device
      Cpil: abbr-name=Cpil, classifications=Mean-Environment-Device  # C-Pillar of a car
      Cpv: abbr-name=Cpv, classifications=Mean-Environment-Device  # CPV | Canister Purge Valve
      Crk: abbr-name=Crk, classifications=Action-PhysicalType  # Crank
      Crkcs: abbr-name=Crkcs, classifications=Mean-Environment-Device  # Crankcase
      Crksft: abbr-name=Crksft, classifications=Mean-Environment-Device  # Crankshaft
      Crash: abbr-name=Crash, classifications=Mean-Environment-Device
      Crawl: abbr-name=Crawl, classifications=Action-PhysicalType
      Crc: abbr-name=Crc, classifications=Condition-Qualifier  # CRC | Cyclic Redundancy Check
      Creat: abbr-name=Creat, classifications=Action-PhysicalType  # Create
      Crp: abbr-name=Crp, classifications=Action-PhysicalType  # Creep | example: creep mode of automatic transmission
      Cta: abbr-name=Cta, classifications=Condition-Qualifier  # Criteria
      Crit: abbr-name=Crit, classifications=Condition-Qualifier  # Critical
      Crs: abbr-name=Crs, classifications=Mean-Environment-Device  # Cruise
      Crypto: abbr-name=Crypto, classifications=Mean-Environment-Device  # Cryptography
      Cubd: abbr-name=Cubd, classifications=Condition-Qualifier  # Cubed
      Cub: abbr-name=Cub, classifications=Condition-Qualifier  # Cubic
      Curb: abbr-name=Curb, classifications=Mean-Environment-Device  # American English for Kerb
      Curt: abbr-name=Curt, classifications=Mean-Environment-Device  # Curtain
      Crvt: abbr-name=Crvt, classifications=Action-PhysicalType  # Curvature
      Crv: abbr-name=Crv, classifications=Mean-Environment-Device  # Curve
      Cush: abbr-name=Cush, classifications=Mean-Environment-Device  # Cushion
      Cust: abbr-name=Cust, classifications=Mean-Environment-Device  # Customer
      Cut: abbr-name=Cut, classifications=Action-PhysicalType
      Cvt: abbr-name=Cvt, classifications=Mean-Environment-Device  # CVT | Continuous Variable Transmission
      Cyc: abbr-name=Cyc, classifications=Condition-Qualifier  # Cycle
      Cyl: abbr-name=Cyl, classifications=Mean-Environment-Device  # Cylinder
      D: abbr-name=D, classifications=Condition-Qualifier  # Differential part of a control structure
      Dampr: abbr-name=Dampr, classifications=Mean-Environment-Device  # Damper
      Dampg: abbr-name=Dampg, classifications=Condition-Qualifier  # Damping
      Das: abbr-name=Das, classifications=Mean-Environment-Device  # DAS | Driver Assistance System
      Dshb: abbr-name=Dshb, classifications=Mean-Environment-Device  # Dashboard | can also be used in the sense of instrument cluster, instrument panel
      Dash: abbr-name=Dash, classifications=Condition-Qualifier  # Dashpot
      Data: abbr-name=Data, classifications=Action-PhysicalType
      Date: abbr-name=Date, classifications=Action-PhysicalType  # date, point of time. This keyword is used to refer to a precise moment or a specific date. This can be a "time stamp" or a calendar date as well.
      Day: abbr-name=Day, classifications=Mean-Environment-Device
      Dayti: abbr-name=Dayti, classifications=Mean-Environment-Device  # Daytime
      Dc: abbr-name=Dc, classifications=Condition-Qualifier  # DC | Direct Current/Voltage
      Dcc: abbr-name=Dcc, classifications=Mean-Environment-Device  # DCC | Distance Cruise Control. In case of cruise control on, the distance to the vehicle ahead is measured. If the distance falls below a defined limit, the vehicle speed is reduced automatically.
      Dcm: abbr-name=Dcm, classifications=Mean-Environment-Device  # DCM | Diagnostic Communication Manager
      Dct: abbr-name=Dct, classifications=Mean-Environment-Device  # DCT | Dual Clutch Transmission
      Deactvt: abbr-name=Deactvt, classifications=Action-PhysicalType  # Deactivate
      Deactvd: abbr-name=Deactvd, classifications=Condition-Qualifier  # Deactivated
      Deactvn: abbr-name=Deactvn, classifications=Condition-Qualifier  # Deactivation
      Dead: abbr-name=Dead, classifications=Condition-Qualifier
      Dbnd: abbr-name=Dbnd, classifications=Action-PhysicalType  # Deadband
      Deb: abbr-name=Deb, classifications=Action-PhysicalType  # Debounce
      Dbg: abbr-name=Dbg, classifications=Condition-Qualifier  # Debug
      Decel: abbr-name=Decel, classifications=Condition-Qualifier  # Deceleration
      Decod: abbr-name=Decod, classifications=Action-PhysicalType  # Decode
      Dec: abbr-name=Dec, classifications=Action-PhysicalType  # Decrease | decrease, decrementation. this keyword is used to express the stepwise descent of a value or counter.
      Deep: abbr-name=Deep, classifications=Condition-Qualifier
      Dft: abbr-name=Dft, classifications=Condition-Qualifier  # Default | default
      Dfct: abbr-name=Dfct, classifications=Condition-Qualifier  # Defect
      Def: abbr-name=Def, classifications=Action-PhysicalType  # Define
      Defd: abbr-name=Defd, classifications=Condition-Qualifier  # Defined
      Definite: abbr-name=Definite, classifications=Condition-Qualifier  # e.g. definite path from navigation system
      Defn: abbr-name=Defn, classifications=Condition-Qualifier  # Definition
      Defrst: abbr-name=Defrst, classifications=Action-PhysicalType  # Defrost
      Defu: abbr-name=Defu, classifications=Condition-Qualifier  # Defueling | defueling. It shall be used to describe the action of taking fuel out of the tank.
      Degraded: abbr-name=Degraded, classifications=Condition-Qualifier
      Deg: abbr-name=Deg, classifications=Mean-Environment-Device  # Degree
      Dly: abbr-name=Dly, classifications=Condition-Qualifier  # Delay
      Del: abbr-name=Del, classifications=Action-PhysicalType  # Delete
      Delta: abbr-name=Delta, classifications=Condition-Qualifier
      Dem: abbr-name=Dem, classifications=Mean-Environment-Device  # DEM | Diagnostic Event Manager
      Dmd: abbr-name=Dmd, classifications=Condition-Qualifier  # Demand
      Dens: abbr-name=Dens, classifications=Action-PhysicalType  # Density
      Deploy: abbr-name=Deploy, classifications=Action-PhysicalType
      Deploymt: abbr-name=Deploymt, classifications=Condition-Qualifier  # Deployment
      Dep: abbr-name=Dep, classifications=Condition-Qualifier  # Depression
      Deriv: abbr-name=Deriv, classifications=Action-PhysicalType  # Derive
      Descr: abbr-name=Descr, classifications=Condition-Qualifier  # Description
      Dsgn: abbr-name=Dsgn, classifications=Action-PhysicalType  # Designate
      Des: abbr-name=Des, classifications=Condition-Qualifier  # Desired
      Desorpn: abbr-name=Desorpn, classifications=Condition-Qualifier  # Desorption
      Dest: abbr-name=Dest, classifications=Condition-Qualifier  # Destination
      Dstr: abbr-name=Dstr, classifications=Action-PhysicalType  # Destruct
      Dstrn: abbr-name=Dstrn, classifications=Condition-Qualifier  # Destruction
      Desox: abbr-name=Desox, classifications=Mean-Environment-Device  # Desulphurization
      Detn: abbr-name=Detn, classifications=Action-PhysicalType  # Detection
      Devlp: abbr-name=Devlp, classifications=Action-PhysicalType  # Develop
      De: abbr-name=De, classifications=Condition-Qualifier  # Deviation
      Dev: abbr-name=Dev, classifications=Mean-Environment-Device  # Device
      Dew: abbr-name=Dew, classifications=Mean-Environment-Device  # Dew Point
      Diag: abbr-name=Diag, classifications=Action-PhysicalType  # Diagnosis
      Diagc: abbr-name=Diagc, classifications=Mean-Environment-Device  # Diagnostic
      Diam: abbr-name=Diam, classifications=Condition-Qualifier  # Diameter | This name describes the component size, e.g. of driving wheels
      Dsl: abbr-name=Dsl, classifications=Mean-Environment-Device  # Diesel
      Dif: abbr-name=Dif, classifications=Condition-Qualifier  # Difference
      Dftl: abbr-name=Dftl, classifications=Mean-Environment-Device  # Differential | A special transmission, used in drive train context
      Difsn: abbr-name=Difsn, classifications=Condition-Qualifier  # Diffusion
      Dig: abbr-name=Dig, classifications=Condition-Qualifier  # Digital
      Dil: abbr-name=Dil, classifications=Condition-Qualifier  # Dilution
      Dim: abbr-name=Dim, classifications=Action-PhysicalType  # used as compound with Light
      Dimension: abbr-name=Dimension, classifications=Action-PhysicalType
      Dio: abbr-name=Dio, classifications=Mean-Environment-Device  # DIO | Digital Input/Output
      Dir: abbr-name=Dir, classifications=Condition-Qualifier  # Direction
      Dire: abbr-name=Dire, classifications=Condition-Qualifier  # Directory
      Di: abbr-name=Di, classifications=Condition-Qualifier  # Disable
      Disa: abbr-name=Disa, classifications=Action-PhysicalType  # Disappear | disappear. used, in order to define a state of failure: "disappeared failure"
      Disarm: abbr-name=Disarm, classifications=Action-PhysicalType
      Disarmed: abbr-name=Disarmed, classifications=Condition-Qualifier
      Dcha: abbr-name=Dcha, classifications=Condition-Qualifier  # Discharge
      Discnct: abbr-name=Discnct, classifications=Action-PhysicalType  # Disconnect
      Dis: abbr-name=Dis, classifications=Condition-Qualifier  # Discrete
      Disengmt: abbr-name=Disengmt, classifications=Condition-Qualifier  # Disengagement
      Dsk: abbr-name=Dsk, classifications=Mean-Environment-Device  # Disk
      Dpl: abbr-name=Dpl, classifications=Condition-Qualifier  # Displacement
      Disp: abbr-name=Disp, classifications=Mean-Environment-Device  # Display | In both meanings, the display (Component) and to display (Characteristic)
      Dispd: abbr-name=Dispd, classifications=Condition-Qualifier  # Displayed
      Dst: abbr-name=Dst, classifications=Action-PhysicalType  # Distance
      Distbn: abbr-name=Distbn, classifications=Condition-Qualifier  # Distribution
      Dstbc: abbr-name=Dstbc, classifications=Condition-Qualifier  # Disturbance
      Div: abbr-name=Div, classifications=Condition-Qualifier  # Division
      Done: abbr-name=Done, classifications=Condition-Qualifier  # e.g. plausibility check done
      Door: abbr-name=Door, classifications=Mean-Environment-Device
      Dbl: abbr-name=Dbl, classifications=Condition-Qualifier  # Double
      Dwn: abbr-name=Dwn, classifications=Condition-Qualifier  # Down
      Drg: abbr-name=Drg, classifications=Condition-Qualifier  # Drag | resistance, caused by mechanical, aerodynamical of topographical influences, being effective against a movement
      Drift: abbr-name=Drift, classifications=Condition-Qualifier
      Drv: abbr-name=Drv, classifications=Condition-Qualifier  # Drive | drive (gear engaged)
      Drvn: abbr-name=Drvn, classifications=Condition-Qualifier  # Driven
      Drvr: abbr-name=Drvr, classifications=Mean-Environment-Device  # Driver | Driver of the vehicle.
      Dt: abbr-name=Dt, classifications=Mean-Environment-Device  # Drivetrain
      Drvg: abbr-name=Drvg, classifications=Action-PhysicalType  # Driving | Action of driving the vehicle.
      Droop: abbr-name=Droop, classifications=Condition-Qualifier
      Drp: abbr-name=Drp, classifications=Condition-Qualifier  # Drop
      Dry: abbr-name=Dry, classifications=Condition-Qualifier  # dry. dry is the opposite of lubricated in case of friction
      Dtc: abbr-name=Dtc, classifications=Condition-Qualifier  # DTC | Diagnostic Trouble Code
      Dtd: abbr-name=Dtd, classifications=Mean-Environment-Device  # DTD | Drivetrain Torque Distribution
      Dual: abbr-name=Dual, classifications=Condition-Qualifier
      Dummy: abbr-name=Dummy, classifications=Condition-Qualifier
      Dump: abbr-name=Dump, classifications=Action-PhysicalType
      Durn: abbr-name=Durn, classifications=Condition-Qualifier  # Duration
      Durg: abbr-name=Durg, classifications=Preposition  # During
      Duty: abbr-name=Duty, classifications=Condition-Qualifier
      Dyn: abbr-name=Dyn, classifications=Condition-Qualifier  # Dynamic
      Dyno: abbr-name=Dyno, classifications=Mean-Environment-Device  # Dynamometer
      Easy: abbr-name=Easy, classifications=Condition-Qualifier
      Ec: abbr-name=Ec, classifications=Condition-Qualifier  # EC | European Community
      Eco: abbr-name=Eco, classifications=Condition-Qualifier  # Economy | economy. related to the detection of driver type either an economy/comfort oriented or a sportive/power requesting driver can be distinguished.
      Ecu: abbr-name=Ecu, classifications=Mean-Environment-Device  # ECU | Electronic Control Unit
      Edge: abbr-name=Edge, classifications=Condition-Qualifier
      Edit: abbr-name=Edit, classifications=Action-PhysicalType
      Eep: abbr-name=Eep, classifications=Mean-Environment-Device  # EEPROM | Electrically Erasable Programmable Read-Only Memory
      Efc: abbr-name=Efc, classifications=Condition-Qualifier  # Effective
      Eff: abbr-name=Eff, classifications=Action-PhysicalType  # Efficiency
      Effort: abbr-name=Effort, classifications=Condition-Qualifier
      Egr: abbr-name=Egr, classifications=Mean-Environment-Device  # EGR | Exhaust Gas Recirculation
      Egypt: abbr-name=Egypt, classifications=Condition-Qualifier
      Ehb: abbr-name=Ehb, classifications=Mean-Environment-Device  # EHB | Electro Hydraulic Brake
      Elpd: abbr-name=Elpd, classifications=Condition-Qualifier  # Elapsed
      Elec: abbr-name=Elec, classifications=Condition-Qualifier  # Electric | Used in the sense of electric or electrical
      Electc: abbr-name=Electc, classifications=Condition-Qualifier  # Electronic
      Eltpnm: abbr-name=Eltpnm, classifications=Condition-Qualifier  # Electropneumatic
      Elm: abbr-name=Elm, classifications=Mean-Environment-Device  # Element
      Elevn: abbr-name=Elevn, classifications=Action-PhysicalType  # Elevation | Measured angle from horizon
      Em: abbr-name=Em, classifications=Mean-Environment-Device  # EM | Electrical Machine
      Emgy: abbr-name=Emgy, classifications=Mean-Environment-Device  # Emergency
      Emf: abbr-name=Emf, classifications=Action-PhysicalType  # EMF | Electromotive "force" is not a force (measured in newtons) but a potential, or energy per unit of charge, measured in volts.
      Emi: abbr-name=Emi, classifications=Mean-Environment-Device  # Emission
      Empty: abbr-name=Empty, classifications=Condition-Qualifier
      Emul: abbr-name=Emul, classifications=Action-PhysicalType  # Emulate
      Emuld: abbr-name=Emuld, classifications=Condition-Qualifier  # Emulated
      Emuln: abbr-name=Emuln, classifications=Condition-Qualifier  # Emulation
      Ena: abbr-name=Ena, classifications=Condition-Qualifier  # Enable
      Enad: abbr-name=Enad, classifications=Condition-Qualifier  # Enabled
      Enag: abbr-name=Enag, classifications=Condition-Qualifier  # Enabling
      End: abbr-name=End, classifications=Condition-Qualifier
      Egy: abbr-name=Egy, classifications=Action-PhysicalType  # Energy
      Engd: abbr-name=Engd, classifications=Condition-Qualifier  # Engaged
      Engmt: abbr-name=Engmt, classifications=Mean-Environment-Device  # Engagement | engagement. to express the situation of engaging e.g. a gear from neutral position / transmission gutter until synchronisation performed.
      Eng: abbr-name=Eng, classifications=Mean-Environment-Device  # Engine
      England: abbr-name=England, classifications=Condition-Qualifier
      Enhd: abbr-name=Enhd, classifications=Condition-Qualifier  # Enhanced
      Enhmt: abbr-name=Enhmt, classifications=Condition-Qualifier  # Enhancement
      Engh: abbr-name=Engh, classifications=Condition-Qualifier  # Enough
      Enchmt: abbr-name=Enchmt, classifications=Condition-Qualifier  # Enrichment
      Entr: abbr-name=Entr, classifications=Action-PhysicalType  # Enter
      Entrc: abbr-name=Entrc, classifications=Mean-Environment-Device  # Entrance
      Entry: abbr-name=Entry, classifications=Action-PhysicalType
      Env: abbr-name=Env, classifications=Mean-Environment-Device  # Environment
      Envtl: abbr-name=Envtl, classifications=Condition-Qualifier  # Environmental
      Eoi: abbr-name=Eoi, classifications=Condition-Qualifier  # EOI | End of Injection
      Eol: abbr-name=Eol, classifications=Condition-Qualifier  # EOL | End of Line
      Epb: abbr-name=Epb, classifications=Mean-Environment-Device  # EPB | Electric Parking Brake
      Equ: abbr-name=Equ, classifications=Condition-Qualifier  # Equal
      Equip: abbr-name=Equip, classifications=Mean-Environment-Device  # Equipment
      Equid: abbr-name=Equid, classifications=Condition-Qualifier  # Equipped
      Equiv: abbr-name=Equiv, classifications=Condition-Qualifier  # Equivalent
      Erase: abbr-name=Erase, classifications=Action-PhysicalType
      Err: abbr-name=Err, classifications=Condition-Qualifier  # Error | information of a defect
      Esc: abbr-name=Esc, classifications=Mean-Environment-Device  # ESC | Electronic Stability Control
      Estim: abbr-name=Estim, classifications=Action-PhysicalType  # Estimate
      Estimd: abbr-name=Estimd, classifications=Condition-Qualifier  # Estimated
      Estimn: abbr-name=Estimn, classifications=Condition-Qualifier  # Estimation
      Estimr: abbr-name=Estimr, classifications=Condition-Qualifier  # Estimator
      Eta: abbr-name=Eta, classifications=Action-PhysicalType  # Typically used for eta factor, efficiency, factor depending on viscosity
      Etc: abbr-name=Etc, classifications=Mean-Environment-Device  # ETC | Electronic Throttle Control
      Eth: abbr-name=Eth, classifications=Mean-Environment-Device  # Ethernet
      Ev: abbr-name=Ev, classifications=Mean-Environment-Device  # EV | Electric Vehicle
      Evl: abbr-name=Evl, classifications=Action-PhysicalType  # Evaluate
      Evln: abbr-name=Evln, classifications=Action-PhysicalType  # Evaluation
      Evlr: abbr-name=Evlr, classifications=Mean-Environment-Device  # Evaluator
      Evap: abbr-name=Evap, classifications=Condition-Qualifier  # Evaporative
      Evapr: abbr-name=Evapr, classifications=Mean-Environment-Device  # Evaporator
      Even: abbr-name=Even, classifications=Condition-Qualifier
      Eve: abbr-name=Eve, classifications=Condition-Qualifier  # Event
      Ever: abbr-name=Ever, classifications=Condition-Qualifier
      Excd: abbr-name=Excd, classifications=Action-PhysicalType  # Exceed
      Excdd: abbr-name=Excdd, classifications=Condition-Qualifier  # Exceeded
      Excr: abbr-name=Excr, classifications=Condition-Qualifier  # Excenter
      Excpn: abbr-name=Excpn, classifications=Condition-Qualifier  # Exception
      Exct: abbr-name=Exct, classifications=Action-PhysicalType  # Excitation | the keyword is used to express the technical effect of excitation, e.g. in connection with a current or a voltage in a generator
      Excl: abbr-name=Excl, classifications=Action-PhysicalType  # Exclude
      Exclsn: abbr-name=Exclsn, classifications=Action-PhysicalType  # Exclusion
      Exist: abbr-name=Exist, classifications=Action-PhysicalType
      Exotherm: abbr-name=Exotherm, classifications=Condition-Qualifier  # Exothermal
      Exp: abbr-name=Exp, classifications=Condition-Qualifier  # Expansion | This keyword can be used for the expansion phase of the engine cycle.
      Expt: abbr-name=Expt, classifications=Condition-Qualifier  # Experiment | experiment. In contrast to the keyword Test, it is not used to check an existing functionality, but to try something new.
      Exprt: abbr-name=Exprt, classifications=Action-PhysicalType  # Export
      Extn: abbr-name=Extn, classifications=Action-PhysicalType  # Extend
      Extd: abbr-name=Extd, classifications=Condition-Qualifier  # Extended
      Extr: abbr-name=Extr, classifications=Mean-Environment-Device  # Exterior
      Ext: abbr-name=Ext, classifications=Condition-Qualifier  # External
      Extrpn: abbr-name=Extrpn, classifications=Action-PhysicalType  # Extrapolation
      Facd: abbr-name=Facd, classifications=Condition-Qualifier  # Faced
      Fac: abbr-name=Fac, classifications=Action-PhysicalType  # Factor | factor, coefficient
      Factry: abbr-name=Factry, classifications=Condition-Qualifier  # Factory
      Fade: abbr-name=Fade, classifications=Action-PhysicalType
      Fail: abbr-name=Fail, classifications=Condition-Qualifier
      Faild: abbr-name=Faild, classifications=Condition-Qualifier  # Failed
      Failr: abbr-name=Failr, classifications=Condition-Qualifier  # Failure
      Fall: abbr-name=Fall, classifications=Condition-Qualifier  # Falling
      Fan: abbr-name=Fan, classifications=Mean-Environment-Device
      Frd: abbr-name=Frd, classifications=Mean-Environment-Device  # Farad | Unit of measure for Electric capacitance
      Fast: abbr-name=Fast, classifications=Condition-Qualifier
      Flt: abbr-name=Flt, classifications=Mean-Environment-Device  # Fault
      Fav: abbr-name=Fav, classifications=Condition-Qualifier  # Favourable
      Fb: abbr-name=Fb, classifications=Action-PhysicalType  # Feedback
      Fmale: abbr-name=Fmale, classifications=Condition-Qualifier  # Female
      Fid: abbr-name=Fid, classifications=Condition-Qualifier  # FID | Functional Identifier
      Fie: abbr-name=Fie, classifications=Condition-Qualifier  # Field
      File: abbr-name=File, classifications=Mean-Environment-Device
      Fillg: abbr-name=Fillg, classifications=Action-PhysicalType  # Filling
      Film: abbr-name=Film, classifications=Mean-Environment-Device
      Fil: abbr-name=Fil, classifications=Condition-Qualifier  # Filter
      Fild: abbr-name=Fild, classifications=Condition-Qualifier  # Filtered
      Fim: abbr-name=Fim, classifications=Mean-Environment-Device  # FIM | Function Inhibition Manager
      Final: abbr-name=Final, classifications=Condition-Qualifier
      Findr: abbr-name=Findr, classifications=Mean-Environment-Device  # Finder
      Fine: abbr-name=Fine, classifications=Condition-Qualifier
      Finshd: abbr-name=Finshd, classifications=Condition-Qualifier  # Finished
      First: abbr-name=First, classifications=Condition-Qualifier
      Fixa: abbr-name=Fixa, classifications=Action-PhysicalType  # Fixation
      Fixd: abbr-name=Fixd, classifications=Condition-Qualifier  # Fixed
      Flg: abbr-name=Flg, classifications=Condition-Qualifier  # Flag | Flag is a binary value.
      Flank: abbr-name=Flank, classifications=Mean-Environment-Device
      Flap: abbr-name=Flap, classifications=Mean-Environment-Device
      Flash: abbr-name=Flash, classifications=Action-PhysicalType  # Flash used as verb in the sense of blinking e.g. of an indicator
      Fls: abbr-name=Fls, classifications=Mean-Environment-Device  # Flash | Flash as device used for flash programming
      Flsg: abbr-name=Flsg, classifications=Condition-Qualifier  # Flashing
      Fr: abbr-name=Fr, classifications=Mean-Environment-Device  # Flexray
      Flpr: abbr-name=Flpr, classifications=Mean-Environment-Device  # Flipper
      Flood: abbr-name=Flood, classifications=Condition-Qualifier
      Flow: abbr-name=Flow, classifications=Condition-Qualifier
      Fluc: abbr-name=Fluc, classifications=Condition-Qualifier  # Fluctuation
      Fld: abbr-name=Fld, classifications=Mean-Environment-Device  # Fluid
      Fly: abbr-name=Fly, classifications=Condition-Qualifier
      Flywh: abbr-name=Flywh, classifications=Mean-Environment-Device  # Flywheel
      Fm: abbr-name=Fm, classifications=Mean-Environment-Device  # FM | Frequency Modulation
      Fob: abbr-name=Fob, classifications=Mean-Environment-Device  # Transponder device in the Key
      Fog: abbr-name=Fog, classifications=Mean-Environment-Device
      Fold: abbr-name=Fold, classifications=Action-PhysicalType
      Folw: abbr-name=Folw, classifications=Action-PhysicalType  # Follow
      Fol: abbr-name=Fol, classifications=Condition-Qualifier  # Follower
      Footwell: abbr-name=Footwell, classifications=Mean-Environment-Device  # Space for vehicle occupants legs
      For: abbr-name=For, classifications=Preposition  # Preposition
      F: abbr-name=F, classifications=Action-PhysicalType  # Force | describes the physical parameter 'force'
      Fmt: abbr-name=Fmt, classifications=Condition-Qualifier  # Format
      Fwd: abbr-name=Fwd, classifications=Condition-Qualifier  # Forward
      Foulg: abbr-name=Foulg, classifications=Condition-Qualifier  # Fouling | e.g. used in detection of the fouling of the exhaust gas recirculation (EGR) line
      Frm: abbr-name=Frm, classifications=Condition-Qualifier  # Frame
      Free: abbr-name=Free, classifications=Condition-Qualifier
      Fw: abbr-name=Fw, classifications=Condition-Qualifier  # Freewheeling
      Frz: abbr-name=Frz, classifications=Action-PhysicalType  # Freeze
      Frq: abbr-name=Frq, classifications=Action-PhysicalType  # Frequency
      Frsh: abbr-name=Frsh, classifications=Condition-Qualifier  # Fresh
      Fric: abbr-name=Fric, classifications=Condition-Qualifier  # Friction | Resistance against a movement
      From: abbr-name=From, classifications=Preposition  # Preposition
      Frnt: abbr-name=Frnt, classifications=Condition-Qualifier  # Front
      Frzn: abbr-name=Frzn, classifications=Condition-Qualifier  # Frozen
      Fu: abbr-name=Fu, classifications=Mean-Environment-Device  # Fuel
      Full: abbr-name=Full, classifications=Condition-Qualifier
      Fct: abbr-name=Fct, classifications=Condition-Qualifier  # Function | Purpose
      Fuse: abbr-name=Fuse, classifications=Mean-Environment-Device
      Fusn: abbr-name=Fusn, classifications=Condition-Qualifier  # Fusion
      Gain: abbr-name=Gain, classifications=Condition-Qualifier
      Gap: abbr-name=Gap, classifications=Action-PhysicalType
      Gas: abbr-name=Gas, classifications=Mean-Environment-Device
      Gsl: abbr-name=Gsl, classifications=Mean-Environment-Device  # Gasoline | This keyword is used to express the fuel type "gasoline".
      Gate: abbr-name=Gate, classifications=Mean-Environment-Device
      Gatewy: abbr-name=Gatewy, classifications=Mean-Environment-Device  # Gateway
      Gdi: abbr-name=Gdi, classifications=Mean-Environment-Device  # GDI | Gasoline Direct Injection
      Gear: abbr-name=Gear, classifications=Mean-Environment-Device
      Gbx: abbr-name=Gbx, classifications=Mean-Environment-Device  # Gearbox
      Gen1: abbr-name=Gen, classifications=Action-PhysicalType  # Generate
      Gend: abbr-name=Gend, classifications=Condition-Qualifier  # Generated
      Genn: abbr-name=Genn, classifications=Condition-Qualifier  # Generation
      Genr: abbr-name=Genr, classifications=Mean-Environment-Device  # Generator
      Gen: abbr-name=Gen, classifications=Condition-Qualifier  # Generic
      Generic: abbr-name=Generic, classifications=Condition-Qualifier
      Germany: abbr-name=Germany, classifications=Condition-Qualifier
      Get: abbr-name=Get, classifications=Action-PhysicalType
      Giga: abbr-name=Giga, classifications=Mean-Environment-Device
      Glass: abbr-name=Glass, classifications=Mean-Environment-Device
      Glb: abbr-name=Glb, classifications=Condition-Qualifier  # Global
      Glv: abbr-name=Glv, classifications=Mean-Environment-Device  # Glove
      Glw: abbr-name=Glw, classifications=Mean-Environment-Device  # Glow
      Govr: abbr-name=Govr, classifications=Mean-Environment-Device  # Governor
      Gpt: abbr-name=Gpt, classifications=Mean-Environment-Device  # GPT | General Purpose Timer
      Grd: abbr-name=Grd, classifications=Mean-Environment-Device  # Grade
      Grdt: abbr-name=Grdt, classifications=Action-PhysicalType  # Gradient | gradient/slope
      Gr: abbr-name=Gr, classifications=Mean-Environment-Device  # Gram | Unit of measure for mass
      Grvy: abbr-name=Grvy, classifications=Mean-Environment-Device  # Gravity | This keyword describes the force of attraction between to masses, well known as gravity.
      Grid: abbr-name=Grid, classifications=Mean-Environment-Device
      Grip: abbr-name=Grip, classifications=Action-PhysicalType  # example: Maximum desired engine torque for grip adaptation
      Gnd: abbr-name=Gnd, classifications=Mean-Environment-Device  # Ground
      Group: abbr-name=Group, classifications=Condition-Qualifier
      Gsm: abbr-name=Gsm, classifications=Mean-Environment-Device  # GSM | Global System for Mobile Communications
      Gulf: abbr-name=Gulf, classifications=Condition-Qualifier
      Half: abbr-name=Half, classifications=Condition-Qualifier  # half, semi-. This keyword is used to characterize something for being only one part of two that make a whole item. Example: the time for a half engine segment.
      Hall: abbr-name=Hall, classifications=Mean-Environment-Device  # as used in Hall Sensor
      Halt: abbr-name=Halt, classifications=Condition-Qualifier
      Hndbrk: abbr-name=Hndbrk, classifications=Mean-Environment-Device  # Handbrake
      Hndl: abbr-name=Hndl, classifications=Mean-Environment-Device  # Handle | The physical device for opening a door
      Hndlg: abbr-name=Hndlg, classifications=Mean-Environment-Device  # Handling
      Hard: abbr-name=Hard, classifications=Condition-Qualifier
      Hw: abbr-name=Hw, classifications=Mean-Environment-Device  # Hardware | This keyword is used to express a relationship to Hardware within a functionality or an environmental tools, e.g. Labcar.
      Hzrd: abbr-name=Hzrd, classifications=Mean-Environment-Device  # Hazard
      Hd: abbr-name=Hd, classifications=Mean-Environment-Device  # Head
      Hdr: abbr-name=Hdr, classifications=Condition-Qualifier  # Header
      Hdlamp: abbr-name=Hdlamp, classifications=Mean-Environment-Device  # Headlamp
      Hdphn: abbr-name=Hdphn, classifications=Mean-Environment-Device  # Headphone
      Hdrest: abbr-name=Hdrest, classifications=Mean-Environment-Device  # Headrest | Headrest of seats
      Heal: abbr-name=Heal, classifications=Action-PhysicalType  # This keyword is needed for functions that try to heal a failure. E.g. an actuator or a control valve is blocked due to a dirt particle. A free-shaking control signal can lead to releasing the particle from the actuator.
      Heat: abbr-name=Heat, classifications=Mean-Environment-Device
      Heatd: abbr-name=Heatd, classifications=Condition-Qualifier  # Heated
      Heatr: abbr-name=Heatr, classifications=Mean-Environment-Device  # Heater
      Heatg: abbr-name=Heatg, classifications=Action-PhysicalType  # Heating
      Hvy: abbr-name=Hvy, classifications=Condition-Qualifier  # Heavy
      Hecto: abbr-name=Hecto, classifications=Mean-Environment-Device  # Unit of measure for pressure
      Hei: abbr-name=Hei, classifications=Action-PhysicalType  # Height
      Hz: abbr-name=Hz, classifications=Mean-Environment-Device  # Hertz | Unit of measure for frequency
      Hev: abbr-name=Hev, classifications=Mean-Environment-Device  # HEV | Hybrid Electric Vehicle
      Hbrnt: abbr-name=Hbrnt, classifications=Action-PhysicalType  # Hibernate
      Hi: abbr-name=Hi, classifications=Condition-Qualifier  # High
      Hp: abbr-name=Hp, classifications=Condition-Qualifier  # Highpass
      Hill: abbr-name=Hill, classifications=Mean-Environment-Device
      Hist: abbr-name=Hist, classifications=Condition-Qualifier  # History | for data stored in history memory
      Hitch: abbr-name=Hitch, classifications=Action-PhysicalType
      Hmi: abbr-name=Hmi, classifications=Mean-Environment-Device  # HMI | Human-Machine Interface
      Hld: abbr-name=Hld, classifications=Action-PhysicalType  # Hold
      Home: abbr-name=Home, classifications=Mean-Environment-Device
      Hom: abbr-name=Hom, classifications=Condition-Qualifier  # Homogeneous | e. g. used in homogeneous injection
      Hood: abbr-name=Hood, classifications=Mean-Environment-Device  # e. g. engine hood
      Hoop: abbr-name=Hoop, classifications=Mean-Environment-Device
      Hozl: abbr-name=Hozl, classifications=Condition-Qualifier  # Horizontal
      Horn: abbr-name=Horn, classifications=Mean-Environment-Device
      Hot: abbr-name=Hot, classifications=Condition-Qualifier
      Htl: abbr-name=Htl, classifications=Mean-Environment-Device  # Hotel
      Hr: abbr-name=Hr, classifications=Mean-Environment-Device  # Hour | Unit of measure for time
      Hud: abbr-name=Hud, classifications=Mean-Environment-Device  # HUD | Head Up Display. This keyword is used to express the feature of show information right in the field of view of the driver, e.g. by mirroring it onto the wind screen.
      Hum: abbr-name=Hum, classifications=Condition-Qualifier  # Humidity | the keyword is used to assign the amount of water in a gas or a gaseous mixture. Example: the humidity in the exhaust gas.
      Hvac: abbr-name=Hvac, classifications=Mean-Environment-Device  # HVAC | Heating Ventilation and Air Conditioning
      Hyb: abbr-name=Hyb, classifications=Condition-Qualifier  # Hybrid | Any vehicle that combines two or more sources of power that can directly or indirectly provide propulsion power is a hybrid
      Hyd: abbr-name=Hyd, classifications=Condition-Qualifier  # Hydraulic | used to characterize hydraulic components
      Hc: abbr-name=Hc, classifications=Mean-Environment-Device  # Hydrocarbon
      Hys: abbr-name=Hys, classifications=Condition-Qualifier  # Hysteresis
      I: abbr-name=I, classifications=Action-PhysicalType  # Electric current
      Ice: abbr-name=Ice, classifications=Mean-Environment-Device  # This keyword expresses an interrelation with ice or with an icy environment, e.g. a functionality to improve the drivability on frosted streets.
      Icu: abbr-name=Icu, classifications=Mean-Environment-Device  # ICU | Input Capture Unit
      Ideal: abbr-name=Ideal, classifications=Condition-Qualifier  # e.g. ideal computed vehicle speed for curve
      Identcl: abbr-name=Identcl, classifications=Condition-Qualifier  # Identical
      Idn: abbr-name=Idn, classifications=Condition-Qualifier  # Identification
      Id: abbr-name=Id, classifications=Mean-Environment-Device  # Identifier
      Idle: abbr-name=Idle, classifications=Condition-Qualifier
      Ign: abbr-name=Ign, classifications=Mean-Environment-Device  # Ignition
      Illmn: abbr-name=Illmn, classifications=Action-PhysicalType  # Illumination
      Img: abbr-name=Img, classifications=Mean-Environment-Device  # Image
      Imdt: abbr-name=Imdt, classifications=Condition-Qualifier  # Immediate | this keyword is used to assign a requirement of minimum delay time or the need to take action as soon as possible.
      Imobn: abbr-name=Imobn, classifications=Action-PhysicalType  # Immobilisation
      Imob: abbr-name=Imob, classifications=Mean-Environment-Device  # Immobilizer
      Impct: abbr-name=Impct, classifications=Action-PhysicalType  # Impact
      Impy: abbr-name=Impy, classifications=Condition-Qualifier  # Implausibility
      Imps: abbr-name=Imps, classifications=Condition-Qualifier  # Implausible
      Imprt: abbr-name=Imprt, classifications=Action-PhysicalType  # Import
      Impo: abbr-name=Impo, classifications=Condition-Qualifier  # Impossible
      Imp: abbr-name=Imp, classifications=Mean-Environment-Device  # Impulse
      In: abbr-name=In, classifications=Preposition  # Preposition for location or condition
      Incln: abbr-name=Incln, classifications=Action-PhysicalType  # Inclination
      Incl: abbr-name=Incl, classifications=Action-PhysicalType  # Incline
      Inc: abbr-name=Inc, classifications=Action-PhysicalType  # Increase | This keyword is used to express a stepwise accretion of a value or counter
      Inct: abbr-name=Inct, classifications=Condition-Qualifier  # Increment | This keyword is used to express a stepwise accretion of a value or counter
      Idx: abbr-name=Idx, classifications=Condition-Qualifier  # Index
      India: abbr-name=India, classifications=Condition-Qualifier
      Indcd: abbr-name=Indcd, classifications=Condition-Qualifier  # Indicated
      Indcn: abbr-name=Indcn, classifications=Condition-Qualifier  # Indication
      Indcr: abbr-name=Indcr, classifications=Mean-Environment-Device  # Indicator
      Ind: abbr-name=Ind, classifications=Condition-Qualifier  # Individual
      Indonesia: abbr-name=Indonesia, classifications=Condition-Qualifier
      Indu: abbr-name=Indu, classifications=Condition-Qualifier  # Inductive
      Inert: abbr-name=Inert, classifications=Condition-Qualifier
      J: abbr-name=J, classifications=Action-PhysicalType  # Inertia | this keyword is used to express the physical effect that the mass of a body is interacting against its acceleration
      Info: abbr-name=Info, classifications=Condition-Qualifier  # Information
      Infra: abbr-name=Infra, classifications=Condition-Qualifier  # e.g. in infra-red, infra-structure, infra-sound, infrasonic sound
      Inhb: abbr-name=Inhb, classifications=Action-PhysicalType  # Inhibit
      Inhbn: abbr-name=Inhbn, classifications=Action-PhysicalType  # Inhibition
      Ini: abbr-name=Ini, classifications=Condition-Qualifier  # Initial
      Inin: abbr-name=Inin, classifications=Condition-Qualifier  # Initialization
      Inj: abbr-name=Inj, classifications=Action-PhysicalType  # Injection
      Injr: abbr-name=Injr, classifications=Mean-Environment-Device  # Injector
      Innr: abbr-name=Innr, classifications=Condition-Qualifier  # Inner
      Inp: abbr-name=Inp, classifications=Condition-Qualifier  # Input
      Insert: abbr-name=Insert, classifications=Action-PhysicalType
      Insd: abbr-name=Insd, classifications=Mean-Environment-Device  # Inside
      Inst: abbr-name=Inst, classifications=Condition-Qualifier  # Instance | This keyword is used for the characterisation e.g. of a diagnosis, instance of the intake air temperature diagnosis
      Intk: abbr-name=Intk, classifications=Mean-Environment-Device  # Intake | Keyword Intake will also be used in the sense of Inlet
      Intgr: abbr-name=Intgr, classifications=Condition-Qualifier  # Integer
      Intgl: abbr-name=Intgl, classifications=Condition-Qualifier  # Integral
      Intd: abbr-name=Intd, classifications=Condition-Qualifier  # Intended
      Inten: abbr-name=Inten, classifications=Action-PhysicalType  # Intensity
      Ico: abbr-name=Ico, classifications=Mean-Environment-Device  # Intercooler
      Interdom: abbr-name=Interdom, classifications=Mean-Environment-Device  # Interdomain
      If: abbr-name=If, classifications=Condition-Qualifier  # Interface
      Intr: abbr-name=Intr, classifications=Mean-Environment-Device  # Interior
      Intery: abbr-name=Intery, classifications=Condition-Qualifier  # Intermediary
      Inter: abbr-name=Inter, classifications=Condition-Qualifier  # Intermediate
      Intm: abbr-name=Intm, classifications=Condition-Qualifier  # Intermittent
      Int: abbr-name=Int, classifications=Condition-Qualifier  # Internal
      Intrpn: abbr-name=Intrpn, classifications=Action-PhysicalType  # Interpolation
      Itp: abbr-name=Itp, classifications=Condition-Qualifier  # Interpreter | For the network layer of KWP2000
      Intrpt: abbr-name=Intrpt, classifications=Action-PhysicalType  # Interrupt
      Intl: abbr-name=Intl, classifications=Condition-Qualifier  # Interval
      Intvg: abbr-name=Intvg, classifications=Condition-Qualifier  # Intervening
      Intv: abbr-name=Intv, classifications=Action-PhysicalType  # Intervention
      Intxcn: abbr-name=Intxcn, classifications=Condition-Qualifier  # Intoxication | User under influence of drugs (e.g. alcohol)
      Invld: abbr-name=Invld, classifications=Condition-Qualifier  # Invalid
      Ivs: abbr-name=Ivs, classifications=Condition-Qualifier  # Inverse
      Ivt: abbr-name=Ivt, classifications=Action-PhysicalType  # Invert
      Ivtr: abbr-name=Ivtr, classifications=Mean-Environment-Device  # Inverter | e.g. inverter in electric cars
      Io: abbr-name=Io, classifications=Mean-Environment-Device  # IO | Input/Output
      Ion: abbr-name=Ion, classifications=Mean-Environment-Device  # as used in Lithium Ion Battery
      Irrv: abbr-name=Irrv, classifications=Condition-Qualifier  # Irreversible | this keyword is used to express that something can not return to a previous status, e.g. in Cruise Control deactivation it means in this case that cruise can not be activated again in the same driving cycle once a deactivation occurred
      Italy: abbr-name=Italy, classifications=Condition-Qualifier
      Jam: abbr-name=Jam, classifications=Action-PhysicalType
      Japan: abbr-name=Japan, classifications=Condition-Qualifier
      Jerk: abbr-name=Jerk, classifications=Mean-Environment-Device
      Jou: abbr-name=Jou, classifications=Mean-Environment-Device  # Joule | Unit of measure for energy, work
      Jmp: abbr-name=Jmp, classifications=Action-PhysicalType  # Jump
      Keep: abbr-name=Keep, classifications=Action-PhysicalType  # e.g. for active Safety Systems like Lane Keep Aid
      Kelvin: abbr-name=Kelvin, classifications=Mean-Environment-Device  # Unit of measure for temperature
      Key: abbr-name=Key, classifications=Mean-Environment-Device
      Keyls: abbr-name=Keyls, classifications=Condition-Qualifier  # Keyless
      Keyword: abbr-name=Keyword, classifications=Mean-Environment-Device
      Ki: abbr-name=Ki, classifications=Action-PhysicalType  # integral gain, Integral amplification, used in software control loops e.g. damper control or lambda control
      Kd: abbr-name=Kd, classifications=Mean-Environment-Device  # Kickdown
      Kilo: abbr-name=Kilo, classifications=Mean-Environment-Device
      Knee: abbr-name=Knee, classifications=Mean-Environment-Device  # knee of human body
      Knob: abbr-name=Knob, classifications=Mean-Environment-Device
      Knk: abbr-name=Knk, classifications=Mean-Environment-Device  # Knock
      Korea: abbr-name=Korea, classifications=Condition-Qualifier
      Kp: abbr-name=Kp, classifications=Action-PhysicalType  # proportional gain, proportional amplification, used in software control loops e.g. damper control or lambda control
      Lam: abbr-name=Lam, classifications=Action-PhysicalType  # Lambda | Air/Fuel Ratio
      Lamp: abbr-name=Lamp, classifications=Mean-Environment-Device  # this keyword is used do describe the component of a lamp, e.g. in the display of the instrument panel
      Lane: abbr-name=Lane, classifications=Mean-Environment-Device
      Language: abbr-name=Language, classifications=Mean-Environment-Device
      Lrg: abbr-name=Lrg, classifications=Condition-Qualifier  # Large
      Lst: abbr-name=Lst, classifications=Condition-Qualifier  # Last
      Ltch: abbr-name=Ltch, classifications=Mean-Environment-Device  # Latch
      Ltcy: abbr-name=Ltcy, classifications=Condition-Qualifier  # Latency
      Lat: abbr-name=Lat, classifications=Condition-Qualifier  # Lateral
      Lati: abbr-name=Lati, classifications=Condition-Qualifier  # Latitude | e.g. position from navigation system
      Lnch: abbr-name=Lnch, classifications=Action-PhysicalType  # Launch
      Lead: abbr-name=Lead, classifications=Mean-Environment-Device  # e.g. lead cylinder
      Leak: abbr-name=Leak, classifications=Condition-Qualifier  # The power stage for the piezo injectors has a special hardware (leakage compensation) to avoid discharging of capacities.
      Lean: abbr-name=Lean, classifications=Condition-Qualifier
      Lrn: abbr-name=Lrn, classifications=Action-PhysicalType  # Learn
      Lrng: abbr-name=Lrng, classifications=Condition-Qualifier  # Learning
      Lvng: abbr-name=Lvng, classifications=Action-PhysicalType  # Leaving
      Led: abbr-name=Led, classifications=Mean-Environment-Device  # LED | Light Emitting Diode
      Le: abbr-name=Le, classifications=Condition-Qualifier  # Left
      Len: abbr-name=Len, classifications=Action-PhysicalType  # Length
      Lvl: abbr-name=Lvl, classifications=Action-PhysicalType  # Level
      Lvlg: abbr-name=Lvlg, classifications=Action-PhysicalType  # Leveling
      Lvr: abbr-name=Lvr, classifications=Mean-Environment-Device  # Lever
      Lib: abbr-name=Lib, classifications=Condition-Qualifier  # Library
      Lid: abbr-name=Lid, classifications=Mean-Environment-Device
      Li: abbr-name=Li, classifications=Mean-Environment-Device  # Light
      Lighter: abbr-name=Lighter, classifications=Mean-Environment-Device
      Ltg: abbr-name=Ltg, classifications=Condition-Qualifier  # Lighting
      Lim: abbr-name=Lim, classifications=Condition-Qualifier  # Limit
      Limn: abbr-name=Limn, classifications=Action-PhysicalType  # Limitation
      Limd: abbr-name=Limd, classifications=Condition-Qualifier  # Limited
      Limr: abbr-name=Limr, classifications=Mean-Environment-Device  # Limiter
      Limp: abbr-name=Limp, classifications=Action-PhysicalType  # example: Timeout camshaft sensor limp home
      Lin: abbr-name=Lin, classifications=Mean-Environment-Device  # LIN | Local Interconnect Network
      Line: abbr-name=Line, classifications=Mean-Environment-Device
      Lnr: abbr-name=Lnr, classifications=Condition-Qualifier  # Linear | used for description of linear qualities
      List: abbr-name=List, classifications=Mean-Environment-Device
      L: abbr-name=L, classifications=Mean-Environment-Device  # Liter | unit of measure for volume
      Load: abbr-name=Load, classifications=Action-PhysicalType  # Unit must be percent
      Lobe: abbr-name=Lobe, classifications=Mean-Environment-Device  # as used in the case of single lobe cam
      Locn: abbr-name=Locn, classifications=Action-PhysicalType  # Location | Position
      Lock: abbr-name=Lock, classifications=Action-PhysicalType
      Lockd: abbr-name=Lockd, classifications=Condition-Qualifier  # Locked
      Lockg: abbr-name=Lockg, classifications=Action-PhysicalType  # Locking
      Logl: abbr-name=Logl, classifications=Condition-Qualifier  # Logical
      Long: abbr-name=Long, classifications=Condition-Qualifier
      Longi: abbr-name=Longi, classifications=Condition-Qualifier  # Longitude | e.g. position from navigation system
      Lgt: abbr-name=Lgt, classifications=Condition-Qualifier  # Longitudinal | longitudinal
      Loop: abbr-name=Loop, classifications=Mean-Environment-Device
      Loss: abbr-name=Loss, classifications=Condition-Qualifier
      Lost: abbr-name=Lost, classifications=Condition-Qualifier
      Ldn: abbr-name=Ldn, classifications=Action-PhysicalType  # Loudness
      Lo: abbr-name=Lo, classifications=Condition-Qualifier  # Low
      Lowr: abbr-name=Lowr, classifications=Condition-Qualifier  # Lower
      Lp: abbr-name=Lp, classifications=Condition-Qualifier  # Lowpass
      Lpg: abbr-name=Lpg, classifications=Mean-Environment-Device  # LPG | Liquified Petroleum Gas
      Lum: abbr-name=Lum, classifications=Mean-Environment-Device  # Lumbar
      Mac: abbr-name=Mac, classifications=Mean-Environment-Device  # Machine
      Mag: abbr-name=Mag, classifications=Condition-Qualifier  # Magnetic
      Mgn: abbr-name=Mgn, classifications=Condition-Qualifier  # Magnitude
      Mai: abbr-name=Mai, classifications=Condition-Qualifier  # Main
      Mntn: abbr-name=Mntn, classifications=Condition-Qualifier  # Maintenance
      Malaysia: abbr-name=Malaysia, classifications=Condition-Qualifier
      Male: abbr-name=Male, classifications=Condition-Qualifier
      Mng: abbr-name=Mng, classifications=Action-PhysicalType  # Manage
      Mngt: abbr-name=Mngt, classifications=Condition-Qualifier  # Management
      Mgr: abbr-name=Mgr, classifications=Condition-Qualifier  # Manager
      Mnfld: abbr-name=Mnfld, classifications=Mean-Environment-Device  # Manifold
      Man: abbr-name=Man, classifications=Condition-Qualifier  # Manual
      Map: abbr-name=Map, classifications=Mean-Environment-Device
      Mpg: abbr-name=Mpg, classifications=Action-PhysicalType  # Mapping
      Mkr: abbr-name=Mkr, classifications=Condition-Qualifier  # Marker
      Mkt: abbr-name=Mkt, classifications=Mean-Environment-Device  # Market | This keyword is used to express market in the meaning of delivery areas, e.g. to characterize deviances in a component or function due to different customer market requirements.
      Mask: abbr-name=Mask, classifications=Condition-Qualifier  # this keyword is used to characterize a masking of a certain value to separate it from the non-masked one.
      M: abbr-name=M, classifications=Action-PhysicalType  # Mass
      Massg: abbr-name=Massg, classifications=Action-PhysicalType  # Massage
      Mst: abbr-name=Mst, classifications=Condition-Qualifier  # Master
      Mat: abbr-name=Mat, classifications=Condition-Qualifier  # Mathematical
      Mtrx: abbr-name=Mtrx, classifications=Condition-Qualifier  # Matrix
      Max: abbr-name=Max, classifications=Condition-Qualifier  # Maximum
      Mcu: abbr-name=Mcu, classifications=Mean-Environment-Device  # MCU | Microcontroller Unit
      Meas: abbr-name=Meas, classifications=Condition-Qualifier  # Measure
      Measd: abbr-name=Measd, classifications=Condition-Qualifier  # Measured
      Mec: abbr-name=Mec, classifications=Condition-Qualifier  # Mechanic
      Mecl: abbr-name=Mecl, classifications=Condition-Qualifier  # Mechanical
      Med: abbr-name=Med, classifications=Condition-Qualifier  # Medium
      Mega: abbr-name=Mega, classifications=Mean-Environment-Device
      Memr: abbr-name=Memr, classifications=Action-PhysicalType  # Memorise
      Memd: abbr-name=Memd, classifications=Condition-Qualifier  # Memorized
      Mem: abbr-name=Mem, classifications=Mean-Environment-Device  # Memory
      Msg: abbr-name=Msg, classifications=Condition-Qualifier  # Message
      Mtr: abbr-name=Mtr, classifications=Mean-Environment-Device  # Meter
      Method: abbr-name=Method, classifications=Condition-Qualifier
      Mtrc: abbr-name=Mtrc, classifications=Condition-Qualifier  # Metric
      Mexico: abbr-name=Mexico, classifications=Condition-Qualifier
      Micro: abbr-name=Micro, classifications=Mean-Environment-Device
      Mid: abbr-name=Mid, classifications=Condition-Qualifier  # Middle
      Mil: abbr-name=Mil, classifications=Mean-Environment-Device  # MIL | Malfunction Indication Lamp
      Milg: abbr-name=Milg, classifications=Action-PhysicalType  # Mileage
      Milli: abbr-name=Milli, classifications=Mean-Environment-Device
      Min: abbr-name=Min, classifications=Condition-Qualifier  # Minimum
      Mins: abbr-name=Mins, classifications=Mean-Environment-Device  # Minute | Unit of measure for time
      Mirr: abbr-name=Mirr, classifications=Mean-Environment-Device  # Mirror
      Misc: abbr-name=Misc, classifications=Condition-Qualifier  # Miscellaneous
      Misf: abbr-name=Misf, classifications=Action-PhysicalType  # Misfire
      Misfg: abbr-name=Misfg, classifications=Condition-Qualifier  # Misfiring
      Miss: abbr-name=Miss, classifications=Condition-Qualifier  # Missing
      Mtgtn: abbr-name=Mtgtn, classifications=Condition-Qualifier  # Mitigation
      Mod: abbr-name=Mod, classifications=Condition-Qualifier  # Mode
      Mdl: abbr-name=Mdl, classifications=Mean-Environment-Device  # Model
      Modln: abbr-name=Modln, classifications=Action-PhysicalType  # Modulation
      Mol: abbr-name=Mol, classifications=Mean-Environment-Device  # Mole | is used as unit for the amount of substance
      Mom: abbr-name=Mom, classifications=Mean-Environment-Device  # Moment
      Momtm: abbr-name=Momtm, classifications=Action-PhysicalType  # Momentum
      Monr: abbr-name=Monr, classifications=Mean-Environment-Device  # Monitor
      Mon: abbr-name=Mon, classifications=Action-PhysicalType  # Monitoring
      Mth: abbr-name=Mth, classifications=Mean-Environment-Device  # Month
      Mtn: abbr-name=Mtn, classifications=Action-PhysicalType  # Motion
      Mot: abbr-name=Mot, classifications=Mean-Environment-Device  # Motor
      Motorcycle: abbr-name=Motorcycle, classifications=Mean-Environment-Device
      Mntd: abbr-name=Mntd, classifications=Condition-Qualifier  # Mounted
      Mntg: abbr-name=Mntg, classifications=Action-PhysicalType  # Mounting
      Move: abbr-name=Move, classifications=Action-PhysicalType
      Movmt: abbr-name=Movmt, classifications=Condition-Qualifier  # Movement
      Movg: abbr-name=Movg, classifications=Action-PhysicalType  # Moving
      Msr: abbr-name=Msr, classifications=Condition-Qualifier  # MSR | Engine drag torque control (also known in german language as "Motorschleppmomentregelung" from which the acronym is derived).
      Mt: abbr-name=Mt, classifications=Mean-Environment-Device  # MT | Manual shifted Transmission
      Multi: abbr-name=Multi, classifications=Condition-Qualifier
      Mmed: abbr-name=Mmed, classifications=Mean-Environment-Device  # Multimedia
      Mpl: abbr-name=Mpl, classifications=Condition-Qualifier  # Multiple
      Mux: abbr-name=Mux, classifications=Mean-Environment-Device  # Multiplexer
      N: abbr-name=N, classifications=Action-PhysicalType  # Speed | Rotatory speed, also referred to as speed of rotation measured in rad/s, rpm or equivalents. Examples: EngN = Engine speed [rpm], WhlN = Wheel speed [rpm]
      Nano: abbr-name=Nano, classifications=Mean-Environment-Device
      Nat: abbr-name=Nat, classifications=Condition-Qualifier  # Natural
      Nav: abbr-name=Nav, classifications=Mean-Environment-Device  # Navigation
      Near: abbr-name=Near, classifications=Condition-Qualifier
      Negn: abbr-name=Negn, classifications=Condition-Qualifier  # Negation
      Neg: abbr-name=Neg, classifications=Condition-Qualifier  # Negative
      Net: abbr-name=Net, classifications=Mean-Environment-Device  # Network | describes all kind of networks in general, e. g. an electric network consisting of any type of consumers and generators
      Neut: abbr-name=Neut, classifications=Condition-Qualifier  # Neutral
      New: abbr-name=New, classifications=Condition-Qualifier
      Nwt: abbr-name=Nwt, classifications=Mean-Environment-Device  # Newton
      Night: abbr-name=Night, classifications=Mean-Environment-Device
      Nm: abbr-name=Nm, classifications=Mean-Environment-Device  # NM | Network Management
      No: abbr-name=No, classifications=Preposition  # Opposite of "yes"
      Nod: abbr-name=Nod, classifications=Mean-Environment-Device  # Node | keyword for a junction or joining of lines or ways
      Noise: abbr-name=Noise, classifications=Condition-Qualifier
      Nom: abbr-name=Nom, classifications=Condition-Qualifier  # Nominal
      Nlnr: abbr-name=Nlnr, classifications=Condition-Qualifier  # Nonlinear | nonlinear. used for description of non linear characteristics (e.g. for an optional additional nonlinear correction)
      Nrdc: abbr-name=Nrdc, classifications=Condition-Qualifier  # Nordic
      Norm: abbr-name=Norm, classifications=Condition-Qualifier  # Normal | this keyword is used to describe something as being in the most common mode, e.g. a state machine has a state normal when running properly without disturbance. Do not mix it with Basic for description of fulfilling a basic or minimum requirement.
      Not: abbr-name=Not, classifications=Preposition
      Notif: abbr-name=Notif, classifications=Condition-Qualifier  # Notification
      Now: abbr-name=Now, classifications=Condition-Qualifier  # in this moment
      Nox: abbr-name=Nox, classifications=Mean-Environment-Device  # NOx | Nitrogen oxides, part of the emissions of a combustion engine.
      Noz: abbr-name=Noz, classifications=Mean-Environment-Device  # Nozzle
      Nr: abbr-name=Nr, classifications=Action-PhysicalType  # Number | this keyword is used to express a numbering in physical meaning
      Nv: abbr-name=Nv, classifications=Condition-Qualifier  # Non volatile
      Nvm: abbr-name=Nvm, classifications=Mean-Environment-Device  # NVM | Non Volatile Memory
      Obd: abbr-name=Obd, classifications=Mean-Environment-Device  # OBD | On Board Diagnosis
      Obj: abbr-name=Obj, classifications=Mean-Environment-Device  # Object
      Obs: abbr-name=Obs, classifications=Action-PhysicalType  # Observe
      Obsvr: abbr-name=Obsvr, classifications=Mean-Environment-Device  # Observer
      Obslt: abbr-name=Obslt, classifications=Condition-Qualifier  # Obsolete
      Obstcl: abbr-name=Obstcl, classifications=Mean-Environment-Device  # Obstacle
      Obstrcn: abbr-name=Obstrcn, classifications=Condition-Qualifier  # Obstruction
      Occpt: abbr-name=Occpt, classifications=Mean-Environment-Device  # Occupant
      Odd: abbr-name=Odd, classifications=Condition-Qualifier
      Of: abbr-name=Of, classifications=Preposition  # Preposition
      Off: abbr-name=Off, classifications=Condition-Qualifier
      Offroad: abbr-name=Offroad, classifications=Condition-Qualifier
      Offs: abbr-name=Offs, classifications=Action-PhysicalType  # Offset
      Ohm: abbr-name=Ohm, classifications=Mean-Environment-Device  # Unit of measure for electric resistance
      Oil: abbr-name=Oil, classifications=Mean-Environment-Device
      Ok: abbr-name=Ok, classifications=Condition-Qualifier  # OK
      Old: abbr-name=Old, classifications=Condition-Qualifier  # in the calculation period n, the keyword OLD assigns a value from the period (n-1).
      On: abbr-name=On, classifications=Preposition
      Only: abbr-name=Only, classifications=Preposition
      Open: abbr-name=Open, classifications=Action-PhysicalType
      Opend: abbr-name=Opend, classifications=Condition-Qualifier  # Opened
      Opener: abbr-name=Opener, classifications=Mean-Environment-Device
      Oper: abbr-name=Oper, classifications=Condition-Qualifier  # Operation
      Optic: abbr-name=Optic, classifications=Condition-Qualifier  # Optical
      Optm: abbr-name=Optm, classifications=Condition-Qualifier  # Optimum
      Optn: abbr-name=Optn, classifications=Condition-Qualifier  # Option
      Opt: abbr-name=Opt, classifications=Condition-Qualifier  # Optional
      Or: abbr-name=Or, classifications=Preposition
      Orntn: abbr-name=Orntn, classifications=Action-PhysicalType  # Orientation
      Os: abbr-name=Os, classifications=Mean-Environment-Device  # OS | Operating System
      Osc: abbr-name=Osc, classifications=Action-PhysicalType  # Oscillate
      Oscn: abbr-name=Oscn, classifications=Condition-Qualifier  # Oscillation | This keyword is used to describe occurrences of pulsation or oscillation
      Out: abbr-name=Out, classifications=Preposition
      Outr: abbr-name=Outr, classifications=Condition-Qualifier  # Outer
      Outl: abbr-name=Outl, classifications=Condition-Qualifier  # Outlet | Outlet (e.g. camshaft)
      Outp: abbr-name=Outp, classifications=Condition-Qualifier  # Output
      Outd: abbr-name=Outd, classifications=Mean-Environment-Device  # Outside | Used for outdoor and outside
      Over: abbr-name=Over, classifications=Condition-Qualifier
      Ovf: abbr-name=Ovf, classifications=Condition-Qualifier  # Overflow
      Ovrheatd: abbr-name=Ovrheatd, classifications=Condition-Qualifier  # Overheated
      Ovrheatg: abbr-name=Ovrheatg, classifications=Action-PhysicalType  # Overheating
      Ovld: abbr-name=Ovld, classifications=Condition-Qualifier  # Overload | The keyword is used for an electrical actuator, if the requested power exceeds the allowed long-time power limit. The overload must be possible for a certain time.
      Ovrdn: abbr-name=Ovrdn, classifications=Condition-Qualifier  # Overridden
      Ovrd: abbr-name=Ovrd, classifications=Action-PhysicalType  # Override
      Own: abbr-name=Own, classifications=Condition-Qualifier
      Oxd: abbr-name=Oxd, classifications=Condition-Qualifier  # Oxidation
      Pad: abbr-name=Pad, classifications=Mean-Environment-Device
      Paddl: abbr-name=Paddl, classifications=Mean-Environment-Device  # Paddle
      Page: abbr-name=Page, classifications=Condition-Qualifier
      Pan: abbr-name=Pan, classifications=Mean-Environment-Device  # Panel
      Panic: abbr-name=Panic, classifications=Action-PhysicalType
      Prm: abbr-name=Prm, classifications=Condition-Qualifier  # Parameter
      Parent: abbr-name=Parent, classifications=Condition-Qualifier  # e.g. "Parent street segment" used in context of route guidance from navigation system
      Par: abbr-name=Par, classifications=Condition-Qualifier  # Parity
      Park: abbr-name=Park, classifications=Action-PhysicalType
      Prkg: abbr-name=Prkg, classifications=Mean-Environment-Device  # Parking
      Part: abbr-name=Part, classifications=Condition-Qualifier
      Ptl: abbr-name=Ptl, classifications=Condition-Qualifier  # Partial | this keyword expresses the characterization of "only partly, not completely"
      Pa: abbr-name=Pa, classifications=Mean-Environment-Device  # Pascal | Unit of measure for pressure
      Pase: abbr-name=Pase, classifications=Mean-Environment-Device  # PASE | Passive Start and Entry (PASE), keyless access.
      Passd: abbr-name=Passd, classifications=Condition-Qualifier  # Passed
      Pass: abbr-name=Pass, classifications=Mean-Environment-Device  # Passenger
      Pas: abbr-name=Pas, classifications=Condition-Qualifier  # Passive
      Pwd: abbr-name=Pwd, classifications=Condition-Qualifier  # Password
      Pah: abbr-name=Pah, classifications=Mean-Environment-Device  # Path
      Pat: abbr-name=Pat, classifications=Condition-Qualifier  # Pattern
      Pdu: abbr-name=Pdu, classifications=Mean-Environment-Device  # PDU | Protocol Data Unit
      Peak: abbr-name=Peak, classifications=Condition-Qualifier
      Pedl: abbr-name=Pedl, classifications=Mean-Environment-Device  # Pedal
      Ped: abbr-name=Ped, classifications=Mean-Environment-Device  # Pedestrian
      Pelv: abbr-name=Pelv, classifications=Mean-Environment-Device  # Pelvis | pelvis of human body
      Pnd: abbr-name=Pnd, classifications=Condition-Qualifier  # Pending | This keyword is used to build the "pending" fault used in the error management aggregate defined by the ISO 15031-5.5 service $07.
      Per: abbr-name=Per, classifications=Preposition  # Preposition
      Perc: abbr-name=Perc, classifications=Action-PhysicalType  # Percent
      Prfmnc: abbr-name=Prfmnc, classifications=Condition-Qualifier  # Performance
      Perd: abbr-name=Perd, classifications=Condition-Qualifier  # Period
      Prmnt: abbr-name=Prmnt, classifications=Condition-Qualifier  # Permanent
      Perml: abbr-name=Perml, classifications=Condition-Qualifier  # Permille
      Permtn: abbr-name=Permtn, classifications=Condition-Qualifier  # Permutation
      Perox: abbr-name=Perox, classifications=Mean-Environment-Device  # Peroxide
      Prsnl: abbr-name=Prsnl, classifications=Condition-Qualifier  # Personal
      Pen: abbr-name=Pen, classifications=Condition-Qualifier  # Personalization
      Pfi: abbr-name=Pfi, classifications=Mean-Environment-Device  # PFI | Port Fuel Injection
      Pha: abbr-name=Pha, classifications=Condition-Qualifier  # Phase
      Phev: abbr-name=Phev, classifications=Mean-Environment-Device  # PHEV | Plug-in Hybrid Electric Vehicle
      Philippine: abbr-name=Philippine, classifications=Condition-Qualifier
      Phy: abbr-name=Phy, classifications=Condition-Qualifier  # Physical
      Pi: abbr-name=Pi, classifications=Condition-Qualifier
      Pico: abbr-name=Pico, classifications=Mean-Environment-Device
      Pid: abbr-name=Pid, classifications=Condition-Qualifier  # PID | Proportional Integral Derivative, as widely used in "PID Controller".
      Pin: abbr-name=Pin, classifications=Mean-Environment-Device
      Pinion: abbr-name=Pinion, classifications=Mean-Environment-Device
      Pipe: abbr-name=Pipe, classifications=Mean-Environment-Device
      Pist: abbr-name=Pist, classifications=Mean-Environment-Device  # Piston | central component in a combustion engine. It serves to transform the gas pressure within the cylinder into a movement. The keyword is used e.g. to express the name for piston temperature
      Pitch: abbr-name=Pitch, classifications=Action-PhysicalType
      Pitchovr: abbr-name=Pitchovr, classifications=Action-PhysicalType  # Pitchover
      Pla: abbr-name=Pla, classifications=Mean-Environment-Device  # Plant
      Plate: abbr-name=Plate, classifications=Mean-Environment-Device
      Plaus: abbr-name=Plaus, classifications=Condition-Qualifier  # Plausible
      Pll: abbr-name=Pll, classifications=Mean-Environment-Device  # PLL | Phase Locked Loop
      Pnm: abbr-name=Pnm, classifications=Condition-Qualifier  # Pneumatic | used e.g. for description of pneumatic actuators (such as recirculation valve actuator or waste gate actuator)
      Ptr: abbr-name=Ptr, classifications=Condition-Qualifier  # Pointer
      Polarity: abbr-name=Polarity, classifications=Condition-Qualifier
      Pole: abbr-name=Pole, classifications=Condition-Qualifier  # e.g. magnetic pole
      Polling: abbr-name=Polling, classifications=Action-PhysicalType
      Pool: abbr-name=Pool, classifications=Mean-Environment-Device
      Port: abbr-name=Port, classifications=Condition-Qualifier
      Posn: abbr-name=Posn, classifications=Action-PhysicalType  # Position
      Posng: abbr-name=Posng, classifications=Action-PhysicalType  # Positioning
      Pos: abbr-name=Pos, classifications=Condition-Qualifier  # Positive
      Psbl: abbr-name=Psbl, classifications=Condition-Qualifier  # Possible
      Post: abbr-name=Post, classifications=Preposition
      Poti: abbr-name=Poti, classifications=Mean-Environment-Device  # Potentiometer
      Pwr: abbr-name=Pwr, classifications=Action-PhysicalType  # Power
      Pt: abbr-name=Pt, classifications=Mean-Environment-Device  # Powertrain
      Pre: abbr-name=Pre, classifications=Preposition  # used to express any kind of pre-processing like e.g. for pre-injection
      Prec: abbr-name=Prec, classifications=Condition-Qualifier  # Precharge
      Pred: abbr-name=Pred, classifications=Condition-Qualifier  # Predicted
      Prel: abbr-name=Prel, classifications=Condition-Qualifier  # Preliminary
      Prem: abbr-name=Prem, classifications=Condition-Qualifier  # Premature
      Prepn: abbr-name=Prepn, classifications=Condition-Qualifier  # Preparation | this characteristic is used to express a general status of preparation, e.g. processing of certain tasks before an activation of a certain component or functionality
      Prep: abbr-name=Prep, classifications=Action-PhysicalType  # Prepare
      Pres: abbr-name=Pres, classifications=Condition-Qualifier  # Presence
      Prsnt: abbr-name=Prsnt, classifications=Condition-Qualifier  # Present
      Psd: abbr-name=Psd, classifications=Condition-Qualifier  # Pressed
      P: abbr-name=P, classifications=Action-PhysicalType  # Pressure
      Prevn: abbr-name=Prevn, classifications=Condition-Qualifier  # Prevention
      Prev: abbr-name=Prev, classifications=Condition-Qualifier  # Previous
      Prim: abbr-name=Prim, classifications=Condition-Qualifier  # Primary
      Prio: abbr-name=Prio, classifications=Condition-Qualifier  # Priority
      Problty: abbr-name=Problty, classifications=Condition-Qualifier  # Probability
      Probl: abbr-name=Probl, classifications=Condition-Qualifier  # Probable | e.g. probable path from nagivation system
      Proc: abbr-name=Proc, classifications=Action-PhysicalType  # Process
      Prof: abbr-name=Prof, classifications=Action-PhysicalType  # Profile
      Prog: abbr-name=Prog, classifications=Condition-Qualifier  # Program
      Progd: abbr-name=Progd, classifications=Condition-Qualifier  # Programmed
      Progm: abbr-name=Progm, classifications=Condition-Qualifier  # Programming
      Progs: abbr-name=Progs, classifications=Condition-Qualifier  # Progress
      Prohb: abbr-name=Prohb, classifications=Action-PhysicalType  # prohibit
      Prj: abbr-name=Prj, classifications=Condition-Qualifier  # Project
      Prjn: abbr-name=Prjn, classifications=Condition-Qualifier  # Projection
      Ppty: abbr-name=Ppty, classifications=Condition-Qualifier  # Property
      Prop: abbr-name=Prop, classifications=Condition-Qualifier  # Proportional
      Prpn: abbr-name=Prpn, classifications=Condition-Qualifier  # Propulsion
      Prp: abbr-name=Prp, classifications=Condition-Qualifier  # Propulsive | opposite of drag resistance. Notion of positive forces generated by a system. Example: for a car, we can list internal combustion engine + starter/generator + electrical engine
      Prot: abbr-name=Prot, classifications=Action-PhysicalType  # Protect
      Protd: abbr-name=Protd, classifications=Condition-Qualifier  # Protected
      Protn: abbr-name=Protn, classifications=Action-PhysicalType  # Protection
      Prototype: abbr-name=Prototype, classifications=Condition-Qualifier
      Ptc: abbr-name=Ptc, classifications=Mean-Environment-Device  # PTC | Power Train Controller
      Puddle: abbr-name=Puddle, classifications=Mean-Environment-Device
      Pull: abbr-name=Pull, classifications=Action-PhysicalType
      Pls: abbr-name=Pls, classifications=Mean-Environment-Device  # Pulse | a pulse is a simple electrical signal with a defined shape
      Pmp: abbr-name=Pmp, classifications=Mean-Environment-Device  # Pump
      Purg: abbr-name=Purg, classifications=Action-PhysicalType  # Purge
      Push: abbr-name=Push, classifications=Action-PhysicalType  # push (start), towing, power on driving, press. keyword for push or active towing (e.g. if a vehicle has to be started by towing, a button is pressed, if there is positive torque inside powertrain)
      Put: abbr-name=Put, classifications=Action-PhysicalType
      Pwm: abbr-name=Pwm, classifications=Condition-Qualifier  # PWM | Pulse Width Modulation
      Pyro: abbr-name=Pyro, classifications=Mean-Environment-Device  # Pyrometer | this keyword is used to express a relationship to a pyrometer which is a contactless instrument to measure high temperatures
      Qlfr: abbr-name=Qlfr, classifications=Condition-Qualifier  # Qualifier
      Qly: abbr-name=Qly, classifications=Condition-Qualifier  # Quality | This keyword is used to express the word 'quality'
      Qnty: abbr-name=Qnty, classifications=Condition-Qualifier  # Quantity
      Query: abbr-name=Query, classifications=Condition-Qualifier
      Quick: abbr-name=Quick, classifications=Condition-Qualifier
      Quo: abbr-name=Quo, classifications=Condition-Qualifier  # Quotient
      Rdr: abbr-name=Rdr, classifications=Mean-Environment-Device  # Radar
      Rad: abbr-name=Rad, classifications=Mean-Environment-Device  # Radian | As unit of measure for angles
      Radr: abbr-name=Radr, classifications=Mean-Environment-Device  # Radiator | a radiator is a component, that senses out heat. It can be found e.g. in the cooling circuit of a car.
      Radio: abbr-name=Radio, classifications=Mean-Environment-Device
      Rd: abbr-name=Rd, classifications=Action-PhysicalType  # Radius
      Rail: abbr-name=Rail, classifications=Mean-Environment-Device  # Examples: Common Rail, Fuel Pressure Rail. The common rail is a core component in some fuel system configurations (esp. diesel). It is a high pressure fuel container mostly in form of a tube and located close to the engine.
      Rain: abbr-name=Rain, classifications=Mean-Environment-Device
      Ram: abbr-name=Ram, classifications=Mean-Environment-Device  # RAM | Random Access Memory
      Ramp: abbr-name=Ramp, classifications=Condition-Qualifier
      Rnd: abbr-name=Rnd, classifications=Condition-Qualifier  # Random
      Rng: abbr-name=Rng, classifications=Action-PhysicalType  # Range
      Rate: abbr-name=Rate, classifications=Action-PhysicalType  # this keyword is used to express a rate in physical meaning
      Rat: abbr-name=Rat, classifications=Action-PhysicalType  # Ratio | RATIO is used to describe a value gained from a proportion of other values. The unit of RATIO must be [-] (no unit).
      Raw: abbr-name=Raw, classifications=Condition-Qualifier  # Unprocessed sensor data.
      Reactn: abbr-name=Reactn, classifications=Action-PhysicalType  # Reaction
      Reacvn: abbr-name=Reacvn, classifications=Condition-Qualifier  # Reactivation
      Read: abbr-name=Read, classifications=Action-PhysicalType
      Reading: abbr-name=Reading, classifications=Action-PhysicalType
      Rdy: abbr-name=Rdy, classifications=Condition-Qualifier  # Ready | readiness identification
      Real: abbr-name=Real, classifications=Condition-Qualifier  # Real part
      Relzd: abbr-name=Relzd, classifications=Condition-Qualifier  # Realized
      Re: abbr-name=Re, classifications=Condition-Qualifier  # Rear
      Re1: abbr-name=Re, classifications=Mean-Environment-Device  # Reynolds Number
      Rbd: abbr-name=Rbd, classifications=Condition-Qualifier  # Rebound
      Recalcn: abbr-name=Recalcn, classifications=Action-PhysicalType  # Recalculation
      Recall: abbr-name=Recall, classifications=Condition-Qualifier
      Rx: abbr-name=Rx, classifications=Action-PhysicalType  # Receive
      Rxr: abbr-name=Rxr, classifications=Mean-Environment-Device  # Receiver
      Rxn: abbr-name=Rxn, classifications=Condition-Qualifier  # Reception
      Recpr: abbr-name=Recpr, classifications=Condition-Qualifier  # Reciprocal
      Recirc: abbr-name=Recirc, classifications=Action-PhysicalType  # Recirculation
      Rcnd: abbr-name=Rcnd, classifications=Condition-Qualifier  # Recognized
      Rec: abbr-name=Rec, classifications=Condition-Qualifier  # Record
      Redn: abbr-name=Redn, classifications=Condition-Qualifier  # Reduction
      Rdnt: abbr-name=Rdnt, classifications=Condition-Qualifier  # Redundant
      Ref: abbr-name=Ref, classifications=Condition-Qualifier  # Reference
      Refrsh: abbr-name=Refrsh, classifications=Action-PhysicalType  # Refresh
      Refu: abbr-name=Refu, classifications=Action-PhysicalType  # Refuel
      Rgn: abbr-name=Rgn, classifications=Condition-Qualifier  # Regeneration
      Regn: abbr-name=Regn, classifications=Condition-Qualifier  # Region
      Rgl: abbr-name=Rgl, classifications=Condition-Qualifier  # Regular | this keyword is used to describe e.g. a process as being in a normal status in sense of correctness. It is behaving like wanted (it behaves like wanted to treat a disturbance), it is not out of order.
      Rgln: abbr-name=Rgln, classifications=Condition-Qualifier  # Regulation
      Reinf: abbr-name=Reinf, classifications=Action-PhysicalType  # Reinforce
      Rejctd: abbr-name=Rejctd, classifications=Condition-Qualifier  # Rejected
      Rel: abbr-name=Rel, classifications=Condition-Qualifier  # Relative
      Rly: abbr-name=Rly, classifications=Mean-Environment-Device  # Relay
      Rels: abbr-name=Rels, classifications=Action-PhysicalType  # Release
      Reld: abbr-name=Reld, classifications=Condition-Qualifier  # Released
      Rlvc: abbr-name=Rlvc, classifications=Condition-Qualifier  # Relevance
      Rlv: abbr-name=Rlv, classifications=Condition-Qualifier  # Relevant
      Rmn: abbr-name=Rmn, classifications=Mean-Environment-Device  # Reminder
      Rem: abbr-name=Rem, classifications=Condition-Qualifier  # Remote
      Rep: abbr-name=Rep, classifications=Action-PhysicalType  # Repeat
      Repn: abbr-name=Repn, classifications=Condition-Qualifier  # Repetition
      Replcmt: abbr-name=Replcmt, classifications=Condition-Qualifier  # Replacement
      Req: abbr-name=Req, classifications=Condition-Qualifier  # Request
      Reqd: abbr-name=Reqd, classifications=Condition-Qualifier  # Requested
      Rqrd: abbr-name=Rqrd, classifications=Condition-Qualifier  # Required
      Resv: abbr-name=Resv, classifications=Condition-Qualifier  # Reserve
      Resd: abbr-name=Resd, classifications=Condition-Qualifier  # Reserved
      Rst: abbr-name=Rst, classifications=Condition-Qualifier  # Reset
      Resi: abbr-name=Resi, classifications=Condition-Qualifier  # Residual
      R: abbr-name=R, classifications=Action-PhysicalType  # Resistance | Unit must be Ohm
      Resl: abbr-name=Resl, classifications=Condition-Qualifier  # Resolution
      Resp: abbr-name=Resp, classifications=Condition-Qualifier  # Response
      Rest: abbr-name=Rest, classifications=Condition-Qualifier
      Rstrt: abbr-name=Rstrt, classifications=Condition-Qualifier  # Restart
      Restore: abbr-name=Restore, classifications=Action-PhysicalType
      Restrctn: abbr-name=Restrctn, classifications=Action-PhysicalType  # Restriction
      Restrnt: abbr-name=Restrnt, classifications=Mean-Environment-Device  # Restraint
      Res: abbr-name=Res, classifications=Condition-Qualifier  # Result
      Resu: abbr-name=Resu, classifications=Condition-Qualifier  # Resume
      Rtd: abbr-name=Rtd, classifications=Condition-Qualifier  # Retard
      Rtdr: abbr-name=Rtdr, classifications=Condition-Qualifier  # Retarder
      Rtrctr: abbr-name=Rtrctr, classifications=Mean-Environment-Device  # Retractor | Part of supplement restraint system to protect occupant in case of crash
      Rvs: abbr-name=Rvs, classifications=Condition-Qualifier  # Reverse
      Rvsb: abbr-name=Rvsb, classifications=Condition-Qualifier  # Reversible | This keyword is used to express that something can return to a previous status, e.g. in Cruise Control deactivation: It means in this case that cruise can be activated again in the same driving cycle once a deactivation occurred.
      Rvsg: abbr-name=Rvsg, classifications=Action-PhysicalType  # Reversing
      Rev: abbr-name=Rev, classifications=Mean-Environment-Device  # Revolution | As unit of measure
      Rex: abbr-name=Rex, classifications=Mean-Environment-Device  # REX | Range Extender
      Rho: abbr-name=Rho, classifications=Action-PhysicalType  # density
      Rich: abbr-name=Rich, classifications=Condition-Qualifier
      Rcrltn: abbr-name=Rcrltn, classifications=Condition-Qualifier  # Ricirculation
      Ride: abbr-name=Ride, classifications=Action-PhysicalType
      Ri: abbr-name=Ri, classifications=Condition-Qualifier  # Right | right
      Rise: abbr-name=Rise, classifications=Action-PhysicalType
      Risng: abbr-name=Risng, classifications=Condition-Qualifier  # Rising
      Risk: abbr-name=Risk, classifications=Condition-Qualifier
      Rke: abbr-name=Rke, classifications=Mean-Environment-Device  # RKE | Remote Keyless Entry
      Road: abbr-name=Road, classifications=Mean-Environment-Device  # this keyword is used to express the conditions a street can apply to the vehicle
      Roll: abbr-name=Roll, classifications=Action-PhysicalType
      Rollbar: abbr-name=Rollbar, classifications=Mean-Environment-Device  # (Active) safety roll bar to protect passengers
      Rollr: abbr-name=Rollr, classifications=Mean-Environment-Device  # Roller
      Rollg: abbr-name=Rollg, classifications=Action-PhysicalType  # Rolling
      Rollovr: abbr-name=Rollovr, classifications=Action-PhysicalType  # Rollover | Info from airbag control unit
      Rom: abbr-name=Rom, classifications=Mean-Environment-Device  # ROM | Read Only Memory
      Ron: abbr-name=Ron, classifications=Action-PhysicalType  # RON | Research Octane Number
      Roof: abbr-name=Roof, classifications=Mean-Environment-Device
      Roty: abbr-name=Roty, classifications=Condition-Qualifier  # Rotary
      Rot: abbr-name=Rot, classifications=Condition-Qualifier  # Rotation | This keyword is used to express circular motions.
      Rotl: abbr-name=Rotl, classifications=Condition-Qualifier  # Rotational
      Rotor: abbr-name=Rotor, classifications=Mean-Environment-Device
      Roughns: abbr-name=Roughns, classifications=Action-PhysicalType  # Roughness
      Route: abbr-name=Route, classifications=Condition-Qualifier  # e.g. used in context of route guidance from navigation system
      Row: abbr-name=Row, classifications=Mean-Environment-Device
      Rpm: abbr-name=Rpm, classifications=Mean-Environment-Device  # RPM | Revolutions per Minute, used as unit of measure of frequency
      Rsa: abbr-name=Rsa, classifications=Condition-Qualifier  # RSA | Republic of South Africa
      Rsc: abbr-name=Rsc, classifications=Mean-Environment-Device  # RSC | Roll Stability Control
      Rte: abbr-name=Rte, classifications=Mean-Environment-Device  # RTE | Run-Time Environment
      Rule: abbr-name=Rule, classifications=Condition-Qualifier
      Run: abbr-name=Run, classifications=Action-PhysicalType
      Runng: abbr-name=Runng, classifications=Condition-Qualifier  # Running
      Rt: abbr-name=Rt, classifications=Condition-Qualifier  # Runtime
      Safe: abbr-name=Safe, classifications=Condition-Qualifier
      Sfty: abbr-name=Sfty, classifications=Mean-Environment-Device  # Safety
      Sale: abbr-name=Sale, classifications=Action-PhysicalType
      Sample: abbr-name=Sample, classifications=Condition-Qualifier
      Satn: abbr-name=Satn, classifications=Action-PhysicalType  # Saturation
      Save: abbr-name=Save, classifications=Action-PhysicalType
      Saved: abbr-name=Saved, classifications=Condition-Qualifier
      Sca: abbr-name=Sca, classifications=Condition-Qualifier  # Scale
      Scan: abbr-name=Scan, classifications=Action-PhysicalType
      Scanr: abbr-name=Scanr, classifications=Mean-Environment-Device  # Scanner
      Scav: abbr-name=Scav, classifications=Condition-Qualifier  # Scavenging | The process of pushing fresh gas from the inlet into the exhaust by having big overlap of opened inlet and outlet valve, especially at charged engines is called scavenging.
      Sdl: abbr-name=Sdl, classifications=Condition-Qualifier  # Scheduler
      Scr: abbr-name=Scr, classifications=Mean-Environment-Device  # SCR | Selective Catalytic Reduction (System)
      Scrn: abbr-name=Scrn, classifications=Mean-Environment-Device  # Screen
      Seat: abbr-name=Seat, classifications=Mean-Environment-Device
      Seatg: abbr-name=Seatg, classifications=Condition-Qualifier  # Seating
      Sec: abbr-name=Sec, classifications=Condition-Qualifier  # Second | Used as "2nd"
      Sec1: abbr-name=Sec, classifications=Mean-Environment-Device  # Second | Used as time unit
      Sector: abbr-name=Sector, classifications=Condition-Qualifier
      Secu: abbr-name=Secu, classifications=Condition-Qualifier  # Security
      Seed: abbr-name=Seed, classifications=Condition-Qualifier
      Seg: abbr-name=Seg, classifications=Mean-Environment-Device  # Segment
      Segd: abbr-name=Segd, classifications=Condition-Qualifier  # Segmented
      Sel: abbr-name=Sel, classifications=Action-PhysicalType  # Select
      Seld: abbr-name=Seld, classifications=Condition-Qualifier  # Selected
      Seln: abbr-name=Seln, classifications=Condition-Qualifier  # Selection | Seln is used to assign e.g. the selection of a certain functionality (one out of several strategies) or component (one of several gears, sensors,..) as well as in simulation to select a single entry of an Array by putting Seln at the end of the name
      Self: abbr-name=Self, classifications=Condition-Qualifier
      Snd: abbr-name=Snd, classifications=Action-PhysicalType  # Send
      Sen: abbr-name=Sen, classifications=Action-PhysicalType  # Sensing
      Snvty: abbr-name=Snvty, classifications=Condition-Qualifier  # Sensitivity
      Snsr: abbr-name=Snsr, classifications=Mean-Environment-Device  # Sensor
      Sent: abbr-name=Sent, classifications=Mean-Environment-Device  # SENT | Single Edge Nibble Transmission (Protocol)
      Seq: abbr-name=Seq, classifications=Condition-Qualifier  # Sequence
      Seql: abbr-name=Seql, classifications=Condition-Qualifier  # Sequential
      Serl: abbr-name=Serl, classifications=Condition-Qualifier  # Serial
      Ser: abbr-name=Ser, classifications=Mean-Environment-Device  # Serie
      Srv: abbr-name=Srv, classifications=Condition-Qualifier  # Service | a service is a processing routine within a certain functionality. This keyword is used to nominate such services.
      Servo: abbr-name=Servo, classifications=Condition-Qualifier
      Session: abbr-name=Session, classifications=Condition-Qualifier
      Set: abbr-name=Set, classifications=Action-PhysicalType
      Sp: abbr-name=Sp, classifications=Condition-Qualifier  # Setpoint
      Sev: abbr-name=Sev, classifications=Action-PhysicalType  # Severity
      Shaft: abbr-name=Shaft, classifications=Condition-Qualifier  # a shaft is a rotating rod, carrying out a certain task or transmitting a force in a powertrain. Example: outbox gearbox shaft.
      Shd: abbr-name=Shd, classifications=Condition-Qualifier  # Shield
      Shift: abbr-name=Shift, classifications=Action-PhysicalType  # Used e.g. in up shift (ShiftUp) or down shift (ShiftDwn) or gear shift (GearShift) (synonyms: upshift, downshift, gearshift, UpShift, DownShift etc.).
      Shiftr: abbr-name=Shiftr, classifications=Mean-Environment-Device  # Shifter
      Sho: abbr-name=Sho, classifications=Condition-Qualifier  # Short | short trip
      Shong: abbr-name=Shong, classifications=Action-PhysicalType  # Shortening
      Shttr: abbr-name=Shttr, classifications=Mean-Environment-Device  # Shutter
      Side: abbr-name=Side, classifications=Condition-Qualifier  # This keyword is intended for common consideration of inlet and exhaust side.
      S: abbr-name=S, classifications=Mean-Environment-Device  # Siemens | Unit of measure for conductance
      Sig: abbr-name=Sig, classifications=Condition-Qualifier  # Signal
      Sill: abbr-name=Sill, classifications=Mean-Environment-Device
      Simple: abbr-name=Simple, classifications=Condition-Qualifier
      Simd: abbr-name=Simd, classifications=Condition-Qualifier  # Simulated
      Simn: abbr-name=Simn, classifications=Condition-Qualifier  # Simulation
      Sng: abbr-name=Sng, classifications=Condition-Qualifier  # Single
      Sin: abbr-name=Sin, classifications=Condition-Qualifier  # Sinus
      Size: abbr-name=Size, classifications=Condition-Qualifier
      Skip: abbr-name=Skip, classifications=Action-PhysicalType
      Slave: abbr-name=Slave, classifications=Condition-Qualifier
      Sleep: abbr-name=Sleep, classifications=Condition-Qualifier
      Sld: abbr-name=Sld, classifications=Action-PhysicalType  # Slide
      Sldg: abbr-name=Sldg, classifications=Action-PhysicalType  # Sliding
      Slip: abbr-name=Slip, classifications=Action-PhysicalType
      Slop: abbr-name=Slop, classifications=Condition-Qualifier  # Slope
      Slow: abbr-name=Slow, classifications=Condition-Qualifier
      Small: abbr-name=Small, classifications=Condition-Qualifier
      Smt: abbr-name=Smt, classifications=Condition-Qualifier  # Smart | more and more electronic components take over tasks that had been done before by a central processing unit. Such components are seen as "intelligent" or "smart", whereas the second expression is the one used more generally.
      Smk: abbr-name=Smk, classifications=Mean-Environment-Device  # Smoke
      Smotng: abbr-name=Smotng, classifications=Action-PhysicalType  # Smoothing
      Soc: abbr-name=Soc, classifications=Condition-Qualifier  # SOC | State of Charge
      Soft: abbr-name=Soft, classifications=Condition-Qualifier
      Sw: abbr-name=Sw, classifications=Mean-Environment-Device  # Software
      Soi: abbr-name=Soi, classifications=Condition-Qualifier  # SOI | Start of Injection. Unit must be angle
      Soln: abbr-name=Soln, classifications=Mean-Environment-Device  # Solenoid
      Soon: abbr-name=Soon, classifications=Condition-Qualifier
      Soot: abbr-name=Soot, classifications=Mean-Environment-Device  # used in the sense of soot or smut
      Sound: abbr-name=Sound, classifications=Action-PhysicalType
      Soundr: abbr-name=Soundr, classifications=Mean-Environment-Device  # Sounder
      Src: abbr-name=Src, classifications=Condition-Qualifier  # Source
      Sox: abbr-name=Sox, classifications=Mean-Environment-Device  # SOx | Sulphur Oxide
      Spare: abbr-name=Spare, classifications=Condition-Qualifier
      Sprk: abbr-name=Sprk, classifications=Action-PhysicalType  # Spark
      Spkr: abbr-name=Spkr, classifications=Mean-Environment-Device  # Speaker | e.g. loudspeaker
      Spcl: abbr-name=Spcl, classifications=Condition-Qualifier  # Special
      Spc: abbr-name=Spc, classifications=Condition-Qualifier  # Specific | for specific environmental data (stored individually with particular failures of one project).
      Spd: abbr-name=Spd, classifications=Action-PhysicalType  # Speed | Use N for rotatory speeds, use V for translatory speeds and only if both of them are not appropriate use Spd. In Chassis currently both is used: Velocity and Spd, as well as „V“ and „Spd“ and combinations. „N“ is also used.
      Spi: abbr-name=Spi, classifications=Condition-Qualifier  # SPI | Serial Peripheral Interface
      Split: abbr-name=Split, classifications=Condition-Qualifier
      Spo: abbr-name=Spo, classifications=Condition-Qualifier  # Spontaneous | This keyword characterizes a sudden, unexpected occurrence. E.g. a not pre-arranged catalyst regeneration phase.
      Spt: abbr-name=Spt, classifications=Condition-Qualifier  # Sport | Related to the (short- and long term) detection of driver type either an economic/comfort oriented or a sportive/ power requesting driver can be distinguished.
      Sprg: abbr-name=Sprg, classifications=Mean-Environment-Device  # Spring
      Sqrt: abbr-name=Sqrt, classifications=Condition-Qualifier  # square root
      Sq: abbr-name=Sq, classifications=Condition-Qualifier  # Square | the Keyword is used to describe the relationship of a Functional Data to the arithmetic procedure of multiplication of a value with itself.
      Sqd: abbr-name=Sqd, classifications=Condition-Qualifier  # Squared
      Ssm: abbr-name=Ssm, classifications=Mean-Environment-Device  # SSM | Stand Still Manager
      Staby: abbr-name=Staby, classifications=Condition-Qualifier  # Stability
      Stabn: abbr-name=Stabn, classifications=Action-PhysicalType  # Stabilization
      Stabr: abbr-name=Stabr, classifications=Mean-Environment-Device  # Stabilizer
      Stab: abbr-name=Stab, classifications=Condition-Qualifier  # Stable
      Stg: abbr-name=Stg, classifications=Mean-Environment-Device  # Stage | Examples: Power Stage / Powerstage
      Stall: abbr-name=Stall, classifications=Action-PhysicalType
      Stallg: abbr-name=Stallg, classifications=Condition-Qualifier  # Stalling
      Stamp: abbr-name=Stamp, classifications=Action-PhysicalType
      Stand: abbr-name=Stand, classifications=Action-PhysicalType
      Std: abbr-name=Std, classifications=Condition-Qualifier  # Standard | e.g. as in standard deviation
      Stdn: abbr-name=Stdn, classifications=Condition-Qualifier  # Standardization
      Stb: abbr-name=Stb, classifications=Condition-Qualifier  # Standby
      Standg: abbr-name=Standg, classifications=Action-PhysicalType  # Standing
      Strt: abbr-name=Strt, classifications=Action-PhysicalType  # Start
      Strtd: abbr-name=Strtd, classifications=Condition-Qualifier  # Started
      Strtr: abbr-name=Strtr, classifications=Mean-Environment-Device  # Starter
      Strtg: abbr-name=Strtg, classifications=Condition-Qualifier  # Starting
      St: abbr-name=St, classifications=Condition-Qualifier  # State | Used for both, "state" and "status".
      Stat: abbr-name=Stat, classifications=Condition-Qualifier  # Static
      Staty: abbr-name=Staty, classifications=Condition-Qualifier  # Stationary | This keyword is used to describe a situation, where a movable part is at rest or a certain condition does not change
      Stc: abbr-name=Stc, classifications=Condition-Qualifier  # Statistic
      Stator: abbr-name=Stator, classifications=Mean-Environment-Device
      Sts: abbr-name=Sts, classifications=Condition-Qualifier  # Status
      Steer: abbr-name=Steer, classifications=Mean-Environment-Device  # Steering | This keyword is used to express the steering of a car.
      Step: abbr-name=Step, classifications=Condition-Qualifier
      Srad: abbr-name=Srad, classifications=Mean-Environment-Device  # Steradian | As a unit of measure for solid angle
      Stfn: abbr-name=Stfn, classifications=Action-PhysicalType  # Stiffness | stiffness is the grade of hardness of a material, e.g. in a damper: it is composed of a spring (stiffness part: force proportional to displacement) and a fluid friction (viscous part: force proportional to speed)
      Still: abbr-name=Still, classifications=Condition-Qualifier
      Sti: abbr-name=Sti, classifications=Condition-Qualifier  # Stimulation | The stimulation describes the inputs for testing of functions.
      Stoi: abbr-name=Stoi, classifications=Condition-Qualifier  # Stoichiometric
      Stop: abbr-name=Stop, classifications=Action-PhysicalType
      Storg: abbr-name=Storg, classifications=Action-PhysicalType  # Storage
      Store: abbr-name=Store, classifications=Action-PhysicalType
      Stgy: abbr-name=Stgy, classifications=Condition-Qualifier  # Strategy
      Strat: abbr-name=Strat, classifications=Condition-Qualifier  # Stratified | e. g. used in stratified injection
      Strike: abbr-name=Strike, classifications=Action-PhysicalType
      Stk: abbr-name=Stk, classifications=Condition-Qualifier  # Stroke
      Struct: abbr-name=Struct, classifications=Condition-Qualifier  # Structure
      Stuck: abbr-name=Stuck, classifications=Condition-Qualifier  # the keyword STUCK is used to express e.g. a "stuck reading" coolant temperature sensor. This is an official expression of the CARB (Californian Air Resources Board) and is used in term of OBD II requirements.
      Sub: abbr-name=Sub, classifications=Condition-Qualifier  # Substitute
      Subt: abbr-name=Subt, classifications=Condition-Qualifier  # Subtractive
      Subtyp: abbr-name=Subtyp, classifications=Condition-Qualifier  # Subtype
      Suctn: abbr-name=Suctn, classifications=Action-PhysicalType  # Suction
      Su: abbr-name=Su, classifications=Mean-Environment-Device  # Sulphur
      Sum: abbr-name=Sum, classifications=Condition-Qualifier
      Sun: abbr-name=Sun, classifications=Mean-Environment-Device
      Sup: abbr-name=Sup, classifications=Preposition  # Super | example: super charger
      Supr: abbr-name=Supr, classifications=Condition-Qualifier  # Superior
      Suppsn: abbr-name=Suppsn, classifications=Action-PhysicalType  # Superposition
      Sppl: abbr-name=Sppl, classifications=Condition-Qualifier  # Supplementary
      Sply: abbr-name=Sply, classifications=Action-PhysicalType  # Supply
      Supp: abbr-name=Supp, classifications=Action-PhysicalType  # Suppress
      Surge: abbr-name=Surge, classifications=Condition-Qualifier  # surging, surge line. this keyword is used to describe the appearance of surging effects in an (air-)stream, e.g. at the surge line of a turbocharger (which is a characteristic parameter)
      Surrndgs: abbr-name=Surrndgs, classifications=Mean-Environment-Device  # Surroundings
      Susp: abbr-name=Susp, classifications=Mean-Environment-Device  # Suspension
      Suspc: abbr-name=Suspc, classifications=Condition-Qualifier  # Suspicion
      Suv: abbr-name=Suv, classifications=Mean-Environment-Device  # SUV | Sport Utility Vehicle
      Swirl: abbr-name=Swirl, classifications=Mean-Environment-Device
      Swt: abbr-name=Swt, classifications=Mean-Environment-Device  # Switch
      Swil: abbr-name=Swil, classifications=Condition-Qualifier  # Switchable
      Switzerland: abbr-name=Switzerland, classifications=Condition-Qualifier
      Sym: abbr-name=Sym, classifications=Condition-Qualifier  # Symptom
      Syncn: abbr-name=Syncn, classifications=Condition-Qualifier  # Synchronization
      Sync: abbr-name=Sync, classifications=Action-PhysicalType  # Synchronize
      Syncd: abbr-name=Syncd, classifications=Condition-Qualifier  # Synchronized
      Sys: abbr-name=Sys, classifications=Mean-Environment-Device  # System
      Tbl: abbr-name=Tbl, classifications=Condition-Qualifier  # Table
      Taiwan: abbr-name=Taiwan, classifications=Condition-Qualifier
      Tank: abbr-name=Tank, classifications=Mean-Environment-Device
      Tar: abbr-name=Tar, classifications=Condition-Qualifier  # Target
      Tau: abbr-name=Tau, classifications=Condition-Qualifier  # Time constant of a control system (P, I, D).
      Tcs: abbr-name=Tcs, classifications=Mean-Environment-Device  # TCS | Traction Control System
      Tdc: abbr-name=Tdc, classifications=Condition-Qualifier  # TDC | Top Dead Center
      Telgrm: abbr-name=Telgrm, classifications=Mean-Environment-Device  # Telegram
      Telm: abbr-name=Telm, classifications=Mean-Environment-Device  # Telematics
      Telltl: abbr-name=Telltl, classifications=Mean-Environment-Device  # Telltale
      T: abbr-name=T, classifications=Action-PhysicalType  # Temperature
      Tmp: abbr-name=Tmp, classifications=Condition-Qualifier  # Temporary
      Tensnr: abbr-name=Tensnr, classifications=Mean-Environment-Device  # Tensioner
      Term: abbr-name=Term, classifications=Condition-Qualifier
      Terminal: abbr-name=Terminal, classifications=Mean-Environment-Device
      Test: abbr-name=Test, classifications=Condition-Qualifier
      Txt: abbr-name=Txt, classifications=Condition-Qualifier  # Text
      Thailand: abbr-name=Thailand, classifications=Condition-Qualifier
      Theo: abbr-name=Theo, classifications=Condition-Qualifier  # Theoretical
      Therm: abbr-name=Therm, classifications=Condition-Qualifier  # Thermal
      Thermo: abbr-name=Thermo, classifications=Condition-Qualifier
      Th: abbr-name=Th, classifications=Mean-Environment-Device  # Thermostat
      Thrd: abbr-name=Thrd, classifications=Condition-Qualifier  # Third
      Thorax: abbr-name=Thorax, classifications=Mean-Environment-Device  # thorax of human body
      Thd: abbr-name=Thd, classifications=Condition-Qualifier  # Threshold
      Thr: abbr-name=Thr, classifications=Mean-Environment-Device  # Throttle
      Tgtnss: abbr-name=Tgtnss, classifications=Action-PhysicalType  # Tightness
      Tilt: abbr-name=Tilt, classifications=Action-PhysicalType
      Ti: abbr-name=Ti, classifications=Action-PhysicalType  # Time | Time, duration
      Tmr: abbr-name=Tmr, classifications=Condition-Qualifier  # Timer | this keyword is used to express a timer. A timer is counter for a defined time span.
      Tintg: abbr-name=Tintg, classifications=Condition-Qualifier  # Tinting | Action of changing the color of an object
      Tip: abbr-name=Tip, classifications=Condition-Qualifier
      Tire: abbr-name=Tire, classifications=Mean-Environment-Device
      Tit: abbr-name=Tit, classifications=Mean-Environment-Device  # Titanium
      Tn: abbr-name=Tn, classifications=Condition-Qualifier  # time constant for discrete control structures. This keyword is used in control engineering context as time constant for discrete control structures
      To: abbr-name=To, classifications=Preposition  # toward something,.....
      Tog: abbr-name=Tog, classifications=Condition-Qualifier  # Toggle
      Tolr: abbr-name=Tolr, classifications=Action-PhysicalType  # Tolerance
      Tooth: abbr-name=Tooth, classifications=Condition-Qualifier
      Top: abbr-name=Top, classifications=Mean-Environment-Device
      Tq: abbr-name=Tq, classifications=Action-PhysicalType  # Torque
      Tors: abbr-name=Tors, classifications=Condition-Qualifier  # Torsion
      Tot: abbr-name=Tot, classifications=Condition-Qualifier  # Total
      Touchd: abbr-name=Touchd, classifications=Condition-Qualifier  # Touched
      Tout: abbr-name=Tout, classifications=Condition-Qualifier  # time out
      Tp: abbr-name=Tp, classifications=Mean-Environment-Device  # TP | Transport Protocol
      Trac: abbr-name=Trac, classifications=Action-PhysicalType  # Traction
      Trlr: abbr-name=Trlr, classifications=Mean-Environment-Device  # Trailer | a wheeled but not motorized vehicle which can be pulled by a motorized vehicle
      Trcv: abbr-name=Trcv, classifications=Mean-Environment-Device  # Transceiver
      Trf: abbr-name=Trf, classifications=Condition-Qualifier  # Transfer
      Tra: abbr-name=Tra, classifications=Condition-Qualifier  # Transient
      Tran: abbr-name=Tran, classifications=Condition-Qualifier  # Transition
      Trsm: abbr-name=Trsm, classifications=Mean-Environment-Device  # Transmission | In a mechanical context
      Tx: abbr-name=Tx, classifications=Action-PhysicalType  # Transmit | In a communication protocol context
      Transpt: abbr-name=Transpt, classifications=Condition-Qualifier  # Transport | e.g. to indicate a specific car/ecu mode (transport mode)
      Trv: abbr-name=Trv, classifications=Condition-Qualifier  # Transversal | transversal in opposite to longitudinal. e.g. used for acceleration
      Trap: abbr-name=Trap, classifications=Action-PhysicalType
      Trapg: abbr-name=Trapg, classifications=Condition-Qualifier  # Trapping | In case of scavenging the total fresh gas flowing into the cylinder is bigger than the mass air flow staying in the cylinder. The ratio of the mass air flow in the cylinder to the total mass air flow is called trapping efficiency
      Trvl: abbr-name=Trvl, classifications=Action-PhysicalType  # Travel
      Trvld: abbr-name=Trvld, classifications=Condition-Qualifier  # Travelled
      Treat: abbr-name=Treat, classifications=Condition-Qualifier  # Treatment
      Trig: abbr-name=Trig, classifications=Condition-Qualifier  # Trigger
      Trip: abbr-name=Trip, classifications=Condition-Qualifier
      Tro: abbr-name=Tro, classifications=Condition-Qualifier  # Trouble
      Truck: abbr-name=Truck, classifications=Mean-Environment-Device
      Tr: abbr-name=Tr, classifications=Mean-Environment-Device  # Trunk
      Tube: abbr-name=Tube, classifications=Condition-Qualifier  # the keyword TUBE expresses any kind of a pipe, for instance the exhaust .
      Tumb: abbr-name=Tumb, classifications=Condition-Qualifier  # Tumble
      Tun: abbr-name=Tun, classifications=Condition-Qualifier  # Tuning
      Trb: abbr-name=Trb, classifications=Mean-Environment-Device  # Turbine | To describe a turbine (turbine wheel) in general, e.g. in a hydraulic torque converter or in a turbocharger
      Trbo: abbr-name=Trbo, classifications=Mean-Environment-Device  # Turbo
      Trbl: abbr-name=Trbl, classifications=Condition-Qualifier  # Turbulence | Flow regime characterized by chaotic stochastic property changes
      Turn: abbr-name=Turn, classifications=Action-PhysicalType
      Twli: abbr-name=Twli, classifications=Mean-Environment-Device  # Twilight
      Typ: abbr-name=Typ, classifications=Condition-Qualifier  # Type
      Udp: abbr-name=Udp, classifications=Mean-Environment-Device  # UDP | User Datagram Protocol
      Uds: abbr-name=Uds, classifications=Mean-Environment-Device  # UDS | Unified Diagnostic Services. Unified Diagnostic Services is a standard for Diagnostics according to ISO14229-1
      Uego: abbr-name=Uego, classifications=Mean-Environment-Device  # UEGO | Universal Exhaust Gas Oxygen Sensor
      Undefd: abbr-name=Undefd, classifications=Condition-Qualifier  # Undefined
      Unfav: abbr-name=Unfav, classifications=Condition-Qualifier  # Unfavourable
      Unique: abbr-name=Unique, classifications=Condition-Qualifier
      Unit: abbr-name=Unit, classifications=Condition-Qualifier
      Ukwn: abbr-name=Ukwn, classifications=Condition-Qualifier  # Unknown
      Unlck: abbr-name=Unlck, classifications=Action-PhysicalType  # Unlock
      Unlckd: abbr-name=Unlckd, classifications=Condition-Qualifier  # Unlocked
      Up: abbr-name=Up, classifications=Action-PhysicalType
      Upd: abbr-name=Upd, classifications=Action-PhysicalType  # Update
      Uppr: abbr-name=Uppr, classifications=Condition-Qualifier  # Upper
      Us: abbr-name=Us, classifications=Condition-Qualifier  # Up-stream | up-stream or up stream or upstream
      Upw: abbr-name=Upw, classifications=Condition-Qualifier  # Upward
      Urb: abbr-name=Urb, classifications=Condition-Qualifier  # Urban
      Urea: abbr-name=Urea, classifications=Mean-Environment-Device
      Usa: abbr-name=Usa, classifications=Condition-Qualifier  # USA | United States of America
      Usg: abbr-name=Usg, classifications=Condition-Qualifier  # Usage
      Use: abbr-name=Use, classifications=Action-PhysicalType
      Usr: abbr-name=Usr, classifications=Mean-Environment-Device  # User
      Vac: abbr-name=Vac, classifications=Condition-Qualifier  # Vacuum
      Vld: abbr-name=Vld, classifications=Condition-Qualifier  # Valid
      Vldt: abbr-name=Vldt, classifications=Action-PhysicalType  # Validate
      Val: abbr-name=Val, classifications=Condition-Qualifier  # Value
      Vlv: abbr-name=Vlv, classifications=Condition-Qualifier  # Valve
      Van: abbr-name=Van, classifications=Mean-Environment-Device
      Vanity: abbr-name=Vanity, classifications=Mean-Environment-Device
      Vap: abbr-name=Vap, classifications=Condition-Qualifier  # Vapor
      Vari: abbr-name=Vari, classifications=Action-PhysicalType  # Variance
      Vrnt: abbr-name=Vrnt, classifications=Condition-Qualifier  # Variant
      Vcc: abbr-name=Vcc, classifications=Action-PhysicalType  # supply voltage
      Vcv: abbr-name=Vcv, classifications=Mean-Environment-Device  # VCV | Volume Control Valve, e.g. used in "high pressure pump volume control valve".
      Vect: abbr-name=Vect, classifications=Condition-Qualifier  # Vector
      Veh: abbr-name=Veh, classifications=Mean-Environment-Device  # Vehicle
      V: abbr-name=V, classifications=Action-PhysicalType  # Velocity | Translatory speed, also referred to as speed of translation or translational speed. Value at this instant of time, no direction, measured in m/s, km/h or equivalents. Examples: VehV = Vehicle speed [km/h], WhlV = Wheel speed [km/h]
      Vent: abbr-name=Vent, classifications=Mean-Environment-Device
      Ventn: abbr-name=Ventn, classifications=Action-PhysicalType  # Ventilation
      Vers: abbr-name=Vers, classifications=Condition-Qualifier  # Version
      Vert: abbr-name=Vert, classifications=Condition-Qualifier  # Vertical
      Vietnam: abbr-name=Vietnam, classifications=Condition-Qualifier
      Vin: abbr-name=Vin, classifications=Mean-Environment-Device  # VIN | Vehicle Identification Number. This keyword is used to describe the vehicle identification number. This is certain code which is unique for every vehicle and is used for its identification.
      Virt: abbr-name=Virt, classifications=Condition-Qualifier  # Virtual
      Vcos: abbr-name=Vcos, classifications=Action-PhysicalType  # Viscosity | Viscosity describes the thickness of a fluid, e.g. in a damper: it is composed of a spring (stiffness part: force proportional to displacement) and a fluid friction (viscous part: force proportional to speed)
      Visy: abbr-name=Visy, classifications=Condition-Qualifier  # Visibility
      Vis: abbr-name=Vis, classifications=Condition-Qualifier  # Visual
      Vlc: abbr-name=Vlc, classifications=Mean-Environment-Device  # VLC | Vehicle Longitudinal Control
      Volt: abbr-name=Volt, classifications=Mean-Environment-Device  # As unit of measure for voltage
      U: abbr-name=U, classifications=Action-PhysicalType  # Voltage
      Vol: abbr-name=Vol, classifications=Action-PhysicalType  # Volume
      Volmc: abbr-name=Volmc, classifications=Condition-Qualifier  # Volumetric
      Vvt: abbr-name=Vvt, classifications=Mean-Environment-Device  # VVT | Variable Valve Timing
      Wait: abbr-name=Wait, classifications=Action-PhysicalType
      Wall: abbr-name=Wall, classifications=Mean-Environment-Device
      Wrm: abbr-name=Wrm, classifications=Condition-Qualifier  # Warm
      Warn: abbr-name=Warn, classifications=Condition-Qualifier  # Warning
      Wshr: abbr-name=Wshr, classifications=Mean-Environment-Device  # Washer
      Wshng: abbr-name=Wshng, classifications=Action-PhysicalType  # Washing
      Wdg: abbr-name=Wdg, classifications=Mean-Environment-Device  # Watchdog
      Wtr: abbr-name=Wtr, classifications=Mean-Environment-Device  # Water
      Watt: abbr-name=Watt, classifications=Mean-Environment-Device  # As unit of measure for power
      Way: abbr-name=Way, classifications=Condition-Qualifier
      Wear: abbr-name=Wear, classifications=Condition-Qualifier
      Wthr: abbr-name=Wthr, classifications=Condition-Qualifier  # Weather
      Wedge: abbr-name=Wedge, classifications=Mean-Environment-Device
      Wght: abbr-name=Wght, classifications=Mean-Environment-Device  # Weight
      Whl: abbr-name=Whl, classifications=Mean-Environment-Device  # Wheel
      Whls: abbr-name=Whls, classifications=Mean-Environment-Device  # Wheels
      Wide: abbr-name=Wide, classifications=Condition-Qualifier  # keyword is used to specify gear box type, which is distinguished via variant coding (wide ratio: long transmission ratio for lower rpm. closed ratio: sports transmission ratio)
      Width: abbr-name=Width, classifications=Condition-Qualifier  # Used in the sense of width or breadth, e.g. wheel width or wheel breadth
      Wind1: abbr-name=Wind, classifications=Mean-Environment-Device  # wind in the sense of breeze
      Win: abbr-name=Win, classifications=Mean-Environment-Device  # Window
      Wind: abbr-name=Wind, classifications=Mean-Environment-Device  # Windscreen
      Wntr: abbr-name=Wntr, classifications=Condition-Qualifier  # Winter
      Wipr: abbr-name=Wipr, classifications=Mean-Environment-Device  # Wiper
      Wipg: abbr-name=Wipg, classifications=Action-PhysicalType  # Wiping
      Wire: abbr-name=Wire, classifications=Mean-Environment-Device  # Electrical connection media
      Wirels: abbr-name=Wirels, classifications=Condition-Qualifier  # Wireless | Used for Wireless connection
      Wish: abbr-name=Wish, classifications=Action-PhysicalType
      Wishd: abbr-name=Wishd, classifications=Condition-Qualifier  # Wished
      With: abbr-name=With, classifications=Preposition  # preposition
      Within: abbr-name=Within, classifications=Preposition  # preposition
      Wo: abbr-name=Wo, classifications=Preposition  # Without | preposition
      Word: abbr-name=Word, classifications=Condition-Qualifier
      W: abbr-name=W, classifications=Action-PhysicalType  # Work | Energy
      World: abbr-name=World, classifications=Condition-Qualifier
      Wrst: abbr-name=Wrst, classifications=Condition-Qualifier  # Worst
      Wrpr: abbr-name=Wrpr, classifications=Mean-Environment-Device  # Wrapper
      Wr: abbr-name=Wr, classifications=Action-PhysicalType  # Write
      Wrg: abbr-name=Wrg, classifications=Condition-Qualifier  # Wrong | is used to express a mismatch which does not have to be treated by error management diagnosis
      Xcp: abbr-name=Xcp, classifications=Mean-Environment-Device  # XCP | Universal Measurement and Calibration Protocol XCP / extended universal calibration protocol (ASAM standard)
      Xpos: abbr-name=Xpos, classifications=Action-PhysicalType  # Xposition | X position
      Yaw: abbr-name=Yaw, classifications=Action-PhysicalType
      Yr: abbr-name=Yr, classifications=Mean-Environment-Device  # Year
      Yes: abbr-name=Yes, classifications=Condition-Qualifier
      Ypos: abbr-name=Ypos, classifications=Action-PhysicalType  # Yposition | Y position
      Ac1: abbr-name=Ac, classifications=Mean-Environment-Device  # AC | Air Conditioner or Air Conditioning (A/C).
      Byp1: abbr-name=Byp, classifications=Mean-Environment-Device  # Bypass
      Symc: abbr-name=Symc, classifications=Condition-Qualifier  # Symmetrical
      Symtry: abbr-name=Symtry, classifications=Condition-Qualifier  # Symmetry
      On1: abbr-name=On, classifications=Condition-Qualifier
      Drvr1: abbr-name=Drvr, classifications=Mean-Environment-Device  # Driver | Example: as in device driver.
      Flexfu: abbr-name=Flexfu, classifications=Condition-Qualifier  # Flex-Fuel | flexible fuel vehicle, flex-fuel engines etc., sometimes also Flex Fuel or FlexFuel
      Consold: abbr-name=Consold, classifications=Action-PhysicalType  # Consolidated | A consolidated physical value is either the measured physical value or an estimated one.
      Pwr1: abbr-name=Pwr, classifications=Mean-Environment-Device  # Power
      Used: abbr-name=Used, classifications=Condition-Qualifier
      Exact: abbr-name=Exact, classifications=Condition-Qualifier
      Ai: abbr-name=Ai, classifications=Mean-Environment-Device  # AI | Application Interfaces
      Aj: abbr-name=Aj, classifications=Mean-Environment-Device  # Antijerk | Avoiding high-frequent small or abrupt movements, quick changes of torque applied.
      Arch: abbr-name=Arch, classifications=Mean-Environment-Device  # Architecture | A description of system, software or hardware elements, of the relations among them, and of the properties of both elements and relations.
      Ascn: abbr-name=Ascn, classifications=Mean-Environment-Device  # Antiscanning
      Ammonia: abbr-name=Nh3, classifications=Action-PhysicalType  # A pungent colorless gaseous alkaline compound of nitrogen and hydrogen NH3 that is very soluble in water and can easily be condensed to a liquid by cold and pressure
      Drain: abbr-name=Drn, classifications=Condition-Qualifier  # To draw off liquid gradually or completely
      Rcv: abbr-name=Rcv, classifications=Action-PhysicalType  # Recovery | A healing or an upturn, e.g. as after a depression
      Ascd: abbr-name=Ascd, classifications=Condition-Qualifier  # Ascending | Ascending, increasing
      Acry: abbr-name=Acry, classifications=Condition-Qualifier  # Accuracy
      Agt: abbr-name=Agt, classifications=Mean-Environment-Device  # Agent | E.g. Reducing Agent, Cooling Agent
      Accy: abbr-name=Accy, classifications=Condition-Qualifier  # Accuracy | The accuracy of a measurement method respectively the quality of signals are defined in ISO 5725: The "accuracy" (Genauigkeit) is described by the two terms "trueness" (Richtigkeit) and "precision" (Präzision).With the condition, that the "Precision" is homogenously spread over it's whole range, the fomula "Accuracy = Trueness + 0,5 Precision" decribes the accuracy.
      Acos: abbr-name=Acos, classifications=Condition-Qualifier  # Arccosine | Inverse function of cosine
      Adas: abbr-name=Adas, classifications=Mean-Environment-Device  # Advanced driver assistance systems (ADAS) are systems developed to automate/adapt/enhance vehicle systems for safety and better driving.
      Aecd: abbr-name=Aecd, classifications=Condition-Qualifier  # AECD | Auxiliary Emission Control Devices
      Ape: abbr-name=Ape, classifications=Mean-Environment-Device  # APE | Outer Pump Electrode. Electrode of a lambda sensor facing directly the exhaust gas.
      Api: abbr-name=Api, classifications=Mean-Environment-Device  # Application Programming Interface | An Application Programming Interface is a set of definitions and protocols to build and integrate application sofftware.
      Asep: abbr-name=Asep, classifications=Mean-Environment-Device  # Additional Sound Emission Provisions (ASEP) | Additional Sound Emission Provisions - extra sound emitting elements built in, e.g. to make electric vehicles receptable for humans
      Asic: abbr-name=Asic, classifications=Mean-Environment-Device  # ASIC | Application Specific Integrated Circuit
      Asin: abbr-name=Asin, classifications=Condition-Qualifier  # Arcsine | Inverse function of sine
      Atan: abbr-name=Atan, classifications=Condition-Qualifier  # Arctangent | The inverse function of the tangent function.
      Atnms: abbr-name=Atnms, classifications=Condition-Qualifier  # Autonomous | independent
      B: abbr-name=B, classifications=Action-PhysicalType  # Magnetic Flux Density | Amount of magnetic flux through Unit Area taken perpendicular to the direction of magnetic flux (B=µH with µ= permeability of the medium and H = magnetic field)
      Backl: abbr-name=Backl, classifications=Condition-Qualifier  # Backlash | A sudden backward movement or reaction/the play between adjacent movable parts (as in a series of gears)
      Bay: abbr-name=Bay, classifications=Mean-Environment-Device  # Space , e.g. engine bay, parking bay
      Beta: abbr-name=Beta, classifications=Condition-Qualifier  # ß, Greek character, offently used for indexing
      Bit: abbr-name=Bits, classifications=Mean-Environment-Device  # Smallest unit of data that a computer can process and store
      Bitws: abbr-name=Bitws, classifications=Condition-Qualifier  # Bitwise | Used for bitwise functions, e.g. Bitwise And (&)
      Dthr: abbr-name=Dthr, classifications=Action-PhysicalType  # Dither | Dither used in control and signal processing
      Enth: abbr-name=Enth, classifications=Action-PhysicalType  # Enthalpy | The sum of the internal energy of a body or system
      Refgnt: abbr-name=Refgnt, classifications=Condition-Qualifier  # Refrigerant | A refrigerant is a substance or mixture, usually a fluid, used in a heat pump and refrigeration cycle.
      Lumi: abbr-name=Lumi, classifications=Action-PhysicalType  # Luminous Intensity, used for measuring luminous Intensity
      Deci: abbr-name=Deci, classifications=Condition-Qualifier  # Unit extension use: decibel (DeciBel, display name dB)
      Micro1: abbr-name=Micro, classifications=Condition-Qualifier
      Hyddyn: abbr-name=Hyddyn, classifications=Condition-Qualifier  # Hydrodynamic
      Detrm: abbr-name=Detrm, classifications=Condition-Qualifier  # Determined
      Cur: abbr-name=Cur, classifications=Condition-Qualifier  # Current
      Ancllry: abbr-name=Ancllry, classifications=Mean-Environment-Device  # Ancillary
      Inclg: abbr-name=Inclg, classifications=Action-PhysicalType  # Including
      Pck: classifications=Condition-Qualifier  # package, pack | Hierarchical element, representing a collection of coherent entities/functionalities/instances.
      Ethnl: abbr-name=Ethnl, classifications=Condition-Qualifier  # Ethanol | A simple alcohol with the chemical formula C2-H5-OH.
      Crd: abbr-name=Crd, classifications=Mean-Environment-Device  # Cardan | A vehicle component for transmitting mechanical power and torque and rotation, usually used to connect other components of a drivetrain that cannot be connected directly because of distance or the need to allow for relative movement between them.
      Ande: abbr-name=Ande, classifications=Mean-Environment-Device  # Anode | The electrode of an electrochemical cell at which oxidation occurs.
      Ctde: abbr-name=Ctde, classifications=Mean-Environment-Device  # Cathode | The electrode of an electrochemical cell at which reduction occurs.
      Dcop: abbr-name=Dcop, classifications=Condition-Qualifier  # Decoupling | to eliminate an interrelationship
