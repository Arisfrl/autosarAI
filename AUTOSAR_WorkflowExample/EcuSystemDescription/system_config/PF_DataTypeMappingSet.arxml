AUTOSAR XML (schema 00054)
package /Pkg_ImplementationDataTypes
  impl type AgSpd2_Impl: implementation-data-type=sint16
  impl type Spd3_Impl: implementation-data-type=uint16
  impl type OnOff1_Impl: implementation-data-type=boolean
package /Pkg_MappingSets
  data type mapping set DataTypeMappingSet_AgSpd: data-type-map{application-data-type=AgSpd2, implementation-data-type=AgSpd2_Impl}
  data type mapping set DataTypeMappingSet_Spd: data-type-map{application-data-type=Spd3, implementation-data-type=Spd3_Impl}
  data type mapping set DataTypeMappingSet_LedOnOff: data-type-map{application-data-type=OnOff1, implementation-data-type=OnOff1_Impl}
