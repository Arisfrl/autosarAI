AUTOSAR XML (schema 00054)
package /Pkg_System_Cfg/Pkg_Pdus
  pdu ISIPdu_EcuWhlSpd_RoadWhlAgSpd_Tx: length=8, unused-bit-pattern=0
    signal ISig_EcuWhlSpd_RoadWhlAgSpd_Tx: start 0, 16 bit, little-endian, system signal SysSig_EcuWhlSpd_RoadWhlAgSpd_Tx, base-type=sint16, compu-method=AgSpd2
  pdu ISIPdu_EcuVehSpd_RoadWhlAgSpd_Rx: length=8, unused-bit-pattern=0
    signal ISig_EcuVehSpd_RoadWhlAgSpd_Rx: start 0, 16 bit, little-endian, system signal SysSig_EcuVehSpd_RoadWhlAgSpd_Rx, base-type=sint16, compu-method=AgSpd2
package /Pkg_System_Cfg/Pkg_Frame
  can frame CanFrame_EcuWhlSpd_RoadWhlAgSpd_Tx: frame-length=8
    pdu to frame mapping ISIPdu_EcuWhlSpd_RoadWhlAgSpd_Tx: packing-byte-order=little-endian, pdu=ISIPdu_EcuWhlSpd_RoadWhlAgSpd_Tx, start-position=0, update-indication-bit-position=0
  can frame CanFrame_EcuVehSpd_RoadWhlAgSpd_Rx: frame-length=8
    pdu to frame mapping ISIPdu_EcuVehSpd_RoadWhlAgSpd_Rx: packing-byte-order=little-endian, pdu=ISIPdu_EcuVehSpd_RoadWhlAgSpd_Rx, start-position=0, update-indication-bit-position=0
