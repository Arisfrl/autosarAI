AUTOSAR XML (schema 00054)
package /EcuWheelSpeed
  hw element WheelSpeed: hw-type=EcuType, hw-category=Ecu
    hw pin group CanBus
package /EcuVehicleSpeed
  hw element VehicleSpeed: hw-type=EcuType, hw-category=Ecu
    hw pin group CanBus
package /HwElements/HwModules
  hw element Dio: hw-category=Digital
    hw pin group L0
    hw pin group L1
  hw element Adc: hw-category=Analog
package /HwCategorys
  7 x hw category:
    CommunicationController
      hw attribute def CommunicationControllerType: category=ENUMERATION, is-required=true
        hw attribute literal def CAN
    SensorActuator
    Analog
    Digital
    Ecu
    MircoController
    ProcessingUnit
package /HwTypes
  4 x hw type:
    EcuType: hw-category=Ecu
    SensorActuatorType: hw-category=SensorActuator
    IoAType: hw-category=Analog
    IoDType: hw-category=Digital
