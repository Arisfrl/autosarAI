AUTOSAR XML (schema 00054)
package /EcuInstances
  ecu instance WheelSpeed
    can communication controller WhlSpd_CanController: wake-up-by-controller-supported=false, can-controller-attributes=can-controller-configuration={prop-seg=8, sync-jump-width=3, time-seg-1=7, time-seg-2=4}
    can communication connector WhlSpd_CanConnector: comm-controller=WhlSpd_CanController
    ecu partition EcuPartWhlSpd
  ecu instance VehicleSpeed
    can communication controller VehSpd_CanController: wake-up-by-controller-supported=false, can-controller-attributes=can-controller-configuration={prop-seg=8, sync-jump-width=3, time-seg-1=7, time-seg-2=4}
    can communication connector VehSpd_CanConnector: comm-controller=VehSpd_CanController
    ecu partition EcuPartVehSpd
